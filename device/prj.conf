## CMakeLists.txt
```
cmake_minimum_required(VERSION 3.20.0)

if(DEFINED SdkRootDirPath)
    execute_process(COMMAND ${CMAKE_COMMAND} -E remove_directory "${CMAKE_BINARY_DIR}")
    message(FATAL_ERROR
    " Wrong SDK is selected, please run\n"
    " west config manifest.file west_nrfsdk.yml\n"
    " and try again.")
endif()

find_package(Zephyr REQUIRED HINTS $ENV{ZEPHYR_BASE})
project(app)

set(IS_NRF_SDK ON)
target_link_libraries(app PUBLIC
    uhk
)

if(CONFIG_BOARD_UHK_60_RIGHT)
    target_sources(app PRIVATE
        src/uhk60/main.c
    )
else()
    target_sources(app PRIVATE
        src/main.c
    )
endif()
```

## Kconfig
```
# custom Kconfig defaults are set per board here,
# as the board-specific Kconfig files are used for mcuboot build as well
rsource "../right/Kconfig.device"

config UHK_BATTERY_DEVICE
    bool
    default y if BOARD_UHK_80_LEFT || BOARD_UHK_80_RIGHT
    default n
    imply ADC

config UHK_USB_LEFT_RELAY
    bool "Experimental wired USB Left host relay"
    depends on BOARD_UHK_80_LEFT || BOARD_UHK_80_RIGHT
    default n
    help
      Connect a second USB computer to the left half and relay input over the
      inter-half cable. Both halves must run compatible relay firmware.

config UHK_USB_LEFT_DEV_SLOT
    bool "Provision a volatile USB Left host slot for development"
    depends on UHK_USB_LEFT_RELAY && BOARD_UHK_80_RIGHT
    default n
    help
      Add a USB_Left_Dev slot in RAM after loading configuration, without
      changing saved configuration or occupying a reserved/paired slot.

# copy over the USB properties to BT
configdefault BT_DIS_MANUF
    default USB_DEVICE_MANUFACTURER
configdefault BT_DIS_MODEL
    default "UHK 80 Right" if BOARD_UHK_80_RIGHT
    default USB_DEVICE_PRODUCT
configdefault BT_DIS_PNP
    default y
configdefault BT_DIS_PNP_VID_SRC
    default 2
configdefault BT_DIS_PNP_VID
    default USB_DEVICE_VID
configdefault BT_DIS_PNP_VER
    default USB_DEVICE_PRODUCT_VERSION

# CONFIG_NCS_SAMPLES_DEFAULTS:
configdefault LOG_DEFAULT_MINIMAL
    default y

# configdefaults must come before sourcing "Kconfig.zephyr" in order to give precedence
# to these application-specific defaults instead of the unconditional default in the Zephyr Kconfig tree.
# https://github.com/nrfconnect/sdk-nrf/blob/4b9841a28e97e9d61b93f8981375d644b9d04ea0/samples/bluetooth/mesh/light/Kconfig#L11C1-L13C30
source "Kconfig.zephyr"
```

## sysbuild.conf
```
SB_CONFIG_BOOTLOADER_MCUBOOT=y
SB_CONFIG_PARTITION_MANAGER=n
SB_CONFIG_MERGED_HEX_FILES=y
SB_CONFIG_MCUBOOT_MODE_SINGLE_APP=y
SB_CONFIG_MCUBOOT_APP_SYNC_UPDATEABLE_IMAGES=n
```

## prj.conf
```kconfig
# settings only for debug build
# for build independent settings use extra-conf/<featureset>.conf
# for board-specific settings use ../boards/<vendor>/<target>/<target>_defconfig
# for board AND build type specific settings use boards/<vendor>/<target>_<build>.conf
CONFIG_USE_SEGGER_RTT=y
CONFIG_RTT_CONSOLE=y
CONFIG_SHELL_BACKEND_RTT=y
# CONFIG_LOG_BACKEND_RTT=y

CONFIG_DEBUG_THREAD_INFO=y
CONFIG_DEBUG=y
CONFIG_C2USB_UDC_MAC_LOG_LEVEL_DBG=y
#CONFIG_UDC_BUF_POOL_SIZE=2048

CONFIG_ASSERT=y
CONFIG_ASSERT_NO_COND_INFO=y
CONFIG_ASSERT_NO_MSG_INFO=y
# re-enable these behaviors that change their default in debug builds?
CONFIG_REBOOT=y
```

## mcuboot.conf
```kconfig
CONFIG_PINCTRL=y
CONFIG_PM_PARTITION_SIZE_MCUBOOT=0x10000
CONFIG_LOG=y
CONFIG_SIZE_OPTIMIZATIONS=y
CONFIG_SERIAL=y
CONFIG_UART_LINE_CTRL=y
CONFIG_MCUBOOT_SERIAL=y
CONFIG_BOOT_SERIAL_CDC_ACM=y
CONFIG_BOOT_SERIAL_PIN_RESET=y
CONFIG_BOOT_SERIAL_WAIT_FOR_DFU=y
CONFIG_BOOT_SERIAL_WAIT_FOR_DFU_TIMEOUT=3000
CONFIG_BOOT_SERIAL_NO_APPLICATION=y
CONFIG_LOG_BACKEND_UART=y
CONFIG_LOG_BACKEND_RTT=n
```

## prj_release.conf
```kconfig
# settings only for release build
CONFIG_USE_SEGGER_RTT=y
CONFIG_RTT_CONSOLE=y
CONFIG_SHELL_BACKEND_RTT=y
# CONFIG_LOG_BACKEND_RTT=y
CONFIG_ASSERT=n
```

## src/main.c
```c
#include "main.h"
#include "bt_advertise.h"
#include "logger.h"
#include "messenger_queue.h"
#include "nus_client.h"
#include "nus_server.h"
#include "bt_manager.h"
#include "config_parser/config_globals.h"
#include "ledmap.h"
#include "pin_wiring.h"
#include "round_trip_test.h"
#include "shared/attributes.h"
#include "zephyr/kernel.h"
#include "zephyr/storage/flash_map.h"
#include "keyboard/key_scanner.h"
#include "keyboard/leds.h"
#include "keyboard/oled/oled.h"
#include "keyboard/charger.h"
#include "keyboard/spi.h"
#include "keyboard/uart_bridge.h"
#include "keyboard/i2c.h"
#include "peripherals/merge_sensor.h"
#include "shell.h"
#include "shell/shell_transport_uhk.h"
#include "shell/shell_uhk.h"
#include "device.h"
#include "hid/transport.h"
#include "bt_conn.h"
#include "settings.h"
#include "flash.h"
#include "usb_commands/usb_command_apply_config.h"
#include "macros/shortcut_parser.h"
#include "macros/keyid_parser.h"
#include "macros/core.h"
#include "timer.h"
#include "user_logic.h"
#include "config_manager.h"
#include "messenger.h"
#include "led_manager.h"
#include "debug.h"
#include "state_sync.h"
#include "keyboard/charger.h"
#include <stdint.h>
#include "dongle_leds.h"
#include "debug_eventloop_timing.h"
#include <zephyr/drivers/gpio.h>
#include "dongle_leds.h"
#include "usb_protocol_handler.h"
#include "trace.h"
#include "macros/vars.h"
#include "thread_stats.h"
#include "power_mode.h"
#include "mouse_controller.h"
#include "test_suite/test_suite.h"
#include "wormhole.h"
#include "power_mode.h"
#include "logger_priority.h"
#include "keyboard/uart_modules.h"

k_tid_t Main_ThreadId = 0;

static void sleepTillNextMs() {
    static uint64_t wakeupTimeUs = 0;
    const uint64_t minSleepTime = 100;
    uint64_t currentTimeUs = k_cyc_to_us_near64(k_cycle_get_32());

    wakeupTimeUs = MIN(currentTimeUs,wakeupTimeUs)+1000;

    if (currentTimeUs < wakeupTimeUs) {
        uint64_t timeToSleep = MAX(wakeupTimeUs-currentTimeUs, minSleepTime);
        k_usleep(timeToSleep);
    } else {
        k_usleep(minSleepTime);
        wakeupTimeUs = currentTimeUs;
    }
}


static K_SEM_DEFINE(mainWakeupSemaphore, 1, 1);

static void scheduleNextRun() {
    uint32_t nextEventTime = 0;
    bool eventIsValid = false;
    if (EventScheduler_Vector & EventVector_EventScheduler) {
        Trace_Printc("d6");
        nextEventTime = EventScheduler_Process();
        Trace_Printc("d7");
        eventIsValid = true;
    }
    int32_t diff = nextEventTime - Timer_GetCurrentTime();

    Trace(')');

    k_sem_take(&mainWakeupSemaphore, K_NO_WAIT);
    bool haveMoreWork = (EventScheduler_Vector & EventVector_UserLogicUpdateMask);
    if (haveMoreWork) {
        LOG_SCHEDULE( EventVector_ReportMask("Continuing immediately because of: ", EventScheduler_Vector & EventVector_UserLogicUpdateMask););
        EVENTLOOP_TIMING(printk("Continuing immediately\n"));
        // Mouse keys don't like being called twice in one second for some reason
        k_sem_give(&mainWakeupSemaphore);
        sleepTillNextMs();
        Trace('(');
        return;
    } else if (eventIsValid) {
        EVENTLOOP_TIMING(printk("Sleeping for %d\n", diff));
        k_sem_take(&mainWakeupSemaphore, K_MSEC(diff));
        // k_sleep(K_MSEC(diff));
    } else {
        EVENTLOOP_TIMING(printk("Sleeping forever\n"));
        k_sem_take(&mainWakeupSemaphore, K_FOREVER);
        // k_sleep(K_FOREVER);
    }
    Trace('(');
}

//TODO: inline this
void Main_Wake() {
    k_sem_give(&mainWakeupSemaphore);
    // k_wakeup(Main_ThreadId);
}

static void detectSpinningEventLoop() {
    if (!Cfg.DevMode) {
        return;
    }

    const uint16_t maxEventsPerSecond = 300; //allow 5ms macro wait loops
    static uint32_t thisCheckTime = 0;
    static uint16_t eventCount = 0;
    static uint16_t spinPeriods = 0;

    if (thisCheckTime == Timer_GetCurrentTime() / 1024) {
        bool isMouseEvent = EventScheduler_Vector & (EventVector_MouseKeys | EventVector_MouseController | EventVector_SendUsbReports | EventVector_MacroEngine);
        if (!DEVICE_IS_UHK80_RIGHT || !isMouseEvent) {
            eventCount++;
        }
    } else {
        if (eventCount > maxEventsPerSecond) {
            spinPeriods++;
            if (spinPeriods > 30) {
#ifdef __ZEPHYR__
                device_id_t target = DeviceId_Uhk80_Right;
#else
                device_id_t target = DEVICE_ID;
#endif
                LogTo(target, LogTarget_Uart | LogTarget_ErrorBuffer, "Looks like the event loop is spinning quite a lot: %u events in the last second.\n", eventCount);
                LogTo(target, LogTarget_Uart | LogTarget_ErrorBuffer, "EV: 0x%x\n", StateWormhole.traceBuffer.eventVector);
                spinPeriods = 0;
            }
        } else {
            spinPeriods = 0;
        }
        thisCheckTime = Timer_GetCurrentTime() / 1024;
        eventCount = 0;
    }
}

void mainRuntime(void) {
    Main_ThreadId = k_current_get();
    printk("----------\n" DEVICE_NAME " started\n");

    // NEW measured with disconnected usb, over battery lines powered by the ppk on 4000mV
    // NEW - absolute floor is 0.2mA - measured with an empty firmware. The 0.6 mA is probably caused by uart shell
    // NEW - 0.84mA / 1.2mA
    // NEW (uninitializing uart doesn't seem to have further effect)

    {
        flash_area_open(FIXED_PARTITION_ID(hardware_config_partition), &hardwareConfigArea);
        flash_area_open(FIXED_PARTITION_ID(user_config_partition), &userConfigArea);
    }

    // 0.83mA

    if (!DEVICE_IS_UHK_DONGLE) {

        InitSpi();

        InitLeds();

        // 0.68mA
        // why the drop? Something is enabled in the devicetree by default?

#if DEVICE_HAS_OLED
        InitOled();
#endif // DEVICE_HAS_OLED

        // 0.68mA

#if DEVICE_HAS_MERGE_SENSOR
        MergeSensor_Init();
#endif // DEVICE_HAS_MERGE_SENSOR

        InitKeyScanner(); // +300 uA @ 1ms; +63 @ 5ms; Continue measuring with 5ms interval

        // 0.75mA
    }

#if DEVICE_IS_UHK80_RIGHT
    HOGP_Register(); // must be before bt_enable() registers static GATT services
#endif

    bt_enable(NULL); // has to be before InitSettings

    // 0.75mA

    // has to be after bt_enable; has to be before ApplyConfig
    InitSettings();

    // needs to be after InitSettings
    if (DEVICE_IS_UHK80_RIGHT) {
        PinWiring_UninitShell();
        PinWiring_Suspend();

        PinWiring_SelectRouting();
        PinWiring_ConfigureRouting();

        PinWiring_Resume();

        ShellUartTransport_Reinit();
    }

    // Needs to be after ShellUartTransport_Reinit, probably
    InitShellCommands();
    Shell_WaitUntilInitialized();
    InitLogLevels();
    Logger_SetPriority(true);

    // 0.75mA

    // read configurations
    {
        InitFlash();
        printk("Reading hardware config\n");
        Flash_ReadAreaSync(hardwareConfigArea, 0, HardwareConfigBuffer.buffer, HARDWARE_CONFIG_SIZE);
        USB_SetSerialNumber(HardwareConfig->uniqueId);

        if (DEVICE_IS_UHK80_LEFT || DEVICE_IS_UHK80_RIGHT) {
            Ledmap_InitLedLayout(); // has to be after hwconfig read
        }

        if (DEVICE_IS_UHK80_RIGHT) {
            printk("Reading user config\n");
            Flash_ReadAreaSync(userConfigArea, 0, StagingUserConfigBuffer.buffer, USER_CONFIG_SIZE);
            printk("Applying user config\n");
            bool factoryMode = false;
            if (factoryMode || UsbCommand_ValidateAndApplyConfigSync(NULL, NULL) != UsbStatusCode_Success) {
                UsbCommand_ApplyFactory(NULL, NULL);
            }
            printk("User config applied\n");
            ShortcutParser_initialize();
            KeyIdParser_initialize();
            Macros_Initialize();
        } else {
            UsbCommand_ApplyFactory(NULL, NULL);
        }
    }

    // 0.75mA

    USB_Enable();

    // 0.75mA

    if (LastRunWasCrash) {
        printk("CRASH DETECTED, waiting for 5 seconds to allow Agent to reenumerate\n");
        k_sleep(K_MSEC(5*1000));
    }

    // Uart has to be enabled only after we have given Agent a chance to reenumarate into bootloader after a crash
    if (!DEVICE_IS_UHK_DONGLE) {
        InitUartModules(); // +0.0mA - not active in i2c setup
        InitUartBridge(); // +0.09mA (when bridge cable connected; 0 when not)
        InitZephyrI2c(); // +0.03mA (when module not connected; irrelevant when active, as it consumes much more)
    }

    // 0.83mA

    // Uart has to be enabled only after we have given Agent a chance to reenumarate into bootloader after a crash
    // has to be after InitSettings
    BtManager_InitBt();
    BtManager_StartBt();

    if (!DEVICE_IS_UHK_DONGLE) {
        InitCharger(); // has to be after usb initialization
    }

    EventVector_Init();

    Messenger_Init();

    StateSync_Init();

    RoundTripTest_Init();

    TestSuite_Init();

    // Call after all threads have been created
    ThreadStats_Init();

    InitLogLevels();
    Logger_SetPriority(false);

#if DEVICE_IS_UHK80_RIGHT
    while (true)
    {
        Trace_Printc("d1");
        Messenger_ProcessQueue();
        Trace_Printc("d2");
        if (EventScheduler_Vector & EventVector_UserLogicUpdateMask) {
            EVENTLOOP_TIMING(EventloopTiming_Start());
            RunUserLogic();
            EVENTLOOP_TIMING(EventloopTiming_End());
        }
        Trace_Printc("d3");
        scheduleNextRun();
        Trace_Printc("d4");
        detectSpinningEventLoop();
        Trace_Printc("d5");
        UserLogic_LastEventloopTime = Timer_GetCurrentTime();
    }
#elif DEVICE_IS_UHK_DONGLE
    while (true)
    {
        Messenger_ProcessQueue();
        RunDongleLogic();
        scheduleNextRun();
        detectSpinningEventLoop();
    }
#else
    while (true)
    {
        Messenger_ProcessQueue();
        RunUhk80LeftHalfLogic();
        scheduleNextRun();
        detectSpinningEventLoop();
    }
#endif
}

int main(void) {
    Trace_Init();
    if (StateWormhole_IsOpen()) {
        printk("Wormhole is open\n");
        if (WormCfg->devMode || StateWormhole.persistStatusBuffer) {
            MacroStatusBuffer_InitFromWormhole();
        } else {
            MacroStatusBuffer_InitNormal();
        }
        StateWormhole_Clean();
    } else {
        printk("Wormhole is closed\n");
        MacroStatusBuffer_InitNormal();
        ConfigManager_ResetWormConfiguration();
        StateWormhole_Clean();
        StateWormhole_Open();
    }

    mainRuntime();
}
```

## src/bluetooth.c
```c
#include <zephyr/kernel.h>
#include <zephyr/device.h>
#include <zephyr/drivers/gpio.h>

#include <zephyr/usb/class/usb_hid.h>

#include <zephyr/types.h>
#include <stddef.h>
#include <string.h>
#include <errno.h>
#include <zephyr/sys/printk.h>
#include <zephyr/sys/byteorder.h>
#include <soc.h>
#include <assert.h>
#include <zephyr/spinlock.h>

#include <zephyr/settings/settings.h>

#include <zephyr/bluetooth/bluetooth.h>
#include <zephyr/bluetooth/hci.h>
#include <zephyr/bluetooth/conn.h>
#include <zephyr/bluetooth/uuid.h>
#include <zephyr/bluetooth/gatt.h>

#include <zephyr/bluetooth/services/bas.h>
#include <bluetooth/services/hids.h>
#include <zephyr/bluetooth/services/dis.h>
#include <dk_buttons_and_leds.h>

#define DEVICE_NAME     CONFIG_BT_DEVICE_NAME
#define DEVICE_NAME_LEN (sizeof(DEVICE_NAME) - 1)

#define BASE_USB_HID_SPEC_VERSION   0x0101

#define OUTPUT_REPORT_MAX_LEN            1
#define OUTPUT_REPORT_BIT_MASK_CAPS_LOCK 0x02
#define INPUT_REP_KEYS_REF_ID            1
#define OUTPUT_REP_KEYS_REF_ID           1
#define SCAN_CODE_POS                    2
#define KEYS_MAX_LEN                    (INPUT_REPORT_KEYS_MAX_LEN - SCAN_CODE_POS)

static const struct bt_data ad[] = {
    BT_DATA_BYTES(BT_DATA_GAP_APPEARANCE,
              (CONFIG_BT_DEVICE_APPEARANCE >> 0) & 0xff,
              (CONFIG_BT_DEVICE_APPEARANCE >> 8) & 0xff),
    BT_DATA_BYTES(BT_DATA_FLAGS, (BT_LE_AD_GENERAL | BT_LE_AD_NO_BREDR)),
    BT_DATA_BYTES(BT_DATA_UUID16_ALL, BT_UUID_16_ENCODE(BT_UUID_HIDS_VAL),
                      BT_UUID_16_ENCODE(BT_UUID_BAS_VAL)),
};

static const struct bt_data sd[] = {
    BT_DATA(BT_DATA_NAME_COMPLETE, DEVICE_NAME, DEVICE_NAME_LEN),
};

static struct {
    struct bt_conn *conn;
    bool in_boot_mode;
} conn_mode;

struct {
    struct bt_conn *conn;
    unsigned int passkey;
} pairing_data;

static void advertising_start(void) {
    struct bt_le_adv_param *adv_param = BT_LE_ADV_PARAM(
                        BT_LE_ADV_OPT_CONNECTABLE | BT_LE_ADV_OPT_ONE_TIME,
                        BT_GAP_ADV_FAST_INT_MIN_2,
                        BT_GAP_ADV_FAST_INT_MAX_2,
                        NULL);

    int err = bt_le_adv_start(adv_param, ad, ARRAY_SIZE(ad), sd, ARRAY_SIZE(sd));
    if (err) {
        if (err == -EALREADY) {
            printk("Advertising continued\n");
        } else {
            printk("Advertising failed to start (err %d)\n", err);
        }

        return;
    }

    printk("Advertising successfully started\n");
}

static void pairing_process() {
    if (!pairing_data.conn) {
        return;
    }

    char addr[BT_ADDR_LE_STR_LEN];
    bt_addr_le_to_str(bt_conn_get_dst(pairing_data.conn), addr, sizeof(addr));
    printk("Passkey for %s: %06u\n", addr, pairing_data.passkey);
    printk("type `uhk btacc 1/0` to accept/reject.\n");
}

// HID init

static void caps_lock_handler(const struct bt_hids_rep *rep) {
    uint8_t report_val = ((*rep->data) & OUTPUT_REPORT_BIT_MASK_CAPS_LOCK) ? 1 : 0;
    printk("Bluetooth Caps lock set to %u\n", report_val);
}

static void hids_outp_rep_handler(struct bt_hids_rep *rep, struct bt_conn *conn, bool write) {
    char addr[BT_ADDR_LE_STR_LEN];

    if (!write) {
        printk("Output report read\n");
        return;
    };

    bt_addr_le_to_str(bt_conn_get_dst(conn), addr, sizeof(addr));
    printk("Output report has been received %s\n", addr);
    caps_lock_handler(rep);
}

static void hids_boot_kb_outp_rep_handler(struct bt_hids_rep *rep, struct bt_conn *conn, bool write) {
    char addr[BT_ADDR_LE_STR_LEN];

    if (!write) {
        printk("Output report read\n");
        return;
    };

    bt_addr_le_to_str(bt_conn_get_dst(conn), addr, sizeof(addr));
    printk("Boot Keyboard Output report has been received %s\n", addr);
    caps_lock_handler(rep);
}

static void hids_pm_evt_handler(enum bt_hids_pm_evt evt, struct bt_conn *conn) {
    char addr[BT_ADDR_LE_STR_LEN];

    if (conn_mode.conn != conn) {
        printk("Cannot find connection handle when processing PM");
        return;
    }

    bt_addr_le_to_str(bt_conn_get_dst(conn), addr, sizeof(addr));

    switch (evt) {
    case BT_HIDS_PM_EVT_BOOT_MODE_ENTERED:
        printk("Boot mode entered %s\n", addr);
        conn_mode.in_boot_mode = true;
        break;
    case BT_HIDS_PM_EVT_REPORT_MODE_ENTERED:
        printk("Report mode entered %s\n", addr);
        conn_mode.in_boot_mode = false;
        break;
    default:
        break;
    }
}

// Bluetooth keyboard

// Note: The configuration below is the same as BOOT mode configuration
// This simplifies the code as the BOOT mode is the same as REPORT mode.
// Changing this configuration would require separate implementation of
// BOOT mode report generation.
#define KEY_PRESS_MAX 6 // Maximum number of non-control keys pressed simultaneously

// Number of bytes in key report
//
// 1 byte: modifier keys
// 1 byte: reserved
// rest: non-control keys
#define INPUT_REPORT_KEYS_MAX_LEN (1 + 1 + KEY_PRESS_MAX)

// INPUT report internal indexes.
// This is a position in internal report table and is not related to report ID.
enum {
    INPUT_REP_KEYS_IDX = 0
};

BT_HIDS_DEF(hids_keyboard_obj,
        OUTPUT_REPORT_MAX_LEN,
        INPUT_REPORT_KEYS_MAX_LEN);

static void hid_keyboard_init(void) {
    static const uint8_t report_map[] = {
        0x05, 0x01,       // Usage Page (Generic Desktop)
        0x09, 0x06,       // Usage (Keyboard)
        0xA1, 0x01,       // Collection (Application)

        // Keys
#if INPUT_REP_KEYS_REF_ID
        0x85, INPUT_REP_KEYS_REF_ID,
#endif
        0x05, 0x07,       // Usage Page (Key Codes)
        0x19, 0xe0,       // Usage Minimum (224)
        0x29, 0xe7,       // Usage Maximum (231)
        0x15, 0x00,       // Logical Minimum (0)
        0x25, 0x01,       // Logical Maximum (1)
        0x75, 0x01,       // Report Size (1)
        0x95, 0x08,       // Report Count (8)
        0x81, 0x02,       // Input (Data, Variable, Absolute)

        0x95, 0x01,       // Report Count (1)
        0x75, 0x08,       // Report Size (8)
        0x81, 0x01,       // Input (Constant) reserved byte(1)

        0x95, 0x06,       // Report Count (6)
        0x75, 0x08,       // Report Size (8)
        0x15, 0x00,       // Logical Minimum (0)
        0x25, 0x65,       // Logical Maximum (101)
        0x05, 0x07,       // Usage Page (Key codes)
        0x19, 0x00,       // Usage Minimum (0)
        0x29, 0x65,       // Usage Maximum (101)
        0x81, 0x00,       // Input (Data, Array) Key array(6 bytes)

        // LED
#if OUTPUT_REP_KEYS_REF_ID
        0x85, OUTPUT_REP_KEYS_REF_ID,
#endif
        0x95, 0x05,       // Report Count (5)
        0x75, 0x01,       // Report Size (1)
        0x05, 0x08,       // Usage Page (Page# for LEDs)
        0x19, 0x01,       // Usage Minimum (1)
        0x29, 0x05,       // Usage Maximum (5)
        0x91, 0x02,       // Output (Data, Variable, Absolute),
        // Led report
        0x95, 0x01,       // Report Count (1)
        0x75, 0x03,       // Report Size (3)
        0x91, 0x01,       // Output (Data, Variable, Absolute),
        // Led report padding

        0xC0              // End Collection (Application)
    };

    struct bt_hids_init_param hids_init_obj = {
        .rep_map.data = report_map,
        .rep_map.size = sizeof(report_map),
        .info = {
            .bcd_hid = BASE_USB_HID_SPEC_VERSION,
            .b_country_code = 0x00,
            .flags = BT_HIDS_REMOTE_WAKE | BT_HIDS_NORMALLY_CONNECTABLE,
        },
        .inp_rep_group_init = {
            .reports = {
                {
                    .size = INPUT_REPORT_KEYS_MAX_LEN,
                    .id = INPUT_REP_KEYS_REF_ID,
                }
            },
            .cnt = 1,
        },
        .outp_rep_group_init = {
            .reports = {
                {
                    .size = OUTPUT_REPORT_MAX_LEN,
                    .id = OUTPUT_REP_KEYS_REF_ID,
                    .handler = hids_outp_rep_handler,
                }
            },
            .cnt =  1,
        },
        .is_kb = true,
        .boot_kb_outp_rep_handler = hids_boot_kb_outp_rep_handler,
        .pm_evt_handler = hids_pm_evt_handler,
    };

    int err = bt_hids_init(&hids_keyboard_obj, &hids_init_obj);
    __ASSERT(err == 0, "HIDS keyboard initialization failed\n");
}

// Bluetooth mouse

// Length of Mouse Input Report containing button data.
#define INPUT_REP_BUTTONS_LEN       3
// Length of Mouse Input Report containing movement data.
#define INPUT_REP_MOVEMENT_LEN      3
// Length of Mouse Input Report containing media player data.
#define INPUT_REP_MEDIA_PLAYER_LEN  1
// Index of Mouse Input Report containing movement data.
#define INPUT_REP_MOVEMENT_INDEX    1
// Id of reference to Mouse Input Report containing button data.
#define INPUT_REP_REF_BUTTONS_ID    1
// Id of reference to Mouse Input Report containing movement data.
#define INPUT_REP_REF_MOVEMENT_ID   2
// Id of reference to Mouse Input Report containing media player data.
#define INPUT_REP_REF_MPLAYER_ID    3

BT_HIDS_DEF(hids_mouse_obj,
        INPUT_REP_BUTTONS_LEN,
        INPUT_REP_MOVEMENT_LEN,
        INPUT_REP_MEDIA_PLAYER_LEN);

static void hid_mouse_init(void)
{
    static const uint8_t report_map[] = {
        0x05, 0x01,     // Usage Page (Generic Desktop)
        0x09, 0x02,     // Usage (Mouse)

        0xA1, 0x01,     // Collection (Application)

        // Report ID 1: Mouse buttons + scroll/pan
        0x85, 0x01,       // Report Id 1
        0x09, 0x01,       // Usage (Pointer)
        0xA1, 0x00,       // Collection (Physical)
        0x95, 0x05,       // Report Count (3)
        0x75, 0x01,       // Report Size (1)
        0x05, 0x09,       // Usage Page (Buttons)
        0x19, 0x01,       // Usage Minimum (01)
        0x29, 0x05,       // Usage Maximum (05)
        0x15, 0x00,       // Logical Minimum (0)
        0x25, 0x01,       // Logical Maximum (1)
        0x81, 0x02,       // Input (Data, Variable, Absolute)
        0x95, 0x01,       // Report Count (1)
        0x75, 0x03,       // Report Size (3)
        0x81, 0x01,       // Input (Constant) for padding
        0x75, 0x08,       // Report Size (8)
        0x95, 0x01,       // Report Count (1)
        0x05, 0x01,       // Usage Page (Generic Desktop)
        0x09, 0x38,       // Usage (Wheel)
        0x15, 0x81,       // Logical Minimum (-127)
        0x25, 0x7F,       // Logical Maximum (127)
        0x81, 0x06,       // Input (Data, Variable, Relative)
        0x05, 0x0C,       // Usage Page (Consumer)
        0x0A, 0x38, 0x02, // Usage (AC Pan)
        0x95, 0x01,       // Report Count (1)
        0x81, 0x06,       // Input (Data,Value,Relative,Bit Field)
        0xC0,             // End Collection (Physical)

        // Report ID 2: Mouse motion
        0x85, 0x02,       // Report Id 2
        0x09, 0x01,       // Usage (Pointer)
        0xA1, 0x00,       // Collection (Physical)
        0x75, 0x0C,       // Report Size (12)
        0x95, 0x02,       // Report Count (2)
        0x05, 0x01,       // Usage Page (Generic Desktop)
        0x09, 0x30,       // Usage (X)
        0x09, 0x31,       // Usage (Y)
        0x16, 0x01, 0xF8, // Logical maximum (2047)
        0x26, 0xFF, 0x07, // Logical minimum (-2047)
        0x81, 0x06,       // Input (Data, Variable, Relative)
        0xC0,             // End Collection (Physical)
        0xC0,             // End Collection (Application)

        // Report ID 3: Advanced buttons
        0x05, 0x0C,       // Usage Page (Consumer)
        0x09, 0x01,       // Usage (Consumer Control)
        0xA1, 0x01,       // Collection (Application)
        0x85, 0x03,       // Report Id (3)
        0x15, 0x00,       // Logical minimum (0)
        0x25, 0x01,       // Logical maximum (1)
        0x75, 0x01,       // Report Size (1)
        0x95, 0x01,       // Report Count (1)

        0x09, 0xCD,       // Usage (Play/Pause)
        0x81, 0x06,       // Input (Data,Value,Relative,Bit Field)
        0x0A, 0x83, 0x01, // Usage (Consumer Control Configuration)
        0x81, 0x06,       // Input (Data,Value,Relative,Bit Field)
        0x09, 0xB5,       // Usage (Scan Next Track)
        0x81, 0x06,       // Input (Data,Value,Relative,Bit Field)
        0x09, 0xB6,       // Usage (Scan Previous Track)
        0x81, 0x06,       // Input (Data,Value,Relative,Bit Field)

        0x09, 0xEA,       // Usage (Volume Down)
        0x81, 0x06,       // Input (Data,Value,Relative,Bit Field)
        0x09, 0xE9,       // Usage (Volume Up)
        0x81, 0x06,       // Input (Data,Value,Relative,Bit Field)
        0x0A, 0x25, 0x02, // Usage (AC Forward)
        0x81, 0x06,       // Input (Data,Value,Relative,Bit Field)
        0x0A, 0x24, 0x02, // Usage (AC Back)
        0x81, 0x06,       // Input (Data,Value,Relative,Bit Field)
        0xC0              // End Collection
    };

    static const uint8_t mouse_movement_mask[ceiling_fraction(INPUT_REP_MOVEMENT_LEN, 8)] = {0};

    struct bt_hids_init_param hids_init_param = {
        .rep_map = {
            .data = report_map,
            .size = sizeof(report_map),
        },
        .info = {
            .bcd_hid = BASE_USB_HID_SPEC_VERSION,
            .b_country_code = 0x00,
            .flags = BT_HIDS_REMOTE_WAKE | BT_HIDS_NORMALLY_CONNECTABLE,
        },
        .inp_rep_group_init = {
            .reports = {
                {
                    .size = INPUT_REP_BUTTONS_LEN,
                    .id = INPUT_REP_REF_BUTTONS_ID,
                },
                {
                    .size = INPUT_REP_MOVEMENT_LEN,
                    .id = INPUT_REP_REF_MOVEMENT_ID,
                    .rep_mask = mouse_movement_mask,
                },
                {
                    .size = INPUT_REP_MEDIA_PLAYER_LEN,
                    .id = INPUT_REP_REF_MPLAYER_ID,
                },
            },
            .cnt = 3,
        },
        .is_mouse = true,
        .pm_evt_handler = hids_pm_evt_handler,
    };

    int err = bt_hids_init(&hids_mouse_obj, &hids_init_param);
    __ASSERT(err == 0, "HIDS mouse initialization failed\n");
}

// Connection callbacks

static void connected(struct bt_conn *conn, uint8_t err) {
    char addr[BT_ADDR_LE_STR_LEN];
    bt_addr_le_to_str(bt_conn_get_dst(conn), addr, sizeof(addr));

    if (err) {
        printk("Failed to connect to %s (%u)\n", addr, err);
        return;
    }

    printk("Connected %s\n", addr);
    // dk_set_led_on(CON_STATUS_LED);

    err = bt_hids_connected(&hids_keyboard_obj, conn);
    if (err) {
        printk("Failed to notify keyboard HID service about connection\n");
        return;
    }

    err = bt_hids_connected(&hids_mouse_obj, conn);
    if (err) {
        printk("Failed to notify mouse HID service about connection\n");
        return;
    }


    if (!conn_mode.conn) {
        conn_mode.conn = conn;
        conn_mode.in_boot_mode = false;
        advertising_start();
    }

    printk("Advertising stopped\n");
}

static void disconnected(struct bt_conn *conn, uint8_t reason) {
    char addr[BT_ADDR_LE_STR_LEN];
    bt_addr_le_to_str(bt_conn_get_dst(conn), addr, sizeof(addr));
    printk("Disconnected from %s (reason %u)\n", addr, reason);

    int err = bt_hids_disconnected(&hids_keyboard_obj, conn);
    if (err) {
        printk("Failed to notify keyboard HID service about disconnection\n");
    }

    err = bt_hids_disconnected(&hids_mouse_obj, conn);
    if (err) {
        printk("Failed to notify mouse HID service about disconnection\n");
    }

    conn_mode.conn = NULL;
    // dk_set_led_off(CON_STATUS_LED);
    advertising_start();
}

static void security_changed(struct bt_conn *conn, bt_security_t level, enum bt_security_err err) {
    char addr[BT_ADDR_LE_STR_LEN];
    bt_addr_le_to_str(bt_conn_get_dst(conn), addr, sizeof(addr));

    if (!err) {
        printk("Security changed: %s level %u\n", addr, level);
    } else {
        printk("Security failed: %s level %u err %d\n", addr, level, err);
    }
}

BT_CONN_CB_DEFINE(conn_callbacks) = {
    .connected = connected,
    .disconnected = disconnected,
    .security_changed = security_changed,
};

// Auth callbacks

static void auth_passkey_display(struct bt_conn *conn, unsigned int passkey) {
    char addr[BT_ADDR_LE_STR_LEN];
    bt_addr_le_to_str(bt_conn_get_dst(conn), addr, sizeof(addr));
    printk("Passkey for %s: %06u\n", addr, passkey);
}

static void auth_passkey_confirm(struct bt_conn *conn, unsigned int passkey) {
    pairing_data.conn    = bt_conn_ref(conn);
    pairing_data.passkey = passkey;
    pairing_process();
}

static void auth_cancel(struct bt_conn *conn) {
    char addr[BT_ADDR_LE_STR_LEN];
    bt_addr_le_to_str(bt_conn_get_dst(conn), addr, sizeof(addr));
    printk("Pairing cancelled: %s\n", addr);
}

static struct bt_conn_auth_cb conn_auth_callbacks = {
    .passkey_display = auth_passkey_display,
    .passkey_confirm = auth_passkey_confirm,
    .cancel = auth_cancel,
};

// Auth info callbacks

static void pairing_complete(struct bt_conn *conn, bool bonded) {
    char addr[BT_ADDR_LE_STR_LEN];
    bt_addr_le_to_str(bt_conn_get_dst(conn), addr, sizeof(addr));
    printk("Pairing completed: %s, bonded: %d\n", addr, bonded);
}

static void pairing_failed(struct bt_conn *conn, enum bt_security_err reason) {
    if (!pairing_data.conn) {
        return;
    }

    if (pairing_data.conn == conn) {
        bt_conn_unref(pairing_data.conn);
        pairing_data.conn = NULL;
    }

    char addr[BT_ADDR_LE_STR_LEN];
    bt_addr_le_to_str(bt_conn_get_dst(conn), addr, sizeof(addr));
    printk("Pairing failed conn: %s, reason %d\n", addr, reason);
}

static struct bt_conn_auth_info_cb conn_auth_info_callbacks = {
    .pairing_complete = pairing_complete,
    .pairing_failed = pairing_failed
};

void key_report_send(uint8_t down) {
    if (!conn_mode.conn) {
        return;
    }

    uint8_t chr = down ? HID_KEY_A : 0;
    uint8_t data[INPUT_REPORT_KEYS_MAX_LEN] = {0 /* modifiers */, 0, chr, 0, 0, 0, 0, 0};

    int keyboard_err = 0;
    int mouse_err = 0;
    if (conn_mode.in_boot_mode) {
        keyboard_err = bt_hids_boot_kb_inp_rep_send(&hids_keyboard_obj, conn_mode.conn, data, sizeof(data), NULL);
        // mouse_err = bt_hids_boot_mouse_inp_rep_send(&hids_mouse_obj, conn_mode.conn, NULL, 5, 0, NULL);
    } else {
        uint8_t buffer[INPUT_REP_MOVEMENT_LEN] = {0, 0, 5};
        keyboard_err = bt_hids_inp_rep_send(&hids_keyboard_obj, conn_mode.conn, INPUT_REP_KEYS_IDX, data, sizeof(data), NULL);
        // mouse_err = bt_hids_inp_rep_send(&hids_mouse_obj, conn_mode.conn, INPUT_REP_MOVEMENT_INDEX, buffer, sizeof(buffer), NULL);
    }

    if (keyboard_err) {
        printk("Key report send error: %d\n", keyboard_err);
    }
    // if (mouse_err) {
    //     printk("Mouse report send error: %d\n", mouse_err);
    // }
}

void num_comp_reply(uint8_t accept) {
    struct bt_conn *conn;

    if (!pairing_data.conn) {
        return;
    }

    conn = pairing_data.conn;

    if (accept) {
        bt_conn_auth_passkey_confirm(conn);
        printk("Numeric Match, conn %p\n", conn);
    } else {
        bt_conn_auth_cancel(conn);
        printk("Numeric Reject, conn %p\n", conn);
    }

    bt_conn_unref(pairing_data.conn);
    pairing_data.conn = NULL;
}

void bas_notify(void) {
    uint8_t battery_level = bt_bas_get_battery_level();

    battery_level--;

    if (!battery_level) {
        battery_level = 100U;
    }

    bt_bas_set_battery_level(battery_level);
}

void bluetooth_init() {
    printk("Starting Bluetooth Peripheral HIDS keyboard\n");

    bt_conn_auth_cb_register(&conn_auth_callbacks);
    bt_conn_auth_info_cb_register(&conn_auth_info_callbacks);
    bt_enable(NULL);

    printk("Bluetooth initialized\n");

    settings_load();
    // list the currently available bluetooth identities
    // bt_addr_le_t addr;
    // int res;
    // res = bt_addr_le_from_str("DE:AD:BE:AF:BA:11", "public", &addr); // why not public?
    // printk("bt_addr_le_from_str: %d\n", res);
    // res = bt_id_create(&addr, NULL);
    // printk("bt_id_create: %d\n", res);

    hid_keyboard_init();
    // hid_mouse_init();

    advertising_start();
}
```

## src/bt_advertise.c
```c
#include "bt_advertise.h"
#include <bluetooth/services/nus.h>
#include <zephyr/bluetooth/gatt.h>
#include "attributes.h"
#include "bt_conn.h"
#include "bt_pair.h"
#include "connections.h"
#include "debug.h"
#include "device.h"
#include "device_state.h"
#include "host_connection.h"
#include "keyboard/oled/widgets/widgets.h"
#include <zephyr/logging/log.h>
#include "config_manager.h"
#include "trace.h"
#include <zephyr/kernel.h>
#include "right/src/bt_defs.h"
#include "bt_health.h"

LOG_MODULE_DECLARE(Bt);

#define LEN(NAME) (sizeof(NAME) - 1)

bool BtAdvertise_IsAdvertising = false;

// Advertisement packets

#define AD_NUS_DATA(NAME)                                                                                \
    BT_DATA_BYTES(BT_DATA_FLAGS, (BT_LE_AD_GENERAL | BT_LE_AD_NO_BREDR)),                          \
        BT_DATA(BT_DATA_NAME_COMPLETE, NAME, LEN(NAME)),

#define AD_HID_DATA                                                                                \
    BT_DATA_BYTES(BT_DATA_GAP_APPEARANCE, (CONFIG_BT_DEVICE_APPEARANCE >> 0) & 0xff,               \
        (CONFIG_BT_DEVICE_APPEARANCE >> 8) & 0xff),                                                \
        BT_DATA_BYTES(BT_DATA_FLAGS, (BT_LE_AD_GENERAL | BT_LE_AD_NO_BREDR)),                      \
        BT_DATA_BYTES(BT_DATA_UUID16_ALL, BT_UUID_16_ENCODE(BT_UUID_HIDS_VAL),                     \
            BT_UUID_16_ENCODE(BT_UUID_BAS_VAL)),

ATTR_UNUSED static const struct bt_data adNusLeft[] = {AD_NUS_DATA("UHK 80 Left BLE")};
ATTR_UNUSED static const struct bt_data adNusRight[] = {AD_NUS_DATA("UHK 80 BLE")};
static const struct bt_data adHid[] = {AD_HID_DATA};

// Helpers

#define ADVERTISEMENT(TYPE) ((adv_config_t) { .advType = TYPE })
#define ADVERTISEMENT_DIRECT_NUS(ADDR) ((adv_config_t) { .advType = ADVERTISE_DIRECTED_NUS, .addr = ADDR })

// Scan response packets

#define SD_NUS_DATA BT_DATA_BYTES(BT_DATA_UUID128_ALL, BT_UUID_NUS_VAL),

#define SD_HID_DATA(NAME) BT_DATA(BT_DATA_NAME_COMPLETE, NAME, LEN(NAME)),

static const struct bt_data sdNus[] = {SD_NUS_DATA};
static const struct bt_data sdHid[] = {SD_HID_DATA("UHK 80 BLE")};

#if DEVICE_IS_UHK80_RIGHT
#define BY_SIDE(LEFT, RIGHT) RIGHT
#else
#define BY_SIDE(LEFT, RIGHT) LEFT
#endif

// Fast advertisement makes mouse key movement jittery as it makes us miss transports
static void applyAdvInterval(struct bt_le_adv_param* param) {
    bool fast = BtConn_UnusedPeripheralConnectionCount() == ACTUAL_PERIPHERAL_CONNECTION_COUNT || Connections_IsSelectedConnecting() || !DEVICE_IS_UHK80_RIGHT;
    if (fast) {
        param->interval_min = BT_GAP_ADV_FAST_INT_MIN_1;
        param->interval_max = BT_GAP_ADV_FAST_INT_MAX_1;
    } else {
        param->interval_min = BT_GAP_ADV_SLOW_INT_MIN;
        param->interval_max = BT_GAP_ADV_SLOW_INT_MAX;
    }
}

#define BT_LE_ADV_START(PARAM, AD, SD) bt_le_adv_start(PARAM, AD, ARRAY_SIZE(AD), SD, ARRAY_SIZE(SD));

static const char * advertisingString(uint8_t advType) {
    switch (advType) {
        case ADVERTISE_NUS:
            return "NUS";
        case ADVERTISE_HID:
            return "HID";
        case ADVERTISE_NUS | ADVERTISE_HID:
            return "HID \"and NUS\"";
        case ADVERTISE_DIRECTED_NUS:
            return "Directed NUS";
        default:
            return "None";
    }
}

ATTR_UNUSED static void setFilters(adv_config_t advConfig) {
    bt_le_filter_accept_list_clear();

    if (advConfig.advType & (ADVERTISE_HID | ADVERTISE_NUS)) {
        LOG_DBG("Bt: filling adv allow filter");
        for (uint8_t connId = ConnectionId_HostConnectionFirst; connId <= ConnectionId_HostConnectionLast; connId++) {
            host_connection_t* hostConnection = HostConnection(connId);

            if (!hostConnection) {
                continue;
            }

            if (advConfig.advType & ADVERTISE_HID && (hostConnection->type == HostConnectionType_BtHid || hostConnection->type == HostConnectionType_NewBtHid)) {
                bt_le_filter_accept_list_add(&hostConnection->bleAddress);
            }
            if (advConfig.advType & ADVERTISE_NUS && hostConnection->type == HostConnectionType_Dongle) {
                bt_le_filter_accept_list_add(&hostConnection->bleAddress);
            }
        }
    }

    if (advConfig.advType & ADVERTISE_DIRECTED_NUS) {
        LOG_DBG("Bt: filling adv allow filter for \"directed\" advertising.");
        bt_le_filter_accept_list_add(advConfig.addr);
    }
}

static void updateAdvertisingIcon(bool newAdvertising) {
    if (DEVICE_ID == DeviceId_Uhk80_Right && BtAdvertise_IsAdvertising != newAdvertising) {
        BtAdvertise_IsAdvertising = newAdvertising;
#if DEVICE_HAS_OLED
        Widget_Refresh(&StatusWidget);
#endif
    }
}

void BtAdvertise_DisableAdvertisingIcon(void) {
    updateAdvertisingIcon(false);
}

uint8_t BtAdvertise_Start(adv_config_t advConfig)
{
    BT_TRACE_AND_ASSERT("ba1");
    int err = 0;

    if ( DEVICE_IS_UHK80_RIGHT && !DeviceState_IsTargetConnected(ConnectionTarget_Left) ) {
        // In this case, scanning is in progress, so we cannot use the allow list.
        advConfig = ADVERTISEMENT(ADVERTISE_NUS | ADVERTISE_HID);
    }

    ATTR_UNUSED const char * advTypeString = advertisingString(advConfig.advType);

    // to clear filters
    BtAdvertise_Stop();

    updateAdvertisingIcon(advConfig.advType != 0);

    // Start advertising
    static struct bt_le_adv_param advParam;
    switch (advConfig.advType) {
        case ADVERTISE_HID:
        case ADVERTISE_NUS | ADVERTISE_HID:
            LOG_DBG("Adv: advertise nus+hid.");
            /* our devices don't check service uuids, so hid advertisement effectively advertises nus too */
            advParam = *BT_LE_ADV_CONN_FAST_1;
            applyAdvInterval(&advParam);
            err = BT_LE_ADV_START(&advParam, adHid, sdHid);

            break;
        case ADVERTISE_NUS:
            if (Cfg.Bt_DirectedAdvertisingAllowed) {
                LOG_DBG("Adv: advertise nus, with allow list.");
                setFilters(advConfig);
                advParam = *BT_LE_ADV_CONN_FAST_1;
                advParam.options = BT_LE_ADV_OPT_CONN | BT_LE_ADV_OPT_FILTER_CONN | BT_LE_ADV_OPT_USE_IDENTITY;
                applyAdvInterval(&advParam);
                err = BT_LE_ADV_START(&advParam, BY_SIDE(adNusLeft, adNusRight), sdNus);
            } else {
                LOG_DBG("Adv: advertise nus, without allow list.");
                advParam = *BT_LE_ADV_CONN_FAST_1;
                applyAdvInterval(&advParam);
                err = BT_LE_ADV_START(&advParam, BY_SIDE(adNusLeft, adNusRight), sdNus);
            }
            break;
        case ADVERTISE_DIRECTED_NUS:
            if (Cfg.Bt_DirectedAdvertisingAllowed) {
                LOG_DBG("Adv: direct advertise nus, with allow list.");
                setFilters(advConfig);

                advParam = *BT_LE_ADV_CONN_FAST_1;
                advParam.options = BT_LE_ADV_OPT_CONN | BT_LE_ADV_OPT_FILTER_CONN | BT_LE_ADV_OPT_USE_IDENTITY;

                applyAdvInterval(&advParam);
                err = BT_LE_ADV_START(&advParam, BY_SIDE(adNusLeft, adNusRight), sdNus);
            } else {
                LOG_DBG("Adv: direct advertise nus, without allow list.");
                advParam = *BT_LE_ADV_CONN_FAST_1;
                applyAdvInterval(&advParam);
                err = BT_LE_ADV_START(&advParam, BY_SIDE(adNusLeft, adNusRight), sdNus);
            }
            break;
        default:
            LOG_INF("Adv: Attempted to start advertising without any type! Ignoring.");
            return 0;
    }

    // Log it
    if (err == 0) {
        LOG_INF("Adv: '%s' started", advTypeString);
        return 0;
    } else if (err == -EALREADY) {
        LOG_INF("Adv: '%s' continued", advTypeString);
        return 0;
    } else {
        LOG_INF("Adv: '%s' failed to start (err %d), free connections: %d", advTypeString, err, BtConn_UnusedPeripheralConnectionCount());
        return err;
    }
}

void BtAdvertise_Stop(void) {
    BT_TRACE_AND_ASSERT("ba2");
    int err = bt_le_adv_stop();
    if (err) {
        LOG_WRN("Adv: Advertising failed to stop (err %d)", err);
        Bt_HandleError("BtAdvertise_Stop", err);
    }
}

adv_config_t BtAdvertise_Config() {
    switch (DEVICE_ID) {
        case DeviceId_Uhk80_Left:
            if (BtPair_OobPairingInProgress) {
                return ADVERTISEMENT(ADVERTISE_NUS | ADVERTISE_HID);
                // Fails handshake with "RF Noise?"
                // struct bt_le_oob* oob = BtPair_GetRemoteOob();
                // return ADVERTISEMENT_DIRECT_NUS(&oob->addr);
            }
            else if (Peers[PeerIdRight].conn == NULL) {
                return ADVERTISEMENT_DIRECT_NUS(&Peers[PeerIdRight].addr);
            } else {
                return ADVERTISEMENT( 0 );
            }

        case DeviceId_Uhk80_Right: {
            bool freeSlots = BtConn_UnusedPeripheralConnectionCount();
            if (freeSlots == 0) {
                LOG_INF("Adv: Current slot count is zero, not advertising!");
                return ADVERTISEMENT( 0 );
            }

            if (BtPair_OobPairingInProgress) {
                return ADVERTISEMENT(ADVERTISE_NUS | ADVERTISE_HID);
                // Fails handshake with "RF Noise?"
                // struct bt_le_oob* oob = BtPair_GetRemoteOob();
                // return ADVERTISEMENT_DIRECT_NUS(&oob->addr);
            }

            if (Connections_IsReady(CurrentHostConnectionId)) {
                if (Cfg.Bt_AlwaysAdvertise) {
                    return ADVERTISEMENT(ADVERTISE_NUS | ADVERTISE_HID);
                } else {
                    return ADVERTISEMENT( 0 );
                }
            }

            connection_type_t currentConnectionType = Connections_Type(CurrentHostConnectionId);
            if (currentConnectionType == ConnectionType_NusDongle) {
                return ADVERTISEMENT_DIRECT_NUS(&HostConnection(CurrentHostConnectionId)->bleAddress);
            } else if (currentConnectionType == ConnectionType_BtHid) {
                return ADVERTISEMENT(ADVERTISE_HID);
            } else if (currentConnectionType == ConnectionType_Empty) {
                return ADVERTISEMENT(ADVERTISE_HID);
            } else {
                return ADVERTISEMENT( 0 );
            }
        }
        case DeviceId_Uhk_Dongle:
            return ADVERTISEMENT( 0 );
        default:
            LOG_WRN("unknown device!");
            return ADVERTISEMENT( 0 );
    }
}
```

## src/bt_advertise.h
```c
#ifndef __BT_ADVERTISE_H__
#define __BT_ADVERTISE_H__

// Includes:

    #include <stdint.h>
    #include <zephyr/bluetooth/addr.h>
    #include "bt_pair.h"
    #include "shared/attributes.h"

// Macros:

    #define ADVERTISE_NUS (1 << 0)
    #define ADVERTISE_HID (1 << 1)
    #define ADVERTISE_DIRECTED_NUS (1 << 2)

// Typedefs:

    typedef struct {
        uint8_t advType;
        bt_addr_le_t* addr;
    } ATTR_PACKED adv_config_t;

// Variables:

    extern bool BtAdvertise_IsAdvertising;

// Functions:

    void BtAdvertise_DisableAdvertisingIcon(void);
    uint8_t BtAdvertise_Start(adv_config_t advConfig);
    void BtAdvertise_Stop(void);
    adv_config_t BtAdvertise_Config();

#endif // __BT_ADVERTISE_H__
```

## src/bt_central_uart.c
```c
#include <bluetooth/services/nus.h>
#include <bluetooth/services/nus_client.h>
#include <bluetooth/scan.h>
#include "bt_scan.h"
#include "bt_conn.h"
#include "bt_central_uart.h"
#include "bool_array_converter.h"
#include "legacy/slot.h"
#include "shared/bool_array_converter.h"
#include "legacy/module.h"
#include "legacy/key_states.h"
#include "keyboard/oled/widgets/console_widget.h"

static struct bt_nus_client nus_client;

static void ble_data_sent(struct bt_nus_client *nus, uint8_t err, const uint8_t *const data, uint16_t len) {
    printk("NUS data sent to %s: %i\n", GetPeerStringByConn(nus->conn), len);
    if (err) {
        printk("ATT error code: 0x%02X\n", err);
    }
}

static uint8_t ble_data_received(struct bt_nus_client *nus, const uint8_t *data, uint16_t len) {
    if (DEVICE_IS_UHK80_RIGHT) {
        printk("Received data: %i %i %i %i %i %i %i %i\n", data[0], data[1], data[2], data[3], data[4], data[5], data[6], data[7]);
        for (uint8_t keyId = 0; keyId < MAX_KEY_COUNT_PER_MODULE; keyId++) {
            KeyStates[SlotId_LeftKeyboardHalf][keyId].hardwareSwitchState = !!(data[keyId/8] & (1 << (keyId % 8)));
        }
    }
    return BT_GATT_ITER_CONTINUE;
}

static void discovery_complete(struct bt_gatt_dm *dm, void *context) {
    struct bt_nus_client *nus = context;
    printk("Service discovery completed\n");

    bt_gatt_dm_data_print(dm);

    bt_nus_handles_assign(dm, nus);
    bt_nus_subscribe_receive(nus);

    bt_gatt_dm_data_release(dm);
}

static void discovery_service_not_found(struct bt_conn *conn, void *context) {
    printk("Service not found\n");
}

static void discovery_error(struct bt_conn *conn, int err, void *context) {
    printk("Error while discovering GATT database: (%d)\n", err);
}

struct bt_gatt_dm_cb discovery_cb = {
    .completed         = discovery_complete,
    .service_not_found = discovery_service_not_found,
    .error_found       = discovery_error,
};

void gatt_discover(struct bt_conn *conn) {
    int err = bt_gatt_dm_start(conn, BT_UUID_NUS_SERVICE, &discovery_cb, &nus_client);
    if (err) {
        printk("could not start the discovery procedure, error code: %d\n", err);
    }
}

static void exchange_func(struct bt_conn *conn, uint8_t err, struct bt_gatt_exchange_params *params) {
    if (err) {
        printk("MTU exchange failed with %s (err %u)\n", GetPeerStringByConn(conn), err);
    } else {
        printk("MTU exchange done with %s\n", GetPeerStringByConn(conn));
    }
}

void SetupCentralConnection(struct bt_conn *conn) {
    static struct bt_gatt_exchange_params exchange_params;

    exchange_params.func = exchange_func;
    int err = bt_gatt_exchange_mtu(conn, &exchange_params);
    if (err) {
        printk("MTU exchange failed with %s, err %d\n", GetPeerStringByConn(conn), err);
    }

    err = bt_conn_set_security(conn, BT_SECURITY_L2);
    if (err) {
        printk("Failed to set security for %s: %d\n", GetPeerStringByConn(conn), err);
    }

    gatt_discover(conn);

    err = bt_scan_stop();
    if ((!err) && (err != -EALREADY)) {
        printk("Stop LE scan failed (err %d)\n", err);
    }
}

void InitCentralUart(void) {
    int err = scan_init();
    if (err != 0) {
        printk("scan_init failed (err %d)\n", err);
        return;
    }

    struct bt_nus_client_init_param init = {
        .cb = {
            .received = ble_data_received,
            .sent = ble_data_sent,
        }
    };

    err = bt_nus_client_init(&nus_client, &init);
    if (err) {
        printk("NUS Client initialization failed (err %d)\n", err);
        return;
    }

    printk("NUS Client module initialized\n");

    err = bt_scan_start(BT_SCAN_TYPE_SCAN_ACTIVE);
    if (err) {
        printk("Scanning failed to start (err %d)\n", err);
        return;
    }

    printk("Scanning successfully started\n");
}

void SendCentralUart(const uint8_t *data, uint16_t len) {
    int err = bt_nus_client_send(&nus_client, data, len);
    if (err) {
        printk("Failed to send data over BLE connection (err %d)\n", err);
    }
}
```

## src/bt_central_uart.h
```c
#ifndef __BT_CENTRAL_UART_H__
#define __BT_CENTRAL_UART_H__

// Includes

    #include <zephyr/bluetooth/conn.h>

// Functions:

    extern void InitCentralUart(void);
    extern void gatt_discover(struct bt_conn *conn);
    extern void SetupCentralConnection(struct bt_conn *conn);
    extern void SendCentralUart(const uint8_t *data, uint16_t len);

#endif // __BT_CENTRAL_UART_H__
```
