## CMakeLists.txt
```
cmake_minimum_required(VERSION 3.20.0)
find_package(Zephyr REQUIRED HINTS $ENV{ZEPHYR_BASE})
project(uhk)

target_include_directories(app PUBLIC
    src
)

if(BOARD STREQUAL "uhk-60-right")
    set(HAS_BLUETOOTH FALSE)
else()
    set(HAS_BLUETOOTH TRUE)
endif()

message(STATUS "HAS_BLUETOOTH: ${HAS_BLUETOOTH}")

file(GLOB usb_sources src/usb/*.c)
file(GLOB usb_cpp_sources src/usb/*.cpp)

if(HAS_BLUETOOTH)
    file(GLOB app_sources src/*.c)
    file(GLOB app_cpp_sources src/*.cpp)
    target_sources(app PRIVATE ${app_sources} ${app_cpp_sources} ${usb_sources} ${usb_cpp_sources})
else()
    file(GLOB app_cpp_sources src/main.cpp)
    # target_sources(app PRIVATE ${app_cpp_sources} ${usb_sources} ${usb_cpp_sources})
    target_sources(app PRIVATE ${app_cpp_sources})
endif()

# C headers compiled with C++ give pointer conversion errors, turn them to warnings
set(CMAKE_CXX_FLAGS "${CMAKE_CXX_FLAGS} -fpermissive")

# set(C2USB_PATH "c2usb")

# add_subdirectory(${C2USB_PATH})
# # link c2usb to the abstract Zephyr interface to inherit the build flags
# target_link_libraries(c2usb zephyr_interface)

# # Link app to c2usb
# target_link_libraries(app PRIVATE
#     c2usb
# )
```

## prj.conf
```kconfig
CONFIG_PINCTRL=y

CONFIG_ADC=y

CONFIG_EXTRA_EXCEPTION_INFO=y
CONFIG_INIT_STACKS=y

CONFIG_CPP=y
CONFIG_LIB_CPLUSPLUS=y
CONFIG_STD_CPP20=y
CONFIG_CPP_MAIN=y

CONFIG_UDC_DRIVER=y

CONFIG_NCS_SAMPLES_DEFAULTS=y

CONFIG_BT=y
CONFIG_BT_DEBUG_LOG=y
CONFIG_BT_MAX_CONN=2
CONFIG_BT_MAX_PAIRED=2
CONFIG_BT_SMP=y
CONFIG_BT_L2CAP_TX_BUF_COUNT=5
CONFIG_BT_PERIPHERAL=y
CONFIG_BT_DEVICE_NAME="UHK 80"
CONFIG_BT_DEVICE_APPEARANCE=961

CONFIG_BT_BAS=y
CONFIG_BT_HIDS=y
CONFIG_BT_HIDS_DEFAULT_PERM_RW_ENCRYPT=y
CONFIG_BT_GATT_UUID16_POOL_SIZE=40
CONFIG_BT_GATT_CHRC_POOL_SIZE=20

CONFIG_BT_CONN_CTX=y

CONFIG_BT_DIS=y
CONFIG_BT_DIS_PNP=y
CONFIG_BT_DIS_MANUF="Ultimate Gadget Laboratories"
CONFIG_BT_DIS_PNP_VID_SRC=2
CONFIG_BT_DIS_PNP_VID=0x1915
CONFIG_BT_DIS_PNP_PID=0xEEEF
CONFIG_BT_DIS_PNP_VER=0x0100

CONFIG_BT_SETTINGS=y
CONFIG_FLASH=y
CONFIG_FLASH_PAGE_LAYOUT=y
CONFIG_FLASH_MAP=y
CONFIG_NVS=y
CONFIG_SETTINGS=y

CONFIG_SERIAL=y

CONFIG_SPI=y

CONFIG_CONSOLE=y
CONFIG_UART_CONSOLE=y
CONFIG_UART_LINE_CTRL=y
CONFIG_UART_INTERRUPT_DRIVEN=y

CONFIG_SHELL=y
CONFIG_HWINFO=y
CONFIG_HWINFO_SHELL=y
CONFIG_I2C=y
CONFIG_I2C_DUMP_MESSAGES=y
CONFIG_I2C_SHELL=y
CONFIG_MCUBOOT_IMG_MANAGER=y
CONFIG_STREAM_FLASH=y
CONFIG_IMG_MANAGER=y
CONFIG_MCUBOOT_SHELL=y
CONFIG_SETTINGS_SHELL=y
CONFIG_SHELL_BACKENDS=y

CONFIG_USE_SEGGER_RTT=y
CONFIG_RTT_CONSOLE=y
CONFIG_SHELL_BACKEND_RTT=y
CONFIG_LOG_BACKEND_RTT=y
CONFIG_BUILD_OUTPUT_HEX=y
CONFIG_CLOCK_CONTROL=y
CONFIG_SOC_SERIES_KINETIS_K2X=y
```

## src/main.c
```c
#include "bluetooth.h"
#include "key_scanner.h"
#include "leds.h"
#include "oled.h"
#include "charger.h"
#include "spi.h"
#include "uart.h"
#include "i2c.h"
#include "merge_sensor.h"
#include "shell.h"
#include "device.h"
#include "usb/usb.hpp"
#include <zephyr/drivers/gpio.h>

//const struct gpio_dt_spec testLed = GPIO_DT_SPEC_GET(DT_ALIAS(test_led), gpios);

int main(void) {
    printk("----------\n" DEVICE_NAME " started\n");

    // while (true) {
    //     gpio_pin_configure_dt(&testLed, GPIO_OUTPUT);
    //     gpio_pin_toggle_dt(&testLed);
    //     k_msleep(1000);
    // }

    InitUart();
    InitI2c();
    InitSpi();
    InitOled();
    InitLeds();
    InitCharger();
    InitMergeSensor();
    InitKeyScanner();
    usb_init(true);
    bluetooth_init();
}
```

## src/main.cpp
```c
extern "C"
{
#include "bluetooth.h"
#include "key_scanner.h"
#include "leds.h"
#include "oled.h"
#include "charger.h"
#include "spi.h"
#include "uart.h"
#include "i2c.h"
#include "merge_sensor.h"
#include "shell.h"
#include "device.h"
}

#include "usb/usb.hpp"

int main(void) {
    printk("----------\n" DEVICE_NAME " started\n");

    InitUart();
    InitI2c();
    InitSpi();
    InitOled();
    InitLeds();
    InitCharger();
    InitMergeSensor();
    usb_init(true);
    bluetooth_init();
    InitKeyScanner();

//  int blink_status = 0;
    for (;;) {
//      bluetooth_set_adv_led(&blink_status);
//      k_sleep(K_MSEC(ADV_LED_BLINK_INTERVAL));
        // Battery level simulation
        bas_notify();
        k_msleep(1);
    }
}
```

## src/bluetooth.c
```c
#include <zephyr/kernel.h>
#include <zephyr/device.h>
#include <zephyr/drivers/gpio.h>

#include <zephyr/usb/class/usb_hid.h>

#include <zephyr/types.h>
#include <stddef.h>
#include <string.h>
#include <errno.h>
#include <zephyr/sys/printk.h>
#include <zephyr/sys/byteorder.h>
#include <soc.h>
#include <assert.h>
#include <zephyr/spinlock.h>

#include <zephyr/settings/settings.h>

#include <zephyr/bluetooth/bluetooth.h>
#include <zephyr/bluetooth/hci.h>
#include <zephyr/bluetooth/conn.h>
#include <zephyr/bluetooth/uuid.h>
#include <zephyr/bluetooth/gatt.h>

#include <zephyr/bluetooth/services/bas.h>
#include <bluetooth/services/hids.h>
#include <zephyr/bluetooth/services/dis.h>
#include <dk_buttons_and_leds.h>

#define DEVICE_NAME     CONFIG_BT_DEVICE_NAME
#define DEVICE_NAME_LEN (sizeof(DEVICE_NAME) - 1)

#define BASE_USB_HID_SPEC_VERSION   0x0101

#define OUTPUT_REPORT_MAX_LEN            1
#define OUTPUT_REPORT_BIT_MASK_CAPS_LOCK 0x02
#define INPUT_REP_KEYS_REF_ID            1
#define OUTPUT_REP_KEYS_REF_ID           1
#define SCAN_CODE_POS                    2
#define KEYS_MAX_LEN                    (INPUT_REPORT_KEYS_MAX_LEN - SCAN_CODE_POS)

#define ADV_STATUS_LED DK_LED1
#define CON_STATUS_LED DK_LED2
#define LED_CAPS_LOCK  DK_LED3
#define KEY_TEXT_MASK  DK_BTN1_MSK

// Key used to accept or reject passkey value
#define KEY_PAIRING_ACCEPT DK_BTN1_MSK
#define KEY_PAIRING_REJECT DK_BTN2_MSK

static const struct bt_data ad[] = {
    BT_DATA_BYTES(BT_DATA_GAP_APPEARANCE,
              (CONFIG_BT_DEVICE_APPEARANCE >> 0) & 0xff,
              (CONFIG_BT_DEVICE_APPEARANCE >> 8) & 0xff),
    BT_DATA_BYTES(BT_DATA_FLAGS, (BT_LE_AD_GENERAL | BT_LE_AD_NO_BREDR)),
    BT_DATA_BYTES(BT_DATA_UUID16_ALL, BT_UUID_16_ENCODE(BT_UUID_HIDS_VAL),
                      BT_UUID_16_ENCODE(BT_UUID_BAS_VAL)),
};

static const struct bt_data sd[] = {
    BT_DATA(BT_DATA_NAME_COMPLETE, DEVICE_NAME, DEVICE_NAME_LEN),
};

static struct {
    struct bt_conn *conn;
    bool in_boot_mode;
} conn_mode;

struct {
    struct bt_conn *conn;
    unsigned int passkey;
} pairing_data;

static void advertising_start(void) {
    struct bt_le_adv_param *adv_param = BT_LE_ADV_PARAM(
                        BT_LE_ADV_OPT_CONNECTABLE | BT_LE_ADV_OPT_ONE_TIME,
                        BT_GAP_ADV_FAST_INT_MIN_2,
                        BT_GAP_ADV_FAST_INT_MAX_2,
                        NULL);

    int err = bt_le_adv_start(adv_param, ad, ARRAY_SIZE(ad), sd, ARRAY_SIZE(sd));
    if (err) {
        if (err == -EALREADY) {
            printk("Advertising continued\n");
        } else {
            printk("Advertising failed to start (err %d)\n", err);
        }

        return;
    }

    printk("Advertising successfully started\n");
}

static void pairing_process() {
    if (!pairing_data.conn) {
        return;
    }

    char addr[BT_ADDR_LE_STR_LEN];
    bt_addr_le_to_str(bt_conn_get_dst(pairing_data.conn), addr, sizeof(addr));
    printk("Passkey for %s: %06u\n", addr, pairing_data.passkey);
    printk("Press Button 1 to confirm, Button 2 to reject.\n");
}

// HID init

static void caps_lock_handler(const struct bt_hids_rep *rep) {
    uint8_t report_val = ((*rep->data) & OUTPUT_REPORT_BIT_MASK_CAPS_LOCK) ? 1 : 0;
    printk("Bluetooth Caps lock set to %u\n", report_val);
}

static void hids_outp_rep_handler(struct bt_hids_rep *rep, struct bt_conn *conn, bool write) {
    char addr[BT_ADDR_LE_STR_LEN];

    if (!write) {
        printk("Output report read\n");
        return;
    };

    bt_addr_le_to_str(bt_conn_get_dst(conn), addr, sizeof(addr));
    printk("Output report has been received %s\n", addr);
    caps_lock_handler(rep);
}

static void hids_boot_kb_outp_rep_handler(struct bt_hids_rep *rep, struct bt_conn *conn, bool write) {
    char addr[BT_ADDR_LE_STR_LEN];

    if (!write) {
        printk("Output report read\n");
        return;
    };

    bt_addr_le_to_str(bt_conn_get_dst(conn), addr, sizeof(addr));
    printk("Boot Keyboard Output report has been received %s\n", addr);
    caps_lock_handler(rep);
}

static void hids_pm_evt_handler(enum bt_hids_pm_evt evt, struct bt_conn *conn) {
    char addr[BT_ADDR_LE_STR_LEN];

    if (conn_mode.conn != conn) {
        printk("Cannot find connection handle when processing PM");
        return;
    }

    bt_addr_le_to_str(bt_conn_get_dst(conn), addr, sizeof(addr));

    switch (evt) {
    case BT_HIDS_PM_EVT_BOOT_MODE_ENTERED:
        printk("Boot mode entered %s\n", addr);
        conn_mode.in_boot_mode = true;
        break;
    case BT_HIDS_PM_EVT_REPORT_MODE_ENTERED:
        printk("Report mode entered %s\n", addr);
        conn_mode.in_boot_mode = false;
        break;
    default:
        break;
    }
}

// Bluetooth keyboard

// Note: The configuration below is the same as BOOT mode configuration
// This simplifies the code as the BOOT mode is the same as REPORT mode.
// Changing this configuration would require separate implementation of
// BOOT mode report generation.
#define KEY_PRESS_MAX 6 // Maximum number of non-control keys pressed simultaneously

// Number of bytes in key report
//
// 1 byte: modifier keys
// 1 byte: reserved
// rest: non-control keys
#define INPUT_REPORT_KEYS_MAX_LEN (1 + 1 + KEY_PRESS_MAX)

// INPUT report internal indexes.
// This is a position in internal report table and is not related to report ID.
enum {
    INPUT_REP_KEYS_IDX = 0
};

BT_HIDS_DEF(hids_keyboard_obj,
        OUTPUT_REPORT_MAX_LEN,
        INPUT_REPORT_KEYS_MAX_LEN);

static void hid_keyboard_init(void) {
    static const uint8_t report_map[] = {
        0x05, 0x01,       // Usage Page (Generic Desktop)
        0x09, 0x06,       // Usage (Keyboard)
        0xA1, 0x01,       // Collection (Application)

        // Keys
#if INPUT_REP_KEYS_REF_ID
        0x85, INPUT_REP_KEYS_REF_ID,
#endif
        0x05, 0x07,       // Usage Page (Key Codes)
        0x19, 0xe0,       // Usage Minimum (224)
        0x29, 0xe7,       // Usage Maximum (231)
        0x15, 0x00,       // Logical Minimum (0)
        0x25, 0x01,       // Logical Maximum (1)
        0x75, 0x01,       // Report Size (1)
        0x95, 0x08,       // Report Count (8)
        0x81, 0x02,       // Input (Data, Variable, Absolute)

        0x95, 0x01,       // Report Count (1)
        0x75, 0x08,       // Report Size (8)
        0x81, 0x01,       // Input (Constant) reserved byte(1)

        0x95, 0x06,       // Report Count (6)
        0x75, 0x08,       // Report Size (8)
        0x15, 0x00,       // Logical Minimum (0)
        0x25, 0x65,       // Logical Maximum (101)
        0x05, 0x07,       // Usage Page (Key codes)
        0x19, 0x00,       // Usage Minimum (0)
        0x29, 0x65,       // Usage Maximum (101)
        0x81, 0x00,       // Input (Data, Array) Key array(6 bytes)

        // LED
#if OUTPUT_REP_KEYS_REF_ID
        0x85, OUTPUT_REP_KEYS_REF_ID,
#endif
        0x95, 0x05,       // Report Count (5)
        0x75, 0x01,       // Report Size (1)
        0x05, 0x08,       // Usage Page (Page# for LEDs)
        0x19, 0x01,       // Usage Minimum (1)
        0x29, 0x05,       // Usage Maximum (5)
        0x91, 0x02,       // Output (Data, Variable, Absolute),
        // Led report
        0x95, 0x01,       // Report Count (1)
        0x75, 0x03,       // Report Size (3)
        0x91, 0x01,       // Output (Data, Variable, Absolute),
        // Led report padding

        0xC0              // End Collection (Application)
    };

    struct bt_hids_init_param hids_init_obj = {
        .rep_map.data = report_map,
        .rep_map.size = sizeof(report_map),
        .info = {
            .bcd_hid = BASE_USB_HID_SPEC_VERSION,
            .b_country_code = 0x00,
            .flags = BT_HIDS_REMOTE_WAKE | BT_HIDS_NORMALLY_CONNECTABLE,
        },
        .inp_rep_group_init = {
            .reports = {
                {
                    .size = INPUT_REPORT_KEYS_MAX_LEN,
                    .id = INPUT_REP_KEYS_REF_ID,
                }
            },
            .cnt = 1,
        },
        .outp_rep_group_init = {
            .reports = {
                {
                    .size = OUTPUT_REPORT_MAX_LEN,
                    .id = OUTPUT_REP_KEYS_REF_ID,
                    .handler = hids_outp_rep_handler,
                }
            },
            .cnt =  1,
        },
        .is_kb = true,
        .boot_kb_outp_rep_handler = hids_boot_kb_outp_rep_handler,
        .pm_evt_handler = hids_pm_evt_handler,
    };

    int err = bt_hids_init(&hids_keyboard_obj, &hids_init_obj);
    __ASSERT(err == 0, "HIDS keyboard initialization failed\n");
}

// Bluetooth mouse

// Length of Mouse Input Report containing button data.
#define INPUT_REP_BUTTONS_LEN       3
// Length of Mouse Input Report containing movement data.
#define INPUT_REP_MOVEMENT_LEN      3
// Length of Mouse Input Report containing media player data.
#define INPUT_REP_MEDIA_PLAYER_LEN  1
// Index of Mouse Input Report containing movement data.
#define INPUT_REP_MOVEMENT_INDEX    1
// Id of reference to Mouse Input Report containing button data.
#define INPUT_REP_REF_BUTTONS_ID    1
// Id of reference to Mouse Input Report containing movement data.
#define INPUT_REP_REF_MOVEMENT_ID   2
// Id of reference to Mouse Input Report containing media player data.
#define INPUT_REP_REF_MPLAYER_ID    3

BT_HIDS_DEF(hids_mouse_obj,
        INPUT_REP_BUTTONS_LEN,
        INPUT_REP_MOVEMENT_LEN,
        INPUT_REP_MEDIA_PLAYER_LEN);

static void hid_mouse_init(void)
{
    static const uint8_t report_map[] = {
        0x05, 0x01,     // Usage Page (Generic Desktop)
        0x09, 0x02,     // Usage (Mouse)

        0xA1, 0x01,     // Collection (Application)

        // Report ID 1: Mouse buttons + scroll/pan
        0x85, 0x01,       // Report Id 1
        0x09, 0x01,       // Usage (Pointer)
        0xA1, 0x00,       // Collection (Physical)
        0x95, 0x05,       // Report Count (3)
        0x75, 0x01,       // Report Size (1)
        0x05, 0x09,       // Usage Page (Buttons)
        0x19, 0x01,       // Usage Minimum (01)
        0x29, 0x05,       // Usage Maximum (05)
        0x15, 0x00,       // Logical Minimum (0)
        0x25, 0x01,       // Logical Maximum (1)
        0x81, 0x02,       // Input (Data, Variable, Absolute)
        0x95, 0x01,       // Report Count (1)
        0x75, 0x03,       // Report Size (3)
        0x81, 0x01,       // Input (Constant) for padding
        0x75, 0x08,       // Report Size (8)
        0x95, 0x01,       // Report Count (1)
        0x05, 0x01,       // Usage Page (Generic Desktop)
        0x09, 0x38,       // Usage (Wheel)
        0x15, 0x81,       // Logical Minimum (-127)
        0x25, 0x7F,       // Logical Maximum (127)
        0x81, 0x06,       // Input (Data, Variable, Relative)
        0x05, 0x0C,       // Usage Page (Consumer)
        0x0A, 0x38, 0x02, // Usage (AC Pan)
        0x95, 0x01,       // Report Count (1)
        0x81, 0x06,       // Input (Data,Value,Relative,Bit Field)
        0xC0,             // End Collection (Physical)

        // Report ID 2: Mouse motion
        0x85, 0x02,       // Report Id 2
        0x09, 0x01,       // Usage (Pointer)
        0xA1, 0x00,       // Collection (Physical)
        0x75, 0x0C,       // Report Size (12)
        0x95, 0x02,       // Report Count (2)
        0x05, 0x01,       // Usage Page (Generic Desktop)
        0x09, 0x30,       // Usage (X)
        0x09, 0x31,       // Usage (Y)
        0x16, 0x01, 0xF8, // Logical maximum (2047)
        0x26, 0xFF, 0x07, // Logical minimum (-2047)
        0x81, 0x06,       // Input (Data, Variable, Relative)
        0xC0,             // End Collection (Physical)
        0xC0,             // End Collection (Application)

        // Report ID 3: Advanced buttons
        0x05, 0x0C,       // Usage Page (Consumer)
        0x09, 0x01,       // Usage (Consumer Control)
        0xA1, 0x01,       // Collection (Application)
        0x85, 0x03,       // Report Id (3)
        0x15, 0x00,       // Logical minimum (0)
        0x25, 0x01,       // Logical maximum (1)
        0x75, 0x01,       // Report Size (1)
        0x95, 0x01,       // Report Count (1)

        0x09, 0xCD,       // Usage (Play/Pause)
        0x81, 0x06,       // Input (Data,Value,Relative,Bit Field)
        0x0A, 0x83, 0x01, // Usage (Consumer Control Configuration)
        0x81, 0x06,       // Input (Data,Value,Relative,Bit Field)
        0x09, 0xB5,       // Usage (Scan Next Track)
        0x81, 0x06,       // Input (Data,Value,Relative,Bit Field)
        0x09, 0xB6,       // Usage (Scan Previous Track)
        0x81, 0x06,       // Input (Data,Value,Relative,Bit Field)

        0x09, 0xEA,       // Usage (Volume Down)
        0x81, 0x06,       // Input (Data,Value,Relative,Bit Field)
        0x09, 0xE9,       // Usage (Volume Up)
        0x81, 0x06,       // Input (Data,Value,Relative,Bit Field)
        0x0A, 0x25, 0x02, // Usage (AC Forward)
        0x81, 0x06,       // Input (Data,Value,Relative,Bit Field)
        0x0A, 0x24, 0x02, // Usage (AC Back)
        0x81, 0x06,       // Input (Data,Value,Relative,Bit Field)
        0xC0              // End Collection
    };

    static const uint8_t mouse_movement_mask[ceiling_fraction(INPUT_REP_MOVEMENT_LEN, 8)] = {0};

    struct bt_hids_init_param hids_init_param = {
        .rep_map = {
            .data = report_map,
            .size = sizeof(report_map),
        },
        .info = {
            .bcd_hid = BASE_USB_HID_SPEC_VERSION,
            .b_country_code = 0x00,
            .flags = BT_HIDS_REMOTE_WAKE | BT_HIDS_NORMALLY_CONNECTABLE,
        },
        .inp_rep_group_init = {
            .reports = {
                {
                    .size = INPUT_REP_BUTTONS_LEN,
                    .id = INPUT_REP_REF_BUTTONS_ID,
                },
                {
                    .size = INPUT_REP_MOVEMENT_LEN,
                    .id = INPUT_REP_REF_MOVEMENT_ID,
                    .rep_mask = mouse_movement_mask,
                },
                {
                    .size = INPUT_REP_MEDIA_PLAYER_LEN,
                    .id = INPUT_REP_REF_MPLAYER_ID,
                },
            },
            .cnt = 3,
        },
        .is_mouse = true,
        .pm_evt_handler = hids_pm_evt_handler,
    };

    int err = bt_hids_init(&hids_mouse_obj, &hids_init_param);
    __ASSERT(err == 0, "HIDS mouse initialization failed\n");
}

// Connection callbacks

static void connected(struct bt_conn *conn, uint8_t err) {
    char addr[BT_ADDR_LE_STR_LEN];
    bt_addr_le_to_str(bt_conn_get_dst(conn), addr, sizeof(addr));

    if (err) {
        printk("Failed to connect to %s (%u)\n", addr, err);
        return;
    }

    printk("Connected %s\n", addr);
    // dk_set_led_on(CON_STATUS_LED);

    err = bt_hids_connected(&hids_keyboard_obj, conn);
    if (err) {
        printk("Failed to notify keyboard HID service about connection\n");
        return;
    }

    err = bt_hids_connected(&hids_mouse_obj, conn);
    if (err) {
        printk("Failed to notify mouse HID service about connection\n");
        return;
    }


    if (!conn_mode.conn) {
        conn_mode.conn = conn;
        conn_mode.in_boot_mode = false;
        advertising_start();
    }

    printk("Advertising stopped\n");
}

static void disconnected(struct bt_conn *conn, uint8_t reason) {
    char addr[BT_ADDR_LE_STR_LEN];
    bt_addr_le_to_str(bt_conn_get_dst(conn), addr, sizeof(addr));
    printk("Disconnected from %s (reason %u)\n", addr, reason);

    int err = bt_hids_disconnected(&hids_keyboard_obj, conn);
    if (err) {
        printk("Failed to notify keyboard HID service about disconnection\n");
    }

    err = bt_hids_disconnected(&hids_mouse_obj, conn);
    if (err) {
        printk("Failed to notify mouse HID service about disconnection\n");
    }

    conn_mode.conn = NULL;
    // dk_set_led_off(CON_STATUS_LED);
    advertising_start();
}

static void security_changed(struct bt_conn *conn, bt_security_t level, enum bt_security_err err) {
    char addr[BT_ADDR_LE_STR_LEN];
    bt_addr_le_to_str(bt_conn_get_dst(conn), addr, sizeof(addr));

    if (!err) {
        printk("Security changed: %s level %u\n", addr, level);
    } else {
        printk("Security failed: %s level %u err %d\n", addr, level, err);
    }
}

BT_CONN_CB_DEFINE(conn_callbacks) = {
    .connected = connected,
    .disconnected = disconnected,
    .security_changed = security_changed,
};

// Auth callbacks

static void auth_passkey_display(struct bt_conn *conn, unsigned int passkey) {
    char addr[BT_ADDR_LE_STR_LEN];
    bt_addr_le_to_str(bt_conn_get_dst(conn), addr, sizeof(addr));
    printk("Passkey for %s: %06u\n", addr, passkey);
}

static void auth_passkey_confirm(struct bt_conn *conn, unsigned int passkey) {
    pairing_data.conn    = bt_conn_ref(conn);
    pairing_data.passkey = passkey;
    pairing_process();
}

static void auth_cancel(struct bt_conn *conn) {
    char addr[BT_ADDR_LE_STR_LEN];
    bt_addr_le_to_str(bt_conn_get_dst(conn), addr, sizeof(addr));
    printk("Pairing cancelled: %s\n", addr);
}

static struct bt_conn_auth_cb conn_auth_callbacks = {
    .passkey_display = auth_passkey_display,
    .passkey_confirm = auth_passkey_confirm,
    .cancel = auth_cancel,
};

// Auth info callbacks

static void pairing_complete(struct bt_conn *conn, bool bonded) {
    char addr[BT_ADDR_LE_STR_LEN];
    bt_addr_le_to_str(bt_conn_get_dst(conn), addr, sizeof(addr));
    printk("Pairing completed: %s, bonded: %d\n", addr, bonded);
}

static void pairing_failed(struct bt_conn *conn, enum bt_security_err reason) {
    if (!pairing_data.conn) {
        return;
    }

    if (pairing_data.conn == conn) {
        bt_conn_unref(pairing_data.conn);
        pairing_data.conn = NULL;
    }

    char addr[BT_ADDR_LE_STR_LEN];
    bt_addr_le_to_str(bt_conn_get_dst(conn), addr, sizeof(addr));
    printk("Pairing failed conn: %s, reason %d\n", addr, reason);
}

static struct bt_conn_auth_info_cb conn_auth_info_callbacks = {
    .pairing_complete = pairing_complete,
    .pairing_failed = pairing_failed
};

void key_report_send(bool down) {
    if (!conn_mode.conn) {
        return;
    }

    uint8_t chr = down ? HID_KEY_A : 0;
    uint8_t data[INPUT_REPORT_KEYS_MAX_LEN] = {0 /* modifiers */, 0, chr, 0, 0, 0, 0, 0};

    int keyboard_err = 0;
    int mouse_err = 0;
    if (conn_mode.in_boot_mode) {
        keyboard_err = bt_hids_boot_kb_inp_rep_send(&hids_keyboard_obj, conn_mode.conn, data, sizeof(data), NULL);
        mouse_err = bt_hids_boot_mouse_inp_rep_send(&hids_mouse_obj, conn_mode.conn, NULL, 5, 0, NULL);
    } else {
        uint8_t buffer[INPUT_REP_MOVEMENT_LEN] = {0, 0, 5};
        keyboard_err = bt_hids_inp_rep_send(&hids_keyboard_obj, conn_mode.conn, INPUT_REP_KEYS_IDX, data, sizeof(data), NULL);
        mouse_err = bt_hids_inp_rep_send(&hids_mouse_obj, conn_mode.conn, INPUT_REP_MOVEMENT_INDEX, buffer, sizeof(buffer), NULL);
    }

    if (keyboard_err) {
        printk("Key report send error: %d\n", keyboard_err);
    }
    if (mouse_err) {
        printk("Mouse report send error: %d\n", mouse_err);
    }
}

static void num_comp_reply(bool accept) {
    struct bt_conn *conn;

    if (!pairing_data.conn) {
        return;
    }

    conn = pairing_data.conn;

    if (accept) {
        bt_conn_auth_passkey_confirm(conn);
        printk("Numeric Match, conn %p\n", conn);
    } else {
        bt_conn_auth_cancel(conn);
        printk("Numeric Reject, conn %p\n", conn);
    }

    bt_conn_unref(pairing_data.conn);
    pairing_data.conn = NULL;
}

void button_changed(uint32_t button_state, uint32_t has_changed) {
    static bool pairing_button_pressed;

    uint32_t buttons = button_state & has_changed;

    if (pairing_data.conn) {
        if (buttons & KEY_PAIRING_ACCEPT) {
            pairing_button_pressed = true;
            num_comp_reply(true);
            return;
        }

        if (buttons & KEY_PAIRING_REJECT) {
            pairing_button_pressed = true;
            num_comp_reply(false);
            return;
        }
    }

    // Do not take any action if the pairing button is released.
    if (pairing_button_pressed && (has_changed & (KEY_PAIRING_ACCEPT | KEY_PAIRING_REJECT))) {
        pairing_button_pressed = false;
        return;
    }

    if (has_changed & KEY_TEXT_MASK) {
        key_report_send((button_state & KEY_TEXT_MASK) != 0);
    }
}

void bas_notify(void) {
    uint8_t battery_level = bt_bas_get_battery_level();

    battery_level--;

    if (!battery_level) {
        battery_level = 100U;
    }

    bt_bas_set_battery_level(battery_level);
}

void bluetooth_init() {
    printk("Starting Bluetooth Peripheral HIDS keyboard\n");

    bt_conn_auth_cb_register(&conn_auth_callbacks);
    bt_conn_auth_info_cb_register(&conn_auth_info_callbacks);
    bt_enable(NULL);

    printk("Bluetooth initialized\n");

    settings_load();
    hid_keyboard_init();
    hid_mouse_init();

    advertising_start();
}
```

## src/bluetooth.h
```c
#include <zephyr/types.h>

extern void bas_notify(void);
extern void bluetooth_init(void);
extern void num_comp_reply(uint8_t accept);
extern void key_report_send(uint8_t down);
```

## src/charger.c
```c
#include <zephyr/drivers/gpio.h>
#include <zephyr/sys/util.h>
#include "charger.h"
#include "shell.h"

const struct gpio_dt_spec chargerEnDt = GPIO_DT_SPEC_GET(DT_ALIAS(charger_en), gpios);
const struct gpio_dt_spec chargerStatDt = GPIO_DT_SPEC_GET(DT_ALIAS(charger_stat), gpios);

struct gpio_callback callbackStruct;

#define DT_SPEC_AND_COMMA(node_id, prop, idx) \
    ADC_DT_SPEC_GET_BY_IDX(node_id, idx),
const struct adc_dt_spec adc_channels[] = {
    DT_FOREACH_PROP_ELEM(DT_PATH(zephyr_user), io_channels, DT_SPEC_AND_COMMA)
};

void chargerStatCallback(const struct device *port, struct gpio_callback *cb, gpio_port_pins_t pins) {
    if (Shell.statLog) {
        printk("STAT changed to %i\n", gpio_pin_get_dt(&chargerStatDt) ? 1 : 0);
    }
}

void InitCharger(void) {
    gpio_pin_configure_dt(&chargerEnDt, GPIO_OUTPUT);
    gpio_pin_set_dt(&chargerEnDt, true);

    gpio_pin_configure_dt(&chargerStatDt, GPIO_INPUT);
    gpio_pin_interrupt_configure_dt(&chargerStatDt, GPIO_INT_EDGE_BOTH);
    gpio_init_callback(&callbackStruct, chargerStatCallback, BIT(chargerStatDt.pin));
    gpio_add_callback(chargerStatDt.port, &callbackStruct);

    // Init ADC channels
    for (size_t i = 0U; i < ARRAY_SIZE(adc_channels); i++) {
        if (!device_is_ready(adc_channels[i].dev)) {
            printk("ADC controller device %s not ready\n", adc_channels[i].dev->name);
            return;
        }
        int err;
        err = adc_channel_setup_dt(&adc_channels[i]);
        if (err < 0) {
            printk("Could not setup channel #%d (%d)\n", i, err);
            return;
        }
    }
}
```

## src/device.h
```c
#ifndef __DEVICE_H__
#define __DEVICE_H__

// Includes:

    #include "autoconf.h"

// Macros:

    #define DEVICE_ID_UHK60V1_RIGHT 1
    #define DEVICE_ID_UHK60V2_RIGHT 2
    #define DEVICE_ID_UHK80_LEFT 3
    #define DEVICE_ID_UHK80_RIGHT 4

    #if CONFIG_DEVICE_ID == DEVICE_ID_UHK60V1_RIGHT
        #define DEVICE_NAME "UHK 60 v1"
        #define USB_DEVICE_PRODUCT_ID 0x6122
    #elif CONFIG_DEVICE_ID == DEVICE_ID_UHK60V2_RIGHT
        #define DEVICE_NAME "UHK 60 v2"
        #define USB_DEVICE_PRODUCT_ID 0x6124
    #elif CONFIG_DEVICE_ID == DEVICE_ID_UHK80_LEFT
        #define DEVICE_NAME "UHK 80 left half"
        #define USB_DEVICE_PRODUCT_ID 0xffff // TODO
    #elif CONFIG_DEVICE_ID == DEVICE_ID_UHK80_RIGHT
        #define DEVICE_NAME "UHK 80 right half"
        #define USB_DEVICE_PRODUCT_ID 0xffff // TODO
    #endif

    #if CONFIG_DEVICE_ID == DEVICE_ID_UHK80_LEFT
        #define DEVICE_HAS_MERGE_SENSE
    #endif

    #if CONFIG_DEVICE_ID == DEVICE_ID_UHK80_RIGHT
        #define DEVICE_HAS_OLED
    #endif

    #if CONFIG_DEVICE_ID == DEVICE_ID_UHK80_LEFT || CONFIG_DEVICE_ID == DEVICE_ID_UHK80_RIGHT
        #define DEVICE_HAS_NRF
        #define DEVICE_HAS_BATTERY
    #endif

#endif
```

## src/device_ids.h
```c
#include "autoconf.h"

#define DEVICE_ID_UHK60V1_RIGHT 1
#define DEVICE_ID_UHK60V2_RIGHT 2
#define DEVICE_ID_UHK80_LEFT 3
#define DEVICE_ID_UHK80_RIGHT 4

#if CONFIG_DEVICE_ID == DEVICE_ID_UHK60V1_RIGHT
    #define DEVICE_NAME "UHK 60 v1"
    #define USB_DEVICE_PRODUCT_ID 0x6122
#elif CONFIG_DEVICE_ID == DEVICE_ID_UHK60V2_RIGHT
    #define DEVICE_NAME "UHK 60 v2"
    #define USB_DEVICE_PRODUCT_ID 0x6124
#elif CONFIG_DEVICE_ID == DEVICE_ID_UHK80_LEFT
    #define DEVICE_NAME "UHK 80 left half"
    #define USB_DEVICE_PRODUCT_ID 0xffff // TODO
#elif CONFIG_DEVICE_ID == DEVICE_ID_UHK80_RIGHT
    #define DEVICE_NAME "UHK 80 right half"
    #define USB_DEVICE_PRODUCT_ID 0xffff // TODO
#endif
```

## src/i2c.c
```c
#include <zephyr/drivers/i2c.h>
#include <zephyr/sys/printk.h>
#include "device.h"

void InitI2c(void) {
    // Init I2C
#if CONFIG_DEVICE_ID == DEVICE_ID_UHK80_LEFT
    #define device_addr 0x18 // left module i2c address
#elif CONFIG_DEVICE_ID == DEVICE_ID_UHK80_RIGHT || CONFIG_DEVICE_ID == DEVICE_ID_UHK60V1_RIGHT || CONFIG_DEVICE_ID == DEVICE_ID_UHK60V2_RIGHT
    #define device_addr 0x28 // right module i2c address
#endif

    uint8_t tx_buf[] = {0x00,0x00};
    uint8_t rx_buf[10] = {0};

    int ret;
    static const struct device *i2c0_dev = DEVICE_DT_GET(DT_NODELABEL(i2c0));
    k_msleep(50);
    if (!device_is_ready(i2c0_dev)) {
        printk("I2C bus %s is not ready!\n",i2c0_dev->name);
    }

    ret = i2c_write_read(i2c0_dev, device_addr, tx_buf, 2, rx_buf, 7);
    if (ret != 0) {
        printk("write-read fail\n");
    }
    printk("sync: %.7s\n", rx_buf);
}
```

## src/key_scanner.c
```c
#include <stdio.h>
#include <zephyr/kernel.h>
#include <zephyr/drivers/gpio.h>
#include "key_scanner.h"
#include "shell.h"
#include "uart.h"
#include "bluetooth.h"
#include <zephyr/drivers/uart.h>

// Thread definitions

#define THREAD_STACK_SIZE 1000
#define THREAD_PRIORITY 5

static K_THREAD_STACK_DEFINE(stack_area, THREAD_STACK_SIZE);
static struct k_thread thread_data;

// Keyboard matrix definitions

static struct gpio_dt_spec rows[KEY_MATRIX_ROWS] = {
    GPIO_DT_SPEC_GET(DT_ALIAS(row1), gpios),
    GPIO_DT_SPEC_GET(DT_ALIAS(row2), gpios),
    GPIO_DT_SPEC_GET(DT_ALIAS(row3), gpios),
    GPIO_DT_SPEC_GET(DT_ALIAS(row4), gpios),
    GPIO_DT_SPEC_GET(DT_ALIAS(row5), gpios),
    GPIO_DT_SPEC_GET(DT_ALIAS(row6), gpios),
};

static struct gpio_dt_spec cols[KEY_MATRIX_COLS] = {
    GPIO_DT_SPEC_GET(DT_ALIAS(col1), gpios),
    GPIO_DT_SPEC_GET(DT_ALIAS(col2), gpios),
    GPIO_DT_SPEC_GET(DT_ALIAS(col3), gpios),
    GPIO_DT_SPEC_GET(DT_ALIAS(col4), gpios),
    GPIO_DT_SPEC_GET(DT_ALIAS(col5), gpios),
    GPIO_DT_SPEC_GET(DT_ALIAS(col6), gpios),
    GPIO_DT_SPEC_GET(DT_ALIAS(col7), gpios),
#if CONFIG_DEVICE_ID == DEVICE_ID_UHK80_RIGHT
    GPIO_DT_SPEC_GET(DT_ALIAS(col8), gpios),
    GPIO_DT_SPEC_GET(DT_ALIAS(col9), gpios),
    GPIO_DT_SPEC_GET(DT_ALIAS(col10), gpios),
#endif
};

#define COLS_COUNT (sizeof(cols) / sizeof(cols[0]))
uint8_t KeyStates[KEY_MATRIX_ROWS][KEY_MATRIX_COLS];
volatile char KeyPressed;

void keyScanner() {
    while (true) {
        KeyPressed = false;
        for (uint8_t rowId=0; rowId<KEY_MATRIX_ROWS; rowId++) {
            gpio_pin_set_dt(&rows[rowId], 1);
            for (uint8_t colId=0; colId<KEY_MATRIX_COLS; colId++) {
                bool keyState = gpio_pin_get_dt(&cols[colId]);
                KeyStates[rowId][colId] = keyState;
                if (keyState) {
                    KeyPressed = true;
                    if (Shell.keyLog) {
                        char buffer[20];
                        sprintf(buffer, "SW%c%c\n", rowId+'1', colId+'1');
                        printk("%s", buffer);
                        for (uint8_t i=0; i<strlen(buffer); i++) {
                            uart_poll_out(uart_dev, buffer[i]);
                        }
                    }
                }
            }
            gpio_pin_set_dt(&rows[rowId], 0);
        }

        key_report_send(KeyStates[0][0]);

        k_msleep(1);
    }
}

void InitKeyScanner(void)
{
    for (uint8_t rowId=0; rowId<6; rowId++) {
        gpio_pin_configure_dt(&rows[rowId], GPIO_OUTPUT);
    }
    for (uint8_t colId=0; colId<COLS_COUNT; colId++) {
        gpio_pin_configure_dt(&cols[colId], GPIO_INPUT);
    }

    k_thread_create(
        &thread_data, stack_area,
        K_THREAD_STACK_SIZEOF(stack_area),
        keyScanner,
        NULL, NULL, NULL,
        THREAD_PRIORITY, 0, K_NO_WAIT
    );
}
```

## src/key_scanner.h
```c
#ifndef __KEY_SCANNER_H__
#define __KEY_SCANNER_H__

// Variables:

    extern uint8_t KeyStates[6][10];
    extern volatile char KeyPressed;

// Functions:

    extern void InitKeyScanner(void);

#endif
```

## src/leds.c
```c
#include <zephyr/kernel.h>
#include <zephyr/drivers/gpio.h>
#include "leds.h"
#include "spi.h"

// Thread definitions

#define THREAD_STACK_SIZE 1000
#define THREAD_PRIORITY 5

static K_THREAD_STACK_DEFINE(stack_area, THREAD_STACK_SIZE);
static struct k_thread thread_data;

// LED GPIOs

const struct gpio_dt_spec ledsCsDt = GPIO_DT_SPEC_GET(DT_ALIAS(leds_cs), gpios);
const struct gpio_dt_spec ledsSdbDt = GPIO_DT_SPEC_GET(DT_ALIAS(leds_sdb), gpios);

void setLedsCs(bool state)
{
    gpio_pin_set_dt(&ledsCsDt, state);
}

#define LedPagePrefix 0b01010000

void ledUpdater() {
    while (true) {
        k_mutex_lock(&SpiMutex, K_FOREVER);

        gpio_pin_set_dt(&ledsCsDt, false);

        writeSpi(LedPagePrefix | 2);
        writeSpi(0x00);
        writeSpi(0b00001001);
        setLedsCs(true);

        setLedsCs(false);
        writeSpi(LedPagePrefix | 2);
        writeSpi(0x01);
        writeSpi(0xff);
        setLedsCs(true);

        setLedsCs(false);
        writeSpi(LedPagePrefix | 0);
        writeSpi(0x00);
        for (int i=0; i<255; i++) {
            writeSpi(1/*KeyPressed || ledsAlwaysOn*/ ? 0xff : 0);
        }
        setLedsCs(true);

        setLedsCs(false);
        writeSpi(LedPagePrefix | 1);
        writeSpi(0x00);
        for (int i=0; i<255; i++) {
            writeSpi(1/*KeyPressed || ledsAlwaysOn*/ ? 0xff : 0);
        }

        gpio_pin_set_dt(&ledsCsDt, true);

        k_mutex_unlock(&SpiMutex);

        k_sleep(K_MSEC(100));
    }
}

void InitLeds(void) {
    gpio_pin_configure_dt(&ledsCsDt, GPIO_OUTPUT);

    gpio_pin_configure_dt(&ledsSdbDt, GPIO_OUTPUT);
    gpio_pin_set_dt(&ledsSdbDt, true);

    k_thread_create(
        &thread_data, stack_area,
        K_THREAD_STACK_SIZEOF(stack_area),
        ledUpdater,
        NULL, NULL, NULL,
        THREAD_PRIORITY, 0, K_NO_WAIT
    );
}
```

## src/leds.h
```c
#ifndef __LEDS_H__
#define __LEDS_H__

// Variables:

    extern const struct gpio_dt_spec ledsCsDt;
    extern const struct gpio_dt_spec ledsSdbDt;

// Functions:

    extern void InitLeds(void);

#endif
```

## src/merge_sensor.c
```c
#include <zephyr/kernel.h>
#include <zephyr/drivers/gpio.h>
#include "merge_sensor.h"
#include "device.h"

#ifdef DEVICE_HAS_MERGE_SENSE
const struct gpio_dt_spec mergeSenseDt = GPIO_DT_SPEC_GET(DT_ALIAS(merge_sense), gpios);
#endif

void InitMergeSensor(void) {
#ifdef DEVICE_HAS_MERGE_SENSE
    gpio_pin_configure_dt(&mergeSenseDt, GPIO_INPUT);
#endif
}
```
