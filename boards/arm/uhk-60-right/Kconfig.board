## boards/arm/uhk-60-right/Kconfig.board
```kconfig
# Copyright (c) 2018, Prevas A/S
# SPDX-License-Identifier: Apache-2.0

config BOARD_UHK_60_RIGHT
    bool "UHK 60 right"
    depends on SOC_SERIES_KINETIS_K2X
    select SOC_PART_NUMBER_MK22FN512VLH12
```

## boards/arm/uhk-60-right/Kconfig.defconfig
```kconfig
# Copyright (c) 2018 Prevas A/S
# SPDX-License-Identifier: Apache-2.0

if BOARD_UHK_60_RIGHT

config BOARD
    default "uhk-60-right"

config OSC_XTAL0_FREQ
    default 8000000

config MCG_PRDIV0
    default 0x3

config MCG_VDIV0
    default 0xc

config MCG_FCRDIV
    default 0

endif
```

## boards/arm/uhk-80-left/Kconfig.board
```kconfig
# Copyright (c) 2023 Nordic Semiconductor ASA
# SPDX-License-Identifier: Apache-2.0

config BOARD_UHK_80_LEFT
	bool "UHK 80 left"
	depends on SOC_NRF52840_QIAA
```

## boards/arm/uhk-80-left/Kconfig.defconfig
```kconfig
# SPDX-License-Identifier: Apache-2.0
# used for both zephyr and mcuboot -> no custom kconfig symbols here
if BOARD_UHK_80_LEFT

if SHELL_BACKEND_RTT
config SHELL_PROMPT_RTT
    default "uhk80:left$ "
endif # SHELL_BACKEND_RTT

if SHELL_BACKEND_SERIAL
config SHELL_PROMPT_UART
    default "uhk80:left$ "
endif # SHELL_BACKEND_SERIAL

if BT_DIS && BT_DIS_PNP
config BT_DIS_PNP_PID
    default 0x8007
endif # BT_DIS && BT_DIS_PNP

config USB_DEVICE_PRODUCT
    default "UHK 80 left half"

config USB_DEVICE_PID
    default 0x0007

config BT_CTLR
    default BT

endif # BOARD_UHK_80_LEFT
```

## boards/arm/uhk-80-right/Kconfig.board
```kconfig
# Copyright (c) 2023 Nordic Semiconductor ASA
# SPDX-License-Identifier: Apache-2.0

config BOARD_UHK_80_RIGHT
	bool "UHK 80 right"
	depends on SOC_NRF52840_QIAA
```

## boards/arm/uhk-80-right/Kconfig.defconfig
```kconfig
# SPDX-License-Identifier: Apache-2.0
# used for both zephyr and mcuboot -> no custom kconfig symbols here
if BOARD_UHK_80_RIGHT

config BOARD
    default "uhk-80-right"

if SHELL_BACKEND_RTT
config SHELL_PROMPT_RTT
    default "uhk80:right$ "
endif # SHELL_BACKEND_RTT

if SHELL_BACKEND_SERIAL
config SHELL_PROMPT_UART
    default "uhk80:right$ "
endif # SHELL_BACKEND_SERIAL

if BT_DIS && BT_DIS_PNP
config BT_DIS_PNP_PID
    default 0x8009
endif # BT_DIS && BT_DIS_PNP

config USB_DEVICE_PRODUCT
    default "UHK 80 right half"

config USB_DEVICE_PID
    default 0x0009

config BT_CTLR
    default BT

endif # BOARD_UHK_80_RIGHT
```

## boards/arm/uhk-dongle/Kconfig.defconfig
```kconfig
# SPDX-License-Identifier: Apache-2.0
# used for both zephyr and mcuboot -> no custom kconfig symbols here
if BOARD_UHK_DONGLE

config BOARD
    default "uhk-dongle"

if SHELL_BACKEND_RTT
config SHELL_PROMPT_RTT
    default "uhk-dongle$ "
endif # SHELL_BACKEND_RTT

if SHELL_BACKEND_SERIAL
config SHELL_PROMPT_UART
    default "uhk-dongle$ "
endif # SHELL_BACKEND_SERIAL

if BT_DIS && BT_DIS_PNP
config BT_DIS_PNP_PID
    default 0x8005
endif # BT_DIS && BT_DIS_PNP

config USB_DEVICE_PRODUCT
    default "UHK dongle"

config USB_DEVICE_PID
    default 0x0005

config BT_CTLR
    default BT

endif # BOARD_UHK_DONGLE
```

## boards/arm/uhk-dongle/uhk-dongle_defconfig
```kconfig
# SPDX-License-Identifier: Apache-2.0
# used for both zephyr and mcuboot -> only shared kconfig symbols here
CONFIG_SOC_SERIES_NRF52X=y
CONFIG_SOC_NRF52840_QIAA=y
CONFIG_BOARD_UHK_DONGLE=y

# Enable MPU
CONFIG_ARM_MPU=y

# Enable hardware stack protection
CONFIG_HW_STACK_PROTECTION=y
```

## boards/ugl/uhk-60-right/Kconfig.board
```kconfig
config BOARD_UHK_60_RIGHT_V1
    bool "UHK 60 v1"
    depends on SOC_SERIES_KINETIS_K2X
    select SOC_PART_NUMBER_MK22FN512VLH12

config BOARD_UHK_60_RIGHT_V2
    bool "UHK 60 v2"
    depends on SOC_SERIES_KINETIS_K2X
    select SOC_PART_NUMBER_MK22FN512VLH12
```

## boards/ugl/uhk-80/Kconfig.defconfig
```kconfig
# SPDX-License-Identifier: Apache-2.0
# used for both zephyr and mcuboot -> no custom kconfig symbols here

if SHELL_BACKEND_RTT
    config SHELL_PROMPT_RTT
        default "uhk80:left$ " if BOARD_UHK_80_LEFT
        default "uhk80:right$ " if BOARD_UHK_80_RIGHT
        default "uhk-dongle$ " if BOARD_UHK_DONGLE
endif # SHELL_BACKEND_RTT

if SHELL_BACKEND_SERIAL
    config SHELL_PROMPT_UART
        default "uhk80:left$ " if BOARD_UHK_80_LEFT
        default "uhk80:right$ " if BOARD_UHK_80_RIGHT
        default "uhk-dongle$ " if BOARD_UHK_DONGLE
endif # SHELL_BACKEND_SERIAL

if BT_DIS && BT_DIS_PNP
    config BT_DIS_PNP_PID
        default 0x8007 if BOARD_UHK_80_LEFT
        default 0x8009 if BOARD_UHK_80_RIGHT
        default 0x8005 if BOARD_UHK_DONGLE
endif # BT_DIS && BT_DIS_PNP

if BOARD_UHK_80_LEFT
    config USB_DEVICE_PRODUCT
        default "UHK 80 left half bootloader" if MCUBOOT
        default "UHK 80 Left USB"
    config USB_DEVICE_PID
        default 0x0006 if !BT
        default 0x0007
endif # BOARD_UHK_80_LEFT

if BOARD_UHK_80_RIGHT
    config USB_DEVICE_PRODUCT
        default "UHK 80 right half bootloader" if MCUBOOT
        default "UHK 80 Right USB"
    config USB_DEVICE_PID
        default 0x0008 if MCUBOOT
        default 0x0009
endif # BOARD_UHK_80_RIGHT

if BOARD_UHK_DONGLE
    config USB_DEVICE_PRODUCT
        default "UHK dongle bootloader" if MCUBOOT
        default "UHK dongle"
    config USB_DEVICE_PID
        default 0x0004 if MCUBOOT
        default 0x0005
endif # BOARD_UHK_DONGLE

if BT
    # uhk-80-right is NUS server AND client, and HID server
    config BT_MAX_CONN
        default 4 if BOARD_UHK_80_RIGHT
        default 2
    config BT_CTLR_SDC_PERIPHERAL_COUNT
        default 3 if BOARD_UHK_80_RIGHT
        default 1
    # use different connection parameters for HID clients and dongle
    config BT_GAP_AUTO_UPDATE_CONN_PARAMS
        default n if BOARD_UHK_80_RIGHT
    config BT_DEVICE_NAME
        default "UHK 80" if BOARD_UHK_80_LEFT || BOARD_UHK_80_RIGHT
    config BT_DEVICE_APPEARANCE
        default 961
endif # BT

config BT_CTLR
    default BT
```

## boards/ugl/uhk-80/Kconfig.uhk-80-left
```kconfig
# Copyright (c) 2023 Nordic Semiconductor ASA
# SPDX-License-Identifier: Apache-2.0

config BOARD_UHK_80_LEFT
	select SOC_NRF52840_QIAA
```

## boards/ugl/uhk-80/Kconfig.uhk-80-right
```kconfig
# Copyright (c) 2023 Nordic Semiconductor ASA
# SPDX-License-Identifier: Apache-2.0

config BOARD_UHK_80_RIGHT
	select SOC_NRF52840_QIAA
```

## boards/ugl/uhk-80/board.yml
```yaml
boards:
  - name: uhk-80-left
    full_name: Ultimate Hacking Keyboard 80 Left
    vendor: ugl
    socs:
      - name: nrf52840
  - name: uhk-80-right
    full_name: Ultimate Hacking Keyboard 80 Right
    vendor: ugl
    socs:
      - name: nrf52840
  - name: uhk-dongle
    full_name: Ultimate Hacking Keyboard Dongle
    vendor: ugl
    socs:
      - name: nrf52840
```

## boards/ugl/uhk-80/uhk-dongle_defconfig
```kconfig
# SPDX-License-Identifier: Apache-2.0
# used for both zephyr and mcuboot -> only shared kconfig symbols here
# Enable MPU
CONFIG_ARM_MPU=y

# Enable hardware stack protection
CONFIG_HW_STACK_PROTECTION=y

CONFIG_PWM=y
```

## boards/ugl/uhk-dongle/Kconfig.board
```kconfig
# Copyright (c) 2023 Nordic Semiconductor ASA
# SPDX-License-Identifier: Apache-2.0

config BOARD_UHK_DONGLE
    bool "UHK dongle"
    depends on SOC_NRF52840_QIAA
```

## west.yml
```yaml
manifest:
  self:
    path: device
    west-commands: scripts/west-commands.yml
  remotes:
    - name: sdk
      url-base: https://github.com/nrfconnect
    - name: zephyr
      url-base: https://github.com/zephyrproject-rtos
    - name: IntergatedCircuits
      url-base: https://github.com/IntergatedCircuits

  projects:
    - name: sdk-nrf
      remote: sdk
      path: nrf
      revision: v2.8.0
      import:
        path-prefix: nrfconnect
      clone-depth: 1
      import:
        name-allowlist:
          - zephyr
          - cmsis
          - hal_nordic
          - mcuboot
          - nrfxlib
          - lvgl
          - segger
          - tinycrypt
          - zcbor

    - name: hal_nxp
      remote: zephyr
      clone-depth: 1

    - name: c2usb
      remote: IntergatedCircuits
      revision: 985a33313134a005fb2689e2bd57d05e4ec3700e
      clone-depth: 1
```
