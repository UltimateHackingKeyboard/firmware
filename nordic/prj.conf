## CMakeLists.txt
```
cmake_minimum_required(VERSION 3.20.0)
find_package(Zephyr REQUIRED HINTS $ENV{ZEPHYR_BASE})
project(uhk)

target_include_directories(app PUBLIC
    src
)

if(BOARD STREQUAL "uhk-60-right")
    set(HAS_BLUETOOTH FALSE)
else()
    set(HAS_BLUETOOTH TRUE)
endif()

message(STATUS "HAS_BLUETOOTH: ${HAS_BLUETOOTH}")

file(GLOB usb_sources src/usb/*.c)
file(GLOB usb_cpp_sources src/usb/*.cpp)

if(HAS_BLUETOOTH)
    file(GLOB app_sources src/*.c)
    file(GLOB app_cpp_sources src/*.cpp)
    target_sources(app PRIVATE ${app_sources} ${app_cpp_sources} ${usb_sources} ${usb_cpp_sources})
else()
    file(GLOB app_cpp_sources src/main.cpp)
    target_sources(app PRIVATE ${app_cpp_sources} ${usb_sources} ${usb_cpp_sources})
endif()

# C headers compiled with C++ give pointer conversion errors, turn them to warnings
set(CMAKE_CXX_FLAGS "${CMAKE_CXX_FLAGS} -fpermissive")

set(C2USB_PATH "c2usb")

add_subdirectory(${C2USB_PATH})
# link c2usb to the abstract Zephyr interface to inherit the build flags
target_link_libraries(c2usb zephyr_interface)

# Link app to c2usb
target_link_libraries(app PRIVATE
    c2usb
)
```

## west.yml
```
manifest:
  self:
    path: application
  remotes:
    - name: sdk
      url-base: https://github.com/nrfconnect
  projects:
    - name: sdk-nrf
      remote: sdk
      path: nrf
      revision: v2.4.99-dev2
      import:
        path-prefix: external
      clone-depth: 1
```

## prj.conf
```kconfig
CONFIG_PINCTRL=y

CONFIG_ADC=y

CONFIG_EXTRA_EXCEPTION_INFO=y
CONFIG_INIT_STACKS=y

CONFIG_CPP=y
CONFIG_LIB_CPLUSPLUS=y
CONFIG_STD_CPP20=y
CONFIG_CPP_MAIN=y

CONFIG_UDC_DRIVER=y
CONFIG_UDC_NRF=y

CONFIG_NCS_SAMPLES_DEFAULTS=y

CONFIG_BT=y
CONFIG_BT_DEBUG_LOG=y
CONFIG_BT_MAX_CONN=2
CONFIG_BT_MAX_PAIRED=2
CONFIG_BT_SMP=y
CONFIG_BT_L2CAP_TX_BUF_COUNT=5
CONFIG_BT_PERIPHERAL=y
CONFIG_BT_DEVICE_NAME="UHK 80"
CONFIG_BT_DEVICE_APPEARANCE=961

CONFIG_BT_BAS=y
CONFIG_BT_HIDS=y
CONFIG_BT_HIDS_DEFAULT_PERM_RW_ENCRYPT=y
CONFIG_BT_GATT_UUID16_POOL_SIZE=40
CONFIG_BT_GATT_CHRC_POOL_SIZE=20

CONFIG_BT_CONN_CTX=y

CONFIG_BT_DIS=y
CONFIG_BT_DIS_PNP=y
CONFIG_BT_DIS_MANUF="Ultimate Gadget Laboratories"
CONFIG_BT_DIS_PNP_VID_SRC=2
CONFIG_BT_DIS_PNP_VID=0x1915
CONFIG_BT_DIS_PNP_PID=0xEEEF
CONFIG_BT_DIS_PNP_VER=0x0100

CONFIG_BT_SETTINGS=y
CONFIG_FLASH=y
CONFIG_FLASH_PAGE_LAYOUT=y
CONFIG_FLASH_MAP=y
CONFIG_NVS=y
CONFIG_SETTINGS=y

CONFIG_SERIAL=y

CONFIG_SPI=y

CONFIG_CONSOLE=y
CONFIG_UART_CONSOLE=y
CONFIG_UART_LINE_CTRL=y
CONFIG_UART_INTERRUPT_DRIVEN=y

CONFIG_SHELL=y
CONFIG_HWINFO=y
CONFIG_HWINFO_SHELL=y
CONFIG_I2C=y
CONFIG_I2C_DUMP_MESSAGES=y
CONFIG_I2C_SHELL=y
CONFIG_MCUBOOT_IMG_MANAGER=y
CONFIG_STREAM_FLASH=y
CONFIG_IMG_MANAGER=y
CONFIG_MCUBOOT_SHELL=y
CONFIG_SETTINGS_SHELL=y
CONFIG_SHELL_BACKENDS=y

CONFIG_USE_SEGGER_RTT=y
CONFIG_RTT_CONSOLE=y
CONFIG_SHELL_BACKEND_RTT=y
CONFIG_LOG_BACKEND_RTT=y
```

## src/main.cpp
```c
#include <zephyr/shell/shell.h>
extern "C"
{
#include <stdio.h>
#include <zephyr/kernel.h>
#include <zephyr/device.h>
#include <zephyr/drivers/gpio.h>
#include <zephyr/drivers/uart.h>
#include <zephyr/usb/class/usb_hid.h>
#include <zephyr/drivers/spi.h>
#include <zephyr/drivers/i2c.h>

#include <zephyr/types.h>
#include <stddef.h>
#include <stdlib.h>
#include <string.h>
#include <errno.h>
#include <zephyr/sys/printk.h>
#include <zephyr/sys/byteorder.h>
#include <soc.h>
#include <assert.h>

#include "bluetooth.h"
}
#include "usb.hpp"
#include <zephyr/drivers/adc.h>

#define DEVICE_ID_UHK60V1_RIGHT 1
#define DEVICE_ID_UHK60V2_RIGHT 2
#define DEVICE_ID_UHK80_LEFT 3
#define DEVICE_ID_UHK80_RIGHT 4

#if CONFIG_DEVICE_ID == DEVICE_ID_UHK60V1_RIGHT
    #define DEVICE_NAME "UHK 60 v1 right half"
#elif CONFIG_DEVICE_ID == DEVICE_ID_UHK60V2_RIGHT
    #define DEVICE_NAME "UHK 60 v2 right half"
#elif CONFIG_DEVICE_ID == DEVICE_ID_UHK80_LEFT
    #define DEVICE_NAME "UHK 80 right half"
#elif CONFIG_DEVICE_ID == DEVICE_ID_UHK80_RIGHT
    #define DEVICE_NAME "UHK 80 right half"
#endif

#if CONFIG_DEVICE_ID == DEVICE_ID_UHK80_LEFT
    #define HAS_MERGE_SENSE
#endif

#if CONFIG_DEVICE_ID == DEVICE_ID_UHK80_RIGHT
    #define HAS_OLED
#endif

#define DT_SPEC_AND_COMMA(node_id, prop, idx) \
    ADC_DT_SPEC_GET_BY_IDX(node_id, idx),

static const struct adc_dt_spec adc_channels[] = {
    DT_FOREACH_PROP_ELEM(DT_PATH(zephyr_user), io_channels, DT_SPEC_AND_COMMA)
};

#define LedPagePrefix 0b01010000

static struct spi_config spiConf = {
    .frequency = 400000U,
    .operation = (SPI_OP_MODE_MASTER | SPI_WORD_SET(8) | SPI_TRANSFER_MSB)
};

uint8_t buf[] = {1};
const struct spi_buf spiBuf[] = {
    {
        .buf = &buf,
        .len = 1,
    }
};

const struct spi_buf_set spiBufSet = {
    .buffers = spiBuf,
    .count = 1,
};

const struct device *spi0_dev = DEVICE_DT_GET(DT_NODELABEL(spi1));
static const struct gpio_dt_spec ledsCsDt = GPIO_DT_SPEC_GET(DT_ALIAS(leds_cs), gpios);
static const struct gpio_dt_spec ledsSdbDt = GPIO_DT_SPEC_GET(DT_ALIAS(leds_sdb), gpios);
static const struct gpio_dt_spec chargerEnDt = GPIO_DT_SPEC_GET(DT_ALIAS(charger_en), gpios);
static const struct gpio_dt_spec chargerStatDt = GPIO_DT_SPEC_GET(DT_ALIAS(charger_stat), gpios);

#ifdef HAS_OLED
static const struct gpio_dt_spec oledEn = GPIO_DT_SPEC_GET(DT_ALIAS(oled_en), gpios);
static const struct gpio_dt_spec oledResetDt = GPIO_DT_SPEC_GET(DT_ALIAS(oled_reset), gpios);
static const struct gpio_dt_spec oledCsDt = GPIO_DT_SPEC_GET(DT_ALIAS(oled_cs), gpios);
static const struct gpio_dt_spec oledA0Dt = GPIO_DT_SPEC_GET(DT_ALIAS(oled_a0), gpios);

void setOledCs(bool state)
{
    gpio_pin_set_dt(&oledCsDt, state);
}

void setA0(bool state)
{
    gpio_pin_set_dt(&oledA0Dt, state);
}

#endif

void setLedsCs(bool state)
{
    gpio_pin_set_dt(&ledsCsDt, state);
}

void writeSpi(uint8_t data)
{
    buf[0] = data;
    spi_write(spi0_dev, &spiConf, &spiBufSet);
}

static const struct device *uart_dev = DEVICE_DT_GET(DT_NODELABEL(uart1));

char bufferIn[20];
char *ch = bufferIn;
void serial_cb(const struct device *dev, void *user_data)
{
    if (!uart_irq_update(uart_dev)) {
        return;
    }

    while (uart_irq_rx_ready(uart_dev)) {
        // put characters into bufferI until newline, at which point printk() the buffer and clear it
        uart_fifo_read(uart_dev, (uint8_t*)ch, 1);
        if (*ch == '\n') {
            printk("got %s", bufferIn);
            ch = bufferIn;
        } else {
            ch++;
        }
    }
}

static struct gpio_dt_spec rows[] = {
    GPIO_DT_SPEC_GET(DT_ALIAS(row1), gpios),
    GPIO_DT_SPEC_GET(DT_ALIAS(row2), gpios),
    GPIO_DT_SPEC_GET(DT_ALIAS(row3), gpios),
    GPIO_DT_SPEC_GET(DT_ALIAS(row4), gpios),
    GPIO_DT_SPEC_GET(DT_ALIAS(row5), gpios),
    GPIO_DT_SPEC_GET(DT_ALIAS(row6), gpios),
};

static struct gpio_dt_spec cols[] = {
    GPIO_DT_SPEC_GET(DT_ALIAS(col1), gpios),
    GPIO_DT_SPEC_GET(DT_ALIAS(col2), gpios),
    GPIO_DT_SPEC_GET(DT_ALIAS(col3), gpios),
    GPIO_DT_SPEC_GET(DT_ALIAS(col4), gpios),
    GPIO_DT_SPEC_GET(DT_ALIAS(col5), gpios),
    GPIO_DT_SPEC_GET(DT_ALIAS(col6), gpios),
    GPIO_DT_SPEC_GET(DT_ALIAS(col7), gpios),
#if CONFIG_DEVICE_ID == DEVICE_ID_UHK80_RIGHT
    GPIO_DT_SPEC_GET(DT_ALIAS(col8), gpios),
    GPIO_DT_SPEC_GET(DT_ALIAS(col9), gpios),
    GPIO_DT_SPEC_GET(DT_ALIAS(col10), gpios),
#endif
};

#define COLS_COUNT (sizeof(cols) / sizeof(cols[0]))

// Shell functions

uint8_t keyLog = 1;
static int cmd_uhk_keylog(const struct shell *shell, size_t argc, char *argv[])
{
    if (argc == 1) {
        shell_fprintf(shell, SHELL_NORMAL, "%i\n", keyLog);
    } else {
        keyLog = argv[1][0] == '1';
    }
    return 0;
}

uint8_t statLog = 1;
static int cmd_uhk_statlog(const struct shell *shell, size_t argc, char *argv[])
{
    if (argc == 1) {
        shell_fprintf(shell, SHELL_NORMAL, "%i\n", statLog);
    } else {
        statLog = argv[1][0] == '1';
    }
    return 0;
}

uint8_t ledsAlwaysOn = 0;
static int cmd_uhk_leds(const struct shell *shell, size_t argc, char *argv[])
{
    if (argc == 1) {
        shell_fprintf(shell, SHELL_NORMAL, "%i\n", ledsAlwaysOn);
    } else {
        ledsAlwaysOn = argv[1][0] == '1';
    }
    return 0;
}

uint8_t sdbState = 1;
static int cmd_uhk_sdb(const struct shell *shell, size_t argc, char *argv[])
{
    if (argc == 1) {
        shell_fprintf(shell, SHELL_NORMAL, "%i\n", sdbState ? 1 : 0);
    } else {
        sdbState = argv[1][0] == '1';
        gpio_pin_set_dt(&ledsSdbDt, sdbState);
    }
    return 0;
}

// Charger behavior:
// - If CHARGER_EN=0 or USB is disconnected, then TS reads 6552[0-9] raw value and sometimes drops to 0.
// - If CHARGER_EN=1, USB is connected, and the battery is disconnected, then STAT alternates between 0 and 1 per second

uint8_t chargerState = 1;
static int cmd_uhk_charger(const struct shell *shell, size_t argc, char *argv[])
{
    if (argc == 1) {
        shell_fprintf(shell, SHELL_NORMAL, "CHARGER_EN: %i | ", chargerState ? 1 : 0);
        shell_fprintf(shell, SHELL_NORMAL, "STAT: %i", gpio_pin_get_dt(&chargerStatDt) ? 1 : 0);

        int err;
        uint16_t buf;
        struct adc_sequence sequence = {
            .buffer = &buf,
            .buffer_size = sizeof(buf),
        };

        for (size_t i = 0U; i < ARRAY_SIZE(adc_channels); i++) {
            int32_t val_mv;

            printk(" | ");
            printk(i ? "VBAT" : "TS");

            (void)adc_sequence_init_dt(&adc_channels[i], &sequence);

            err = adc_read(adc_channels[i].dev, &sequence);
            if (err < 0) {
                printk("Could not read (%d)\n", err);
                continue;
            }

            // If using differential mode, the 16 bit value
            // in the ADC sample buffer should be a signed 2's
            // complement value.
            if (adc_channels[i].channel_cfg.differential) {
                val_mv = (int32_t)((int16_t)buf);
            } else {
                val_mv = (int32_t)buf;
            }
            printk(": %d", val_mv);
            err = adc_raw_to_millivolts_dt(&adc_channels[i], &val_mv);
            // conversion to mV may not be supported, skip if not
            if (err < 0) {
                printk(" (value in mV not available)");
            } else {
                printk(" = %d mV", val_mv);
            }
        }
        printk("\n");
    } else {
        chargerState = argv[1][0] == '1';
        gpio_pin_set_dt(&chargerEnDt, chargerState);
    }
    return 0;
}

#ifdef HAS_OLED
uint8_t oledState = 1;
static int cmd_uhk_oled(const struct shell *shell, size_t argc, char *argv[])
{
    if (argc == 1) {
        shell_fprintf(shell, SHELL_NORMAL, "%i\n", oledState ? 1 : 0);
    } else {
        oledState = argv[1][0] == '1';
        gpio_pin_set_dt(&oledEn, oledState);
    }
    return 0;
}
#endif

#ifdef HAS_MERGE_SENSE
static const struct gpio_dt_spec mergeSenseDt = GPIO_DT_SPEC_GET(DT_ALIAS(merge_sense), gpios);

static int cmd_uhk_merge(const struct shell *shell, size_t argc, char *argv[])
{
    shell_fprintf(shell, SHELL_NORMAL, "%i\n", gpio_pin_get_dt(&mergeSenseDt) ? 1 : 0);
    return 0;
}
#endif

void chargerStatCallback(const struct device *port, struct gpio_callback *cb, gpio_port_pins_t pins) {
    if (statLog) {
        printk("STAT changed to %i\n", gpio_pin_get_dt(&chargerStatDt) ? 1 : 0);
    }
}

struct gpio_callback callbackStruct;

volatile char keyPressed;

int main(void) {
    printk("----------\n" DEVICE_NAME " started\n");

    // Configure GPIOs

    gpio_pin_configure_dt(&ledsCsDt, GPIO_OUTPUT);

    gpio_pin_configure_dt(&ledsSdbDt, GPIO_OUTPUT);
    gpio_pin_set_dt(&ledsSdbDt, true);

    gpio_pin_configure_dt(&chargerEnDt, GPIO_OUTPUT);
    gpio_pin_set_dt(&chargerEnDt, true);

    gpio_pin_configure_dt(&chargerStatDt, GPIO_INPUT);
    gpio_pin_interrupt_configure_dt(&chargerStatDt, GPIO_INT_EDGE_BOTH);
    gpio_init_callback(&callbackStruct, chargerStatCallback, BIT(chargerStatDt.pin));
    gpio_add_callback(chargerStatDt.port, &callbackStruct);

#ifdef HAS_OLED
    gpio_pin_configure_dt(&oledEn, GPIO_OUTPUT);
    gpio_pin_set_dt(&oledEn, true);

    gpio_pin_configure_dt(&oledResetDt, GPIO_OUTPUT);
    gpio_pin_set_dt(&oledResetDt, false);
    k_msleep(1);
    gpio_pin_set_dt(&oledResetDt, true);

    gpio_pin_configure_dt(&oledCsDt, GPIO_OUTPUT);
    gpio_pin_configure_dt(&oledA0Dt, GPIO_OUTPUT);
#endif

    struct device *uart_dev = DEVICE_DT_GET(DT_NODELABEL(uart1));

    for (uint8_t rowId=0; rowId<6; rowId++) {
        gpio_pin_configure_dt(&rows[rowId], GPIO_OUTPUT);
    }
    for (uint8_t colId=0; colId<COLS_COUNT; colId++) {
        gpio_pin_configure_dt(&cols[colId], GPIO_INPUT);
    }

#ifdef HAS_MERGE_SENSE
    gpio_pin_configure_dt(&mergeSenseDt, GPIO_INPUT);
#endif

    // Create shell commands

    SHELL_STATIC_SUBCMD_SET_CREATE(
        uhk_cmds,
        SHELL_CMD_ARG(keylog, NULL,
            "get/set key logging",
            cmd_uhk_keylog, 1, 1),
        SHELL_CMD_ARG(statlog, NULL,
            "get/set stat logging",
            cmd_uhk_statlog, 1, 1),
        SHELL_CMD_ARG(leds, NULL,
            "get/set LEDs always on state",
            cmd_uhk_leds, 1, 1),
        SHELL_CMD_ARG(sdb, NULL,
            "get/set LED driver SDB pin",
            cmd_uhk_sdb, 1, 1),
        SHELL_CMD_ARG(charger, NULL,
            "get/set CHARGER_EN pin",
            cmd_uhk_charger, 1, 1),
#ifdef HAS_OLED
        SHELL_CMD_ARG(oled, NULL,
            "get/set OLED_EN pin",
            cmd_uhk_oled, 1, 1),
#endif
#ifdef HAS_MERGE_SENSE
        SHELL_CMD_ARG(merge, NULL,
            "get the merged state of UHK halves",
            cmd_uhk_merge, 1, 0),
#endif
        SHELL_SUBCMD_SET_END
    );

    SHELL_CMD_REGISTER(uhk, &uhk_cmds, "UHK commands", NULL);

    // Init I2C
#if CONFIG_DEVICE_ID == DEVICE_ID_UHK80_LEFT
    #define device_addr 0x18 // left module i2c address
#elif CONFIG_DEVICE_ID == DEVICE_ID_UHK80_RIGHT
    #define device_addr 0x28 // right module i2c address
#endif

    uint8_t tx_buf[] = {0x00,0x00};
    uint8_t rx_buf[10] = {0};

    int ret;
    static const struct device *i2c0_dev = DEVICE_DT_GET(DT_NODELABEL(i2c0));
    k_msleep(50);
    if (!device_is_ready(i2c0_dev)) {
        printk("I2C bus %s is not ready!\n",i2c0_dev->name);
    }

    ret = i2c_write_read(i2c0_dev, device_addr, tx_buf, 2, rx_buf, 7);
    if (ret != 0) {
        printk("write-read fail\n");
    }
    printk("sync: %.7s\n", rx_buf);

    // Init ADC channels
    for (size_t i = 0U; i < ARRAY_SIZE(adc_channels); i++) {
        if (!device_is_ready(adc_channels[i].dev)) {
            printk("ADC controller device %s not ready\n", adc_channels[i].dev->name);
            return 0;
        }
        int err;
        err = adc_channel_setup_dt(&adc_channels[i]);
        if (err < 0) {
            printk("Could not setup channel #%d (%d)\n", i, err);
            return 0;
        }
    }

    if (!device_is_ready(uart_dev)) {
        printk("UART device not found!");
        return 1;
    }

    // dk_buttons_init(button_changed);
    // dk_leds_init();

    usb_init(true);
    bluetooth_init();

    uart_irq_callback_user_data_set(uart_dev, serial_cb, NULL);
    uart_irq_rx_enable(uart_dev);
//  int blink_status = 0;
    uint32_t counter = 0;
    bool pixel = 1;

    for (;;) {
        keyPressed = false;
        for (uint8_t rowId=0; rowId<6; rowId++) {
            gpio_pin_set_dt(&rows[rowId], 1);
            for (uint8_t colId=0; colId<COLS_COUNT; colId++) {
                if (gpio_pin_get_dt(&cols[colId])) {
                    keyPressed = true;
                    if (keyLog) {
                        char buffer[20];
                        sprintf(buffer, "SW%c%c\n", rowId+'1', colId+'1');
                        printk("%s", buffer);
                        for (uint8_t i=0; i<strlen(buffer); i++) {
                            uart_poll_out(uart_dev, buffer[i]);
                        }
                    }
                }
            }
            gpio_pin_set_dt(&rows[rowId], 0);
        }

        #ifdef HAS_OLED
        setA0(false);
        setOledCs(false);
        writeSpi(0xaf);
        setOledCs(true);

        setA0(false);
        setOledCs(false);
        writeSpi(0x81);
        writeSpi(0xff);
        setOledCs(true);

        setA0(true);
        setOledCs(false);
        writeSpi(pixel ? 0xff : 0x00);
        setOledCs(true);
        #endif

        setLedsCs(false);
        writeSpi(LedPagePrefix | 2);
        writeSpi(0x00);
        writeSpi(0b00001001);
        setLedsCs(true);

        setLedsCs(false);
        writeSpi(LedPagePrefix | 2);
        writeSpi(0x01);
        writeSpi(0xff);
        setLedsCs(true);

        setLedsCs(false);
        writeSpi(LedPagePrefix | 0);
        writeSpi(0x00);
        for (int i=0; i<255; i++) {
            writeSpi(keyPressed || ledsAlwaysOn ? 0xff : 0);
        }
        setLedsCs(true);

        setLedsCs(false);
        writeSpi(LedPagePrefix | 1);
        writeSpi(0x00);
        for (int i=0; i<255; i++) {
            writeSpi(keyPressed || ledsAlwaysOn ? 0xff : 0);
        }
        setLedsCs(true);

//      bluetooth_set_adv_led(&blink_status);
//      k_sleep(K_MSEC(ADV_LED_BLINK_INTERVAL));
        // Battery level simulation
        bas_notify();

        if (counter++ > 19) {
            pixel = !pixel;
            counter = 0;
        }
    }
}
```

## src/bluetooth.c
```c
#include <zephyr/kernel.h>
#include <zephyr/device.h>
#include <zephyr/drivers/gpio.h>

#include <zephyr/usb/class/usb_hid.h>

#include <zephyr/types.h>
#include <stddef.h>
#include <string.h>
#include <errno.h>
#include <zephyr/sys/printk.h>
#include <zephyr/sys/byteorder.h>
#include <soc.h>
#include <assert.h>
#include <zephyr/spinlock.h>

#include <zephyr/settings/settings.h>

#include <zephyr/bluetooth/bluetooth.h>
#include <zephyr/bluetooth/hci.h>
#include <zephyr/bluetooth/conn.h>
#include <zephyr/bluetooth/uuid.h>
#include <zephyr/bluetooth/gatt.h>

#include <zephyr/bluetooth/services/bas.h>
#include <bluetooth/services/hids.h>
#include <zephyr/bluetooth/services/dis.h>
#include <dk_buttons_and_leds.h>

#define DEVICE_NAME     CONFIG_BT_DEVICE_NAME
#define DEVICE_NAME_LEN (sizeof(DEVICE_NAME) - 1)

#define BASE_USB_HID_SPEC_VERSION   0x0101

#define OUTPUT_REPORT_MAX_LEN            1
#define OUTPUT_REPORT_BIT_MASK_CAPS_LOCK 0x02
#define INPUT_REP_KEYS_REF_ID            1
#define OUTPUT_REP_KEYS_REF_ID           1
#define SCAN_CODE_POS                    2
#define KEYS_MAX_LEN                    (INPUT_REPORT_KEYS_MAX_LEN - SCAN_CODE_POS)

#define ADV_STATUS_LED DK_LED1
#define CON_STATUS_LED DK_LED2
#define LED_CAPS_LOCK  DK_LED3
#define KEY_TEXT_MASK  DK_BTN1_MSK

// Key used to accept or reject passkey value
#define KEY_PAIRING_ACCEPT DK_BTN1_MSK
#define KEY_PAIRING_REJECT DK_BTN2_MSK

static volatile bool is_adv;

static const struct bt_data ad[] = {
    BT_DATA_BYTES(BT_DATA_GAP_APPEARANCE,
              (CONFIG_BT_DEVICE_APPEARANCE >> 0) & 0xff,
              (CONFIG_BT_DEVICE_APPEARANCE >> 8) & 0xff),
    BT_DATA_BYTES(BT_DATA_FLAGS, (BT_LE_AD_GENERAL | BT_LE_AD_NO_BREDR)),
    BT_DATA_BYTES(BT_DATA_UUID16_ALL, BT_UUID_16_ENCODE(BT_UUID_HIDS_VAL),
                      BT_UUID_16_ENCODE(BT_UUID_BAS_VAL)),
};

static const struct bt_data sd[] = {
    BT_DATA(BT_DATA_NAME_COMPLETE, DEVICE_NAME, DEVICE_NAME_LEN),
};

static struct {
    struct bt_conn *conn;
    bool in_boot_mode;
} conn_mode;

struct {
    struct bt_conn *conn;
    unsigned int passkey;
} pairing_data;

static void advertising_start(void) {
    struct bt_le_adv_param *adv_param = BT_LE_ADV_PARAM(
                        BT_LE_ADV_OPT_CONNECTABLE | BT_LE_ADV_OPT_ONE_TIME,
                        BT_GAP_ADV_FAST_INT_MIN_2,
                        BT_GAP_ADV_FAST_INT_MAX_2,
                        NULL);

    int err = bt_le_adv_start(adv_param, ad, ARRAY_SIZE(ad), sd, ARRAY_SIZE(sd));
    if (err) {
        if (err == -EALREADY) {
            printk("Advertising continued\n");
        } else {
            printk("Advertising failed to start (err %d)\n", err);
        }

        return;
    }

    is_adv = true;
    printk("Advertising successfully started\n");
}

static void pairing_process() {
    if (!pairing_data.conn) {
        return;
    }

    char addr[BT_ADDR_LE_STR_LEN];
    bt_addr_le_to_str(bt_conn_get_dst(pairing_data.conn), addr, sizeof(addr));
    printk("Passkey for %s: %06u\n", addr, pairing_data.passkey);
    printk("Press Button 1 to confirm, Button 2 to reject.\n");
}

// HID init

static void caps_lock_handler(const struct bt_hids_rep *rep) {
    uint8_t report_val = ((*rep->data) & OUTPUT_REPORT_BIT_MASK_CAPS_LOCK) ? 1 : 0;
    dk_set_led(LED_CAPS_LOCK, report_val);
}

static void hids_outp_rep_handler(struct bt_hids_rep *rep, struct bt_conn *conn, bool write) {
    char addr[BT_ADDR_LE_STR_LEN];

    if (!write) {
        printk("Output report read\n");
        return;
    };

    bt_addr_le_to_str(bt_conn_get_dst(conn), addr, sizeof(addr));
    printk("Output report has been received %s\n", addr);
    caps_lock_handler(rep);
}

static void hids_boot_kb_outp_rep_handler(struct bt_hids_rep *rep, struct bt_conn *conn, bool write) {
    char addr[BT_ADDR_LE_STR_LEN];

    if (!write) {
        printk("Output report read\n");
        return;
    };

    bt_addr_le_to_str(bt_conn_get_dst(conn), addr, sizeof(addr));
    printk("Boot Keyboard Output report has been received %s\n", addr);
    caps_lock_handler(rep);
}

static void hids_pm_evt_handler(enum bt_hids_pm_evt evt, struct bt_conn *conn) {
    char addr[BT_ADDR_LE_STR_LEN];

    if (conn_mode.conn != conn) {
        printk("Cannot find connection handle when processing PM");
        return;
    }

    bt_addr_le_to_str(bt_conn_get_dst(conn), addr, sizeof(addr));

    switch (evt) {
    case BT_HIDS_PM_EVT_BOOT_MODE_ENTERED:
        printk("Boot mode entered %s\n", addr);
        conn_mode.in_boot_mode = true;
        break;
    case BT_HIDS_PM_EVT_REPORT_MODE_ENTERED:
        printk("Report mode entered %s\n", addr);
        conn_mode.in_boot_mode = false;
        break;
    default:
        break;
    }
}

// Bluetooth keyboard

// Note: The configuration below is the same as BOOT mode configuration
// This simplifies the code as the BOOT mode is the same as REPORT mode.
// Changing this configuration would require separate implementation of
// BOOT mode report generation.
#define KEY_PRESS_MAX 6 // Maximum number of non-control keys pressed simultaneously

// Number of bytes in key report
//
// 1 byte: modifier keys
// 1 byte: reserved
// rest: non-control keys
#define INPUT_REPORT_KEYS_MAX_LEN (1 + 1 + KEY_PRESS_MAX)

// INPUT report internal indexes.
// This is a position in internal report table and is not related to report ID.
enum {
    INPUT_REP_KEYS_IDX = 0
};

BT_HIDS_DEF(hids_keyboard_obj,
        OUTPUT_REPORT_MAX_LEN,
        INPUT_REPORT_KEYS_MAX_LEN);

static void hid_keyboard_init(void) {
    static const uint8_t report_map[] = {
        0x05, 0x01,       // Usage Page (Generic Desktop)
        0x09, 0x06,       // Usage (Keyboard)
        0xA1, 0x01,       // Collection (Application)

        // Keys
#if INPUT_REP_KEYS_REF_ID
        0x85, INPUT_REP_KEYS_REF_ID,
#endif
        0x05, 0x07,       // Usage Page (Key Codes)
        0x19, 0xe0,       // Usage Minimum (224)
        0x29, 0xe7,       // Usage Maximum (231)
        0x15, 0x00,       // Logical Minimum (0)
        0x25, 0x01,       // Logical Maximum (1)
        0x75, 0x01,       // Report Size (1)
        0x95, 0x08,       // Report Count (8)
        0x81, 0x02,       // Input (Data, Variable, Absolute)

        0x95, 0x01,       // Report Count (1)
        0x75, 0x08,       // Report Size (8)
        0x81, 0x01,       // Input (Constant) reserved byte(1)

        0x95, 0x06,       // Report Count (6)
        0x75, 0x08,       // Report Size (8)
        0x15, 0x00,       // Logical Minimum (0)
        0x25, 0x65,       // Logical Maximum (101)
        0x05, 0x07,       // Usage Page (Key codes)
        0x19, 0x00,       // Usage Minimum (0)
        0x29, 0x65,       // Usage Maximum (101)
        0x81, 0x00,       // Input (Data, Array) Key array(6 bytes)

        // LED
#if OUTPUT_REP_KEYS_REF_ID
        0x85, OUTPUT_REP_KEYS_REF_ID,
#endif
        0x95, 0x05,       // Report Count (5)
        0x75, 0x01,       // Report Size (1)
        0x05, 0x08,       // Usage Page (Page# for LEDs)
        0x19, 0x01,       // Usage Minimum (1)
        0x29, 0x05,       // Usage Maximum (5)
        0x91, 0x02,       // Output (Data, Variable, Absolute),
        // Led report
        0x95, 0x01,       // Report Count (1)
        0x75, 0x03,       // Report Size (3)
        0x91, 0x01,       // Output (Data, Variable, Absolute),
        // Led report padding

        0xC0              // End Collection (Application)
    };

    struct bt_hids_init_param hids_init_obj = {
        .rep_map.data = report_map,
        .rep_map.size = sizeof(report_map),
        .info = {
            .bcd_hid = BASE_USB_HID_SPEC_VERSION,
            .b_country_code = 0x00,
            .flags = BT_HIDS_REMOTE_WAKE | BT_HIDS_NORMALLY_CONNECTABLE,
        },
        .inp_rep_group_init = {
            .reports = {
                {
                    .size = INPUT_REPORT_KEYS_MAX_LEN,
                    .id = INPUT_REP_KEYS_REF_ID,
                }
            },
            .cnt = 1,
        },
        .outp_rep_group_init = {
            .reports = {
                {
                    .size = OUTPUT_REPORT_MAX_LEN,
                    .id = OUTPUT_REP_KEYS_REF_ID,
                    .handler = hids_outp_rep_handler,
                }
            },
            .cnt =  1,
        },
        .is_kb = true,
        .boot_kb_outp_rep_handler = hids_boot_kb_outp_rep_handler,
        .pm_evt_handler = hids_pm_evt_handler,
    };

    int err = bt_hids_init(&hids_keyboard_obj, &hids_init_obj);
    __ASSERT(err == 0, "HIDS keyboard initialization failed\n");
}

// Bluetooth mouse

// Length of Mouse Input Report containing button data.
#define INPUT_REP_BUTTONS_LEN       3
// Length of Mouse Input Report containing movement data.
#define INPUT_REP_MOVEMENT_LEN      3
// Length of Mouse Input Report containing media player data.
#define INPUT_REP_MEDIA_PLAYER_LEN  1
// Index of Mouse Input Report containing movement data.
#define INPUT_REP_MOVEMENT_INDEX    1
// Id of reference to Mouse Input Report containing button data.
#define INPUT_REP_REF_BUTTONS_ID    1
// Id of reference to Mouse Input Report containing movement data.
#define INPUT_REP_REF_MOVEMENT_ID   2
// Id of reference to Mouse Input Report containing media player data.
#define INPUT_REP_REF_MPLAYER_ID    3

BT_HIDS_DEF(hids_mouse_obj,
        INPUT_REP_BUTTONS_LEN,
        INPUT_REP_MOVEMENT_LEN,
        INPUT_REP_MEDIA_PLAYER_LEN);

static void hid_mouse_init(void)
{
    static const uint8_t report_map[] = {
        0x05, 0x01,     // Usage Page (Generic Desktop)
        0x09, 0x02,     // Usage (Mouse)

        0xA1, 0x01,     // Collection (Application)

        // Report ID 1: Mouse buttons + scroll/pan
        0x85, 0x01,       // Report Id 1
        0x09, 0x01,       // Usage (Pointer)
        0xA1, 0x00,       // Collection (Physical)
        0x95, 0x05,       // Report Count (3)
        0x75, 0x01,       // Report Size (1)
        0x05, 0x09,       // Usage Page (Buttons)
        0x19, 0x01,       // Usage Minimum (01)
        0x29, 0x05,       // Usage Maximum (05)
        0x15, 0x00,       // Logical Minimum (0)
        0x25, 0x01,       // Logical Maximum (1)
        0x81, 0x02,       // Input (Data, Variable, Absolute)
        0x95, 0x01,       // Report Count (1)
        0x75, 0x03,       // Report Size (3)
        0x81, 0x01,       // Input (Constant) for padding
        0x75, 0x08,       // Report Size (8)
        0x95, 0x01,       // Report Count (1)
        0x05, 0x01,       // Usage Page (Generic Desktop)
        0x09, 0x38,       // Usage (Wheel)
        0x15, 0x81,       // Logical Minimum (-127)
        0x25, 0x7F,       // Logical Maximum (127)
        0x81, 0x06,       // Input (Data, Variable, Relative)
        0x05, 0x0C,       // Usage Page (Consumer)
        0x0A, 0x38, 0x02, // Usage (AC Pan)
        0x95, 0x01,       // Report Count (1)
        0x81, 0x06,       // Input (Data,Value,Relative,Bit Field)
        0xC0,             // End Collection (Physical)

        // Report ID 2: Mouse motion
        0x85, 0x02,       // Report Id 2
        0x09, 0x01,       // Usage (Pointer)
        0xA1, 0x00,       // Collection (Physical)
        0x75, 0x0C,       // Report Size (12)
        0x95, 0x02,       // Report Count (2)
        0x05, 0x01,       // Usage Page (Generic Desktop)
        0x09, 0x30,       // Usage (X)
        0x09, 0x31,       // Usage (Y)
        0x16, 0x01, 0xF8, // Logical maximum (2047)
        0x26, 0xFF, 0x07, // Logical minimum (-2047)
        0x81, 0x06,       // Input (Data, Variable, Relative)
        0xC0,             // End Collection (Physical)
        0xC0,             // End Collection (Application)

        // Report ID 3: Advanced buttons
        0x05, 0x0C,       // Usage Page (Consumer)
        0x09, 0x01,       // Usage (Consumer Control)
        0xA1, 0x01,       // Collection (Application)
        0x85, 0x03,       // Report Id (3)
        0x15, 0x00,       // Logical minimum (0)
        0x25, 0x01,       // Logical maximum (1)
        0x75, 0x01,       // Report Size (1)
        0x95, 0x01,       // Report Count (1)

        0x09, 0xCD,       // Usage (Play/Pause)
        0x81, 0x06,       // Input (Data,Value,Relative,Bit Field)
        0x0A, 0x83, 0x01, // Usage (Consumer Control Configuration)
        0x81, 0x06,       // Input (Data,Value,Relative,Bit Field)
        0x09, 0xB5,       // Usage (Scan Next Track)
        0x81, 0x06,       // Input (Data,Value,Relative,Bit Field)
        0x09, 0xB6,       // Usage (Scan Previous Track)
        0x81, 0x06,       // Input (Data,Value,Relative,Bit Field)

        0x09, 0xEA,       // Usage (Volume Down)
        0x81, 0x06,       // Input (Data,Value,Relative,Bit Field)
        0x09, 0xE9,       // Usage (Volume Up)
        0x81, 0x06,       // Input (Data,Value,Relative,Bit Field)
        0x0A, 0x25, 0x02, // Usage (AC Forward)
        0x81, 0x06,       // Input (Data,Value,Relative,Bit Field)
        0x0A, 0x24, 0x02, // Usage (AC Back)
        0x81, 0x06,       // Input (Data,Value,Relative,Bit Field)
        0xC0              // End Collection
    };

    static const uint8_t mouse_movement_mask[ceiling_fraction(INPUT_REP_MOVEMENT_LEN, 8)] = {0};

    struct bt_hids_init_param hids_init_param = {
        .rep_map = {
            .data = report_map,
            .size = sizeof(report_map),
        },
        .info = {
            .bcd_hid = BASE_USB_HID_SPEC_VERSION,
            .b_country_code = 0x00,
            .flags = BT_HIDS_REMOTE_WAKE | BT_HIDS_NORMALLY_CONNECTABLE,
        },
        .inp_rep_group_init = {
            .reports = {
                {
                    .size = INPUT_REP_BUTTONS_LEN,
                    .id = INPUT_REP_REF_BUTTONS_ID,
                },
                {
                    .size = INPUT_REP_MOVEMENT_LEN,
                    .id = INPUT_REP_REF_MOVEMENT_ID,
                    .rep_mask = mouse_movement_mask,
                },
                {
                    .size = INPUT_REP_MEDIA_PLAYER_LEN,
                    .id = INPUT_REP_REF_MPLAYER_ID,
                },
            },
            .cnt = 3,
        },
        .is_mouse = true,
        .pm_evt_handler = hids_pm_evt_handler,
    };

    int err = bt_hids_init(&hids_mouse_obj, &hids_init_param);
    __ASSERT(err == 0, "HIDS mouse initialization failed\n");
}

// Connection callbacks

static void connected(struct bt_conn *conn, uint8_t err) {
    char addr[BT_ADDR_LE_STR_LEN];
    bt_addr_le_to_str(bt_conn_get_dst(conn), addr, sizeof(addr));

    if (err) {
        printk("Failed to connect to %s (%u)\n", addr, err);
        return;
    }

    printk("Connected %s\n", addr);
    dk_set_led_on(CON_STATUS_LED);

    err = bt_hids_connected(&hids_keyboard_obj, conn);
    if (err) {
        printk("Failed to notify keyboard HID service about connection\n");
        return;
    }

    err = bt_hids_connected(&hids_mouse_obj, conn);
    if (err) {
        printk("Failed to notify mouse HID service about connection\n");
        return;
    }


    if (!conn_mode.conn) {
        conn_mode.conn = conn;
        conn_mode.in_boot_mode = false;
        advertising_start();
    }

    is_adv = false;
}

static void disconnected(struct bt_conn *conn, uint8_t reason) {
    char addr[BT_ADDR_LE_STR_LEN];
    bt_addr_le_to_str(bt_conn_get_dst(conn), addr, sizeof(addr));
    printk("Disconnected from %s (reason %u)\n", addr, reason);

    int err = bt_hids_disconnected(&hids_keyboard_obj, conn);
    if (err) {
        printk("Failed to notify keyboard HID service about disconnection\n");
    }

    err = bt_hids_disconnected(&hids_mouse_obj, conn);
    if (err) {
        printk("Failed to notify mouse HID service about disconnection\n");
    }

    conn_mode.conn = NULL;
    dk_set_led_off(CON_STATUS_LED);
    advertising_start();
}

static void security_changed(struct bt_conn *conn, bt_security_t level, enum bt_security_err err) {
    char addr[BT_ADDR_LE_STR_LEN];
    bt_addr_le_to_str(bt_conn_get_dst(conn), addr, sizeof(addr));

    if (!err) {
        printk("Security changed: %s level %u\n", addr, level);
    } else {
        printk("Security failed: %s level %u err %d\n", addr, level, err);
    }
}

BT_CONN_CB_DEFINE(conn_callbacks) = {
    .connected = connected,
    .disconnected = disconnected,
    .security_changed = security_changed,
};

// Auth callbacks

static void auth_passkey_display(struct bt_conn *conn, unsigned int passkey) {
    char addr[BT_ADDR_LE_STR_LEN];
    bt_addr_le_to_str(bt_conn_get_dst(conn), addr, sizeof(addr));
    printk("Passkey for %s: %06u\n", addr, passkey);
}

static void auth_passkey_confirm(struct bt_conn *conn, unsigned int passkey) {
    pairing_data.conn    = bt_conn_ref(conn);
    pairing_data.passkey = passkey;
    pairing_process();
}

static void auth_cancel(struct bt_conn *conn) {
    char addr[BT_ADDR_LE_STR_LEN];
    bt_addr_le_to_str(bt_conn_get_dst(conn), addr, sizeof(addr));
    printk("Pairing cancelled: %s\n", addr);
}

static struct bt_conn_auth_cb conn_auth_callbacks = {
    .passkey_display = auth_passkey_display,
    .passkey_confirm = auth_passkey_confirm,
    .cancel = auth_cancel,
};

// Auth info callbacks

static void pairing_complete(struct bt_conn *conn, bool bonded) {
    char addr[BT_ADDR_LE_STR_LEN];
    bt_addr_le_to_str(bt_conn_get_dst(conn), addr, sizeof(addr));
    printk("Pairing completed: %s, bonded: %d\n", addr, bonded);
}

static void pairing_failed(struct bt_conn *conn, enum bt_security_err reason) {
    if (!pairing_data.conn) {
        return;
    }

    if (pairing_data.conn == conn) {
        bt_conn_unref(pairing_data.conn);
        pairing_data.conn = NULL;
    }

    char addr[BT_ADDR_LE_STR_LEN];
    bt_addr_le_to_str(bt_conn_get_dst(conn), addr, sizeof(addr));
    printk("Pairing failed conn: %s, reason %d\n", addr, reason);
}

static struct bt_conn_auth_info_cb conn_auth_info_callbacks = {
    .pairing_complete = pairing_complete,
    .pairing_failed = pairing_failed
};

void key_report_send(bool down) {
    if (!conn_mode.conn) {
        return;
    }

    uint8_t chr = down ? HID_KEY_A : 0;
    uint8_t data[INPUT_REPORT_KEYS_MAX_LEN] = {0 /* modifiers */, 0, chr, 0, 0, 0, 0, 0};

    int keyboard_err = 0;
    int mouse_err = 0;
    if (conn_mode.in_boot_mode) {
        keyboard_err = bt_hids_boot_kb_inp_rep_send(&hids_keyboard_obj, conn_mode.conn, data, sizeof(data), NULL);
        mouse_err = bt_hids_boot_mouse_inp_rep_send(&hids_mouse_obj, conn_mode.conn, NULL, 5, 0, NULL);
    } else {
        uint8_t buffer[INPUT_REP_MOVEMENT_LEN] = {0, 0, 5};
        keyboard_err = bt_hids_inp_rep_send(&hids_keyboard_obj, conn_mode.conn, INPUT_REP_KEYS_IDX, data, sizeof(data), NULL);
        mouse_err = bt_hids_inp_rep_send(&hids_mouse_obj, conn_mode.conn, INPUT_REP_MOVEMENT_INDEX, buffer, sizeof(buffer), NULL);
    }

    if (keyboard_err) {
        printk("Key report send error: %d\n", keyboard_err);
    }
    if (mouse_err) {
        printk("Mouse report send error: %d\n", mouse_err);
    }
}

static void num_comp_reply(bool accept) {
    struct bt_conn *conn;

    if (!pairing_data.conn) {
        return;
    }

    conn = pairing_data.conn;

    if (accept) {
        bt_conn_auth_passkey_confirm(conn);
        printk("Numeric Match, conn %p\n", conn);
    } else {
        bt_conn_auth_cancel(conn);
        printk("Numeric Reject, conn %p\n", conn);
    }

    bt_conn_unref(pairing_data.conn);
    pairing_data.conn = NULL;
}

void button_changed(uint32_t button_state, uint32_t has_changed) {
    static bool pairing_button_pressed;

    uint32_t buttons = button_state & has_changed;

    if (pairing_data.conn) {
        if (buttons & KEY_PAIRING_ACCEPT) {
            pairing_button_pressed = true;
            num_comp_reply(true);
            return;
        }

        if (buttons & KEY_PAIRING_REJECT) {
            pairing_button_pressed = true;
            num_comp_reply(false);
            return;
        }
    }

    // Do not take any action if the pairing button is released.
    if (pairing_button_pressed && (has_changed & (KEY_PAIRING_ACCEPT | KEY_PAIRING_REJECT))) {
        pairing_button_pressed = false;
        return;
    }

    if (has_changed & KEY_TEXT_MASK) {
        key_report_send((button_state & KEY_TEXT_MASK) != 0);
    }
}

void bas_notify(void) {
    uint8_t battery_level = bt_bas_get_battery_level();

    battery_level--;

    if (!battery_level) {
        battery_level = 100U;
    }

    bt_bas_set_battery_level(battery_level);
}

void bluetooth_set_adv_led(int *blink_status) {
    if (is_adv) {
        dk_set_led(ADV_STATUS_LED, (++*blink_status) % 2);
    } else {
        dk_set_led_off(ADV_STATUS_LED);
    }
}

void bluetooth_init() {
    printk("Starting Bluetooth Peripheral HIDS keyboard\n");

    bt_conn_auth_cb_register(&conn_auth_callbacks);
    bt_conn_auth_info_cb_register(&conn_auth_info_callbacks);
    bt_enable(NULL);

    printk("Bluetooth initialized\n");

    settings_load();
    hid_keyboard_init();
    hid_mouse_init();

    advertising_start();
}
```

## src/command_app.cpp
```c
#include "command_app.hpp"
#include "hid/rdf/descriptor.hpp"
#include "hid/report_protocol.hpp"

namespace hid::page
{
    enum class ugl : usage_id_type;
    template<>
    struct info<ugl>
    {
        constexpr static usage_id_type base_id = 0xFF000000;
        constexpr static usage_id_type max_usage = 0x0003 | base_id;
        constexpr static const char* name = "UGL";
    };
    enum class ugl : usage_id_type
    {
        COMMAND_APP = 0x0001 | info<ugl>::base_id,
        COMMAND_DATA_IN = 0x0002 | info<ugl>::base_id,
        COMMAND_DATA_OUT = 0x0003 | info<ugl>::base_id,
    };
}
const hid::report_protocol& command_app::report_protocol()
{
    using namespace hid::page;
    using namespace hid::rdf;

    static constexpr auto rd = descriptor(
        usage_page<ugl>(),
        usage(ugl::COMMAND_APP),
        collection::application(
            conditional_report_id<REPORT_ID>(),
            report_size(8),
            report_count(MESSAGE_SIZE),
            logical_limits<1, 1>(0, 0xff),
            usage(ugl::COMMAND_DATA_IN),
            input::buffered_variable(),
            usage(ugl::COMMAND_DATA_OUT),
            output::buffered_variable()
        )
    );
    static constexpr hid::report_protocol rp {rd};
    return rp;
}

command_app& command_app::handle()
{
    static command_app app{};
    return app;
}

void command_app::start(hid::protocol prot)
{
    // start receiving reports
    receive_report(&out_buffer_);
}

void command_app::set_report(hid::report::type type, const std::span<const uint8_t>& data)
{
    // only one report is receivable
    const auto& data_to_pass = out_buffer_.payload;
    // TODO: call UsbProtocolHandler()

    // always keep receiving new reports
    // if the report data is processed immediately, the same buffer can be used
    receive_report(&out_buffer_);
}

void command_app::get_report(hid::report::selector select, const std::span<uint8_t>& buffer)
{
    // fetching the IN report this way doesn't make sense
    send_report(std::span<const uint8_t>());
}
```

## src/controls_app.cpp
```c
#include "controls_app.hpp"
#include "hid/rdf/descriptor.hpp"
#include "hid/report_protocol.hpp"

const hid::report_protocol& controls_app::report_protocol()
{
    using namespace hid;
    using namespace hid::page;
    using namespace hid::rdf;

    static constexpr auto rd = descriptor(
        usage_page<consumer>(),
        usage(consumer::CONSUMER_CONTROL),
        collection::application(
            report_size(sizeof(std::declval<controls_report>().consumer_codes[0]) * 8),
            report_count(CONSUMER_CODE_COUNT),
            logical_limits<1, 2>(0, info<consumer>::max_usage),
            usage_extended_limits(nullusage, static_cast<consumer>(info<consumer>::max_usage)),
            input::array(),

            report_size(sizeof(std::declval<controls_report>().system_codes[0]) * 8),
            report_count(SYSTEM_CODE_COUNT),
            logical_limits<1, 2>(0, info<generic_desktop>::max_usage),
            usage_extended_limits(nullusage, static_cast<generic_desktop>(info<generic_desktop>::max_usage)),
            input::array(),

            report_size(sizeof(std::declval<controls_report>().telephony_codes[0]) * 8),
            report_count(TELEPHONY_CODE_COUNT),
            logical_limits<1, 2>(0, info<telephony>::max_usage),
            usage_extended_limits(nullusage, static_cast<telephony>(info<consumer>::max_usage)),
            input::array()
        )
    );
    static constexpr hid::report_protocol rp {rd};
    return rp;
}

controls_app& controls_app::handle()
{
    static controls_app app{};
    return app;
}

void controls_app::start(hid::protocol prot)
{
    // TODO start handling controls events
}

void controls_app::stop()
{
    // TODO stop handling controls events
}

void controls_app::in_report_sent(const std::span<const uint8_t>& data)
{
    // the next IN report can be sent if any are queued
}

void controls_app::get_report(hid::report::selector select, const std::span<uint8_t>& buffer)
{
    // TODO fetch the controls report data in the protocol specific format
}
```

## src/gamepad_app.hpp
```c
#ifndef __GAMEPAD_APP_HEADER__
#define __GAMEPAD_APP_HEADER__

#include "hid/application.hpp"

class gamepad_app : public hid::application
{
    static const hid::report_protocol& report_protocol();

    gamepad_app()
        : application(report_protocol())
    {}

public:
    struct joystick
    {
        hid::le_int16_t X {};
        hid::le_int16_t Y {};
    };
    struct gamepad_report : public hid::report::base<hid::report::type::INPUT, 0>
    {
    private:
        const uint8_t report_id {};
        const uint8_t report_size { sizeof(gamepad_report) };
    public:
        union
        {
            hid::le_uint16_t buttons {};
            struct
            {
                uint16_t UP : 1;
                uint16_t DOWN : 1;
                uint16_t LEFT : 1;
                uint16_t RIGHT : 1;
                uint16_t START : 1;
                uint16_t BACK : 1;
                uint16_t LS : 1;
                uint16_t RS : 1;
                uint16_t LB : 1;
                uint16_t RB : 1;
                uint16_t HOME : 1;
                uint16_t : 1;
                uint16_t A : 1;
                uint16_t B : 1;
                uint16_t X : 1;
                uint16_t Y : 1;
            };
        };
        uint8_t left_trigger {};
        uint8_t right_trigger {};
        joystick left;
        joystick right;

        constexpr gamepad_report() = default;

        // TODO: add helpers
    };

    static gamepad_app& handle();

    using hid::application::send_report;

    void start(hid::protocol prot) override;
    void stop() override;
    void set_report(hid::report::type type, const std::span<const uint8_t>& data) override
    {
        // no FEATURE or OUTPUT reports
    }
    void in_report_sent(const std::span<const uint8_t>& data) override;
    void get_report(hid::report::selector select, const std::span<uint8_t>& buffer) override;

private:
};

#endif // __GAMEPAD_APP_HEADER__
```

## src/usb.cpp
```c
extern "C"
{
#include <zephyr/kernel.h>
#include <zephyr/device.h>
#include <zephyr/drivers/gpio.h>
#include <zephyr/types.h>
#include <stddef.h>
#include <string.h>
#include <errno.h>
#include <zephyr/sys/printk.h>
#include <zephyr/sys/byteorder.h>
#include <zephyr/kernel.h>
#include <soc.h>
#include <assert.h>
#include <zephyr/spinlock.h>

#include <zephyr/settings/settings.h>

#include "bluetooth.h"
}
#include "usb.hpp"
#include "keyboard_app.hpp"
#include "mouse_app.hpp"
#include "command_app.hpp"
#include "controls_app.hpp"
#include "gamepad_app.hpp"
#include "usb/df/device.hpp"
#include "usb/df/port/zephyr/udc_mac.hpp"
#include "usb/df/class/hid.hpp"
#include "usb/df/vendor/microsoft_os_extension.hpp"
#include "usb/df/vendor/microsoft_xinput.hpp"

// TODO fill valid product info
constexpr usb::product_info prinfo {
    0xfff0, "UGL",
    0xffff, "UHK", usb::version("1.0")
};

void usb_init(bool gamepad_enable) {
    static constexpr auto speed = usb::speed::FULL;
    static usb::df::zephyr::udc_mac mac {DEVICE_DT_GET(DT_NODELABEL(zephyr_udc0))};

    static usb::df::hid::function usb_kb { keyboard_app::handle(), usb::hid::boot_protocol_mode::KEYBOARD };
    static usb::df::hid::function usb_mouse { mouse_app::handle() };
    static usb::df::hid::function usb_command { command_app::handle() };
    static usb::df::hid::function usb_controls { controls_app::handle() };
    static usb::df::hid::function usb_gamepad { gamepad_app::handle() };
    static usb::df::microsoft::xfunction usb_xpad { gamepad_app::handle() };

    constexpr auto config_header = usb::df::config::header(usb::df::config::power::bus(500, true));
    const auto shared_config_elems = usb::df::config::join_elements(
            usb::df::hid::config(usb_kb, speed, usb::endpoint::address(0x81), 1),
            usb::df::hid::config(usb_mouse, speed, usb::endpoint::address(0x82), 1),
            usb::df::hid::config(usb_command, speed, usb::endpoint::address(0x83), 20,
                    usb::endpoint::address(0x03), 20),
            usb::df::hid::config(usb_controls, speed, usb::endpoint::address(0x84), 1)
    );

    static const auto base_config = usb::df::config::make_config(config_header, shared_config_elems);

    static const auto gamepad_config = usb::df::config::make_config(config_header, shared_config_elems,
            usb::df::hid::config(usb_gamepad, speed, usb::endpoint::address(0x85), 1)
    );

    static const auto xpad_config = usb::df::config::make_config(config_header, shared_config_elems,
            usb::df::microsoft::xconfig(usb_xpad, usb::endpoint::address(0x85), 1,
                    usb::endpoint::address(0x05), 255)
    );

    static usb::df::microsoft::alternate_enumeration<usb::speeds(usb::speed::FULL)> ms_enum {};
    static usb::df::device_instance<usb::speeds(usb::speed::FULL)> device {mac, prinfo, ms_enum};

    if (device.is_open()) {
        device.close();
        // TODO: add enough sleep to be effective
        k_sleep(K_MSEC(100));
    }
    if (gamepad_enable) {
        ms_enum.set_config(xpad_config);
        device.set_config(gamepad_config);
    } else {
        ms_enum.set_config({});
        device.set_config(base_config);
    }
    device.open();
}
```

## src/usb.hpp
```c
#ifndef __USB_HEADER__
#define __USB_HEADER__

#include <zephyr/device.h>

// TODO: add parameter to select initial mode (gamepad yes/no, keyboard 6/N KRO)
void usb_init(const device* dev);

#endif // __USB_HEADER__
```
