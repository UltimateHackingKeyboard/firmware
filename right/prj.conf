## CMakeLists.txt
```
cmake_minimum_required(VERSION 3.22.0)

add_subdirectory(sysbuild)

# Avoid linking test executables (prevents newlib _exit/_sbrk etc. linker errors)
set(CMAKE_TRY_COMPILE_TARGET_TYPE STATIC_LIBRARY CACHE STRING "")

set(CMAKE_EXPORT_COMPILE_COMMANDS ON)
set(CMAKE_C_STANDARD 11)
set(CMAKE_C_STANDARD_REQUIRED ON)
set(CMAKE_CXX_STANDARD 20)
set(CMAKE_CXX_STANDARD_REQUIRED ON)
set(WEST ON) # necessary for looking up mcux modules from west workspace

set(board frdmk22f) # TODO: how to remove the board selection?
set(device MK22F51212)

include(${SdkRootDirPath}/cmake/extension/mcux.cmake)
project(uhk-60-right
    LANGUAGES "ASM" "C" "CXX"
)
include(${SdkRootDirPath}/CMakeLists.txt)

set(IS_MCUX_SDK ON)
set(BL_APP_VECTOR_TABLE_ADDRESS 0xc000)

target_compile_definitions(${PROJECT_NAME} PUBLIC
    BL_HAS_BOOTLOADER_CONFIG=1
    BL_APP_VECTOR_TABLE_ADDRESS=${BL_APP_VECTOR_TABLE_ADDRESS}
    __STARTUP_CLEAR_BSS
    #USB_STACK_BM
)

target_link_libraries(${PROJECT_NAME} PUBLIC
    c2usb
)

add_subdirectory(src)
target_include_directories(${PROJECT_NAME} PRIVATE
    # as some headers are included via shared/ prefix
    ${CMAKE_CURRENT_SOURCE_DIR}/..
)
include(${CMAKE_CURRENT_SOURCE_DIR}/../shared/CMakeLists.txt)
mcux_add_source(SOURCES ../lib/bootloader/src/bootloader/src/wormhole.c)
mcux_add_include(INCLUDES ../lib/bootloader/src)

mcux_add_linker_symbol(SYMBOLS
    __heap_size__=0x400
    __stack_size__=0x1000
    __bl_app_vector_table_address__=${BL_APP_VECTOR_TABLE_ADDRESS}
)
mcux_add_armgcc_linker_script(LINKER src/link/MK22FN512xxx12_flash.ld)

mcux_convert_binary(
    BINARY "${APPLICATION_BINARY_DIR}/${PROJECT_NAME}.hex"
)
```

## Kconfig
```
# Need to refer the root Kconfig.mcuxpreso to get all Kconfig data
source "Kconfig.mcuxpresso"

# Board example specific Kconfig can be linked in this way if needed
osource "${project_board_port_path}/Kconfig"

config BOARD_UHK_60_RIGHT_V1
    bool "UHK 60 v1"
config BOARD_UHK_60_RIGHT_V2
    bool "UHK 60 v2"

rsource  "Kconfig.device"
```

## Kconfig.device
```
# custom Kconfig defaults are set per board here,
# as the board-specific Kconfig files are used for mcuboot build as well

config DEVICE_ID
    int "UHK device id"
    default 1 if BOARD_UHK_60_RIGHT_V1
    default 2 if BOARD_UHK_60_RIGHT_V2
    default 3 if BOARD_UHK_80_LEFT
    default 4 if BOARD_UHK_80_RIGHT
    default 5 if BOARD_UHK_DONGLE
    help
        The device id that identifies the specific UHK.

config KEYBOARD_MAX_SCANCODE
    hex "highest keyboard scancode"
    default 0xDD
    range 0x66 0xDD
    help
        The highest keyboard scancode value influences the overall length of the HID record sent to the host.
        The value 0x86 is the maximum for Android devices (which don't exchange the MTU from the default 23)
        to still receive the "NKRO" report layout. If a higher scancode is used, the report size will exceed this size,
        causing a fallback to 6KRO report layout on Android.

# Device vid / pid / comment:
#
# old:
# 0x1D50    0x6120    UHK 60 v1 KBOOT Bootloader
# 0x1D50    0x6121    UHK Bootloader proxy
# 0x1D50    0x6122    UHK 60 v1 Keyboard firmware
# 0x1D50    0x6123    UHK 60 v2 KBOOT Bootloader
# 0x1D50    0x6124    UHK 60 v2 Keyboard firmware
#
# new:
# 0x37A8    0x0000    UHK 60 v1 BusPal proxy
# 0x37A8    0x0001    UHK 60 v1 keyboard firmware
# 0x37A8    0x0002    UHK 60 v2 BusPal proxy
# 0x37A8    0x0003    UHK 60 v2 keyboard firmware
# 0x37A8    0x0004    UHK Dongle MCUboot bootloader
# 0x37A8    0x0005    UHK Dongle firmware
# 0x37A8    0x0006    UHK 80 left MCUboot
# 0x37A8    0x0007    UHK 80 left keyboard firmware
# 0x37A8    0x0008    UHK 80 right MCUboot
# 0x37A8    0x0009    UHK 80 right keyboard firmware

# by using the same Kconfig symbol names as mcuboot, the board Kconfig files can contain the values
config USB_DEVICE_VID
    hex "USB vendor ID"
    range 0x0000 0xFFFF
    default 0x37A8
    help
        The USB vendor ID is used to identify the specific UHK device.

config USB_DEVICE_MANUFACTURER
    string "USB vendor name"
    default "Ultimate Gadget Laboratories"
    help
        The USB vendor name is used to describe the specific UHK device to the host OS user.
        Macro value is in quotes

config USB_BUSPAL_DEVICE_PID
    hex "USB BusPal product ID"
    range 0x0000 0xFFFF
    default 0x0000 if BOARD_UHK_60_RIGHT_V1
    default 0x0002 if BOARD_UHK_60_RIGHT_V2
    default 0x0000
    help
        The USB BusPal product ID is used to identify the specific UHK device.

config USB_DEVICE_PID
    hex "USB product ID"
    range 0x0000 0xFFFF
    default 0x0001 if BOARD_UHK_60_RIGHT_V1
    default 0x0003 if BOARD_UHK_60_RIGHT_V2
    default 0x0005 if BOARD_UHK_DONGLE
    default 0x0007 if BOARD_UHK_80_LEFT
    default 0x0009 if BOARD_UHK_80_RIGHT
    help
        The USB product ID is used to identify the specific UHK device.

config USB_DEVICE_PRODUCT
    string "USB product name"
    default "UHK 60 v1" if BOARD_UHK_60_RIGHT_V1
    default "UHK 60 v2" if BOARD_UHK_60_RIGHT_V2
    default "UHK dongle" if BOARD_UHK_DONGLE
    default "UHK 80 Left USB" if BOARD_UHK_80_LEFT
    default "UHK 80 Right USB" if BOARD_UHK_80_RIGHT
    help
        The USB product name is used to describe the specific UHK device to the host OS user.
        Macro value is in quotes

config USB_DEVICE_PRODUCT_VERSION
    hex "USB product version"
    range 0x0000 0xFFFF
    default 0x0001 if BOARD_UHK_60_RIGHT_V1
    default 0x0002 if BOARD_UHK_60_RIGHT_V2
    default 0x0001
    help
        The USB product version is used to identify the UHK device operating mode.
```

## prj.conf
```kconfig
# basic OS abstraction for USB middleware
CONFIG_FSL_OSA_TASK_ENABLE=n
CONFIG_MCUX_PRJSEG_component.osa_interface.generated_config=y

# USB device stack
CONFIG_MCUX_COMPONENT_middleware.usb.common_header=y
CONFIG_MCUX_COMPONENT_middleware.usb.device.common_header=y
CONFIG_MCUX_COMPONENT_middleware.usb.device.khci=y
#CONFIG_MCUX_COMPONENT_middleware.usb.device.khci_config_header=n
#CONFIG_MCUX_COMPONENT_middleware.usb.device.controller.driver=y
CONFIG_MCUX_MISC_USB_DEVICE_GENERATE_CONFIG=y
CONFIG_MCUX_MISC_USB_LITE=y
CONFIG_USB_DEVICE_CONFIG_SELF_POWER=n
# buspal USB HID device
CONFIG_USB_DEVICE_CONFIG_HID=1
#CONFIG_USB_DEVICE_CONFIG_ENDPOINTS=9
CONFIG_USB_DEVICE_CONFIG_LOW_POWER_MODE=y
CONFIG_USB_DEVICE_CONFIG_REMOTE_WAKEUP=y
CONFIG_C2USB=y
CONFIG_C2USB_MCUX_MAC=y
CONFIG_C2USB_MCUX_USB_COEXISTENCE=y
CONFIG_C2USB_HID_BOOT_PROTOCOL=y

# disable board (and device) specific source files, as the project has its own sources
# examples/_common/project_segments/common/Kconfig.prjseg
CONFIG_MCUX_HAS_PRJSEG_module.board.pinmux_sel=n
CONFIG_MCUX_PRJSEG_module.board.console_lite=n
CONFIG_MCUX_PRJSEG_module.board.boardfile=n
CONFIG_MCUX_PRJSEG_module.board.clock=n
CONFIG_MCUX_PRJSEG_module.board.suite=n
CONFIG_MCUX_PRJSEG_module.board.use_board_clock=n

CONFIG_MCUX_HAS_PRJSEG_project.use_hw_app=n

# CMSIS layer files
CONFIG_MCUX_COMPONENT_device.startup=n
CONFIG_MCUX_COMPONENT_device.CMSIS=y
CONFIG_MCUX_COMPONENT_device.system=y

# peripheral drivers
CONFIG_MCUX_COMPONENT_driver.adc16=y
CONFIG_MCUX_COMPONENT_driver.ftm=y
CONFIG_MCUX_COMPONENT_driver.i2c=y
CONFIG_MCUX_COMPONENT_driver.pit=y
CONFIG_MCUX_COMPONENT_driver.rtc=y
CONFIG_MCUX_COMPONENT_driver.uart=n
CONFIG_MCUX_COMPONENT_driver.lpuart=n

# Segger J-Link RTT debug console, enable for PRINTF debugging
#CONFIG_MCUX_COMPONENT_utility.debug_console_rtt=y
```

## src/main.c
```c
#include "attributes.h"
#include "config_parser/parse_config.h"
#include "keymap.h"
#include "led_manager.h"
#include "logger.h"
#include "module.h"
#include "slave_drivers/is31fl3xxx_driver.h"
#include "slave_drivers/uhk_module_driver.h"
#include "slot.h"
#include "timer.h"
#include "init_clock.h"
#include "init_peripherals.h"
#include "lufa/HIDClassCommon.h"
#include "segment_display.h"
#include "usb_commands/usb_command_exec_macro_command.h"
#include "slave_scheduler.h"
#include "bus_pal_hardware.h"
#include "command.h"
#include "eeprom.h"
#include "right_key_matrix.h"
#include "usb_commands/usb_command_apply_config.h"
#include "peripherals/reset_button.h"
#include "config_parser/config_globals.h"
#include "usb_report_updater.h"
#include "usb_semaphore.h"
#include "macro_events.h"
#include "macros/shortcut_parser.h"
#include "macros/keyid_parser.h"
#include "ledmap.h"
#include "test_suite/test_hooks.h"
#include "debug.h"
#include "event_scheduler.h"
#include "config_parser/config_globals.h"
#include "user_logic.h"
#include "layouts/key_layout_60_to_universal.h"
#include "power_mode.h"
#include "usb_protocol_handler.h"
#include "event_scheduler.h"
#include "utils.h"
#include "wormhole.h"
#include "trace.h"
#include "trace_reasons.h"
#include "config_manager.h"
#include "hid/transport.h"

static volatile bool IsEepromInitialized = false;
static volatile bool IsConfigInitialized = false;
static volatile bool IsHardwareConfigInitialized = false;

static void userConfigurationReadFinished(void)
{
    IsEepromInitialized = true;
}

static void hardwareConfigurationReadFinished(void)
{
    IsHardwareConfigInitialized = true;
    Ledmap_InitLedLayout();
    if (IsFactoryResetModeEnabled()) {
        HardwareConfig->signatureLength = HARDWARE_CONFIG_SIGNATURE_LENGTH;
        strncpy(HardwareConfig->signature, "FTY", HARDWARE_CONFIG_SIGNATURE_LENGTH);
    }
    EEPROM_LaunchTransfer(StorageOperation_Read, ConfigBufferId_StagingUserConfig, userConfigurationReadFinished);
}

static void initConfig()
{
    while (!IsConfigInitialized) {
        if (IsEepromInitialized) {

            if (IsFactoryResetModeEnabled() || UsbCommand_ValidateAndApplyConfigSync(NULL, NULL) != UsbStatusCode_Success) {
                UsbCommand_ApplyFactory(NULL, NULL);
            }
            ShortcutParser_initialize();
            KeyIdParser_initialize();
            Macros_Initialize();
            EventVector_Init();
            IsConfigInitialized = true;
        } else {
            __WFI();
        }
    }
}

static void sendFirstReport()
{
    hid_keyboard_report_t emptyReport = {0};
    errno_t ret = -1;
    // Wait until sending a report is successful, but don't block longer than 5 seconds.
    while (ret && Timer_GetCurrentTime() < 5000) {
        UsbSemaphore_Set(UsbReportUpdate_Keyboard);
        ret = Hid_SendKeyboardReport(&emptyReport);
        if (ret) {
            UsbSemaphore_Clear();
            __WFI();
        }
    }
    while (UsbSemaphore_Get()) {
        __WFI();
    }
}

void CopyRightKeystateMatrix(void)
{
    KeyMatrix_ScanRow(&RightKeyMatrix);
    ++MatrixScanCounter;
    bool stateChanged = false;
    for (uint8_t keyId = 0; keyId < RIGHT_KEY_MATRIX_KEY_COUNT; keyId++) {
        uint8_t targetKeyId;

        // TODO: optimize this? This translation is quite costly :-/
        if (VERSION_AT_LEAST(DataModelVersion, 8, 2, 0)) {
            targetKeyId = KeyLayout_Uhk60_to_Universal[SlotId_RightKeyboardHalf][keyId];
        } else {
            targetKeyId = keyId;
        }

        if (KeyStates[SlotId_RightKeyboardHalf][targetKeyId].hardwareSwitchState != RightKeyMatrix.keyStates[keyId]) {
            DEBUG_KEY_LIFE_SCAN(RightKeyMatrix.keyStates[keyId]);
            KeyStates[SlotId_RightKeyboardHalf][targetKeyId].hardwareSwitchState = RightKeyMatrix.keyStates[keyId];
            stateChanged = true;
        }
    }
    if (stateChanged) {
        EventVector_Set(EventVector_StateMatrix);
    }
}

static void initUsb() {
    while (!IsHardwareConfigInitialized) {
        __WFI();
    }
    CLOCK_EnableUsbfs0Clock(kCLOCK_UsbSrcIrc48M, 48000000);
    USB_SetSerialNumber(HardwareConfig->uniqueId);
    USB_Enable();
}

static void blinkSfjl() {
    KeyBacklightBrightness = 255;
    Ledmap_SetSfjlValues();
    uint32_t blinkStartTime = Timer_GetCurrentTime();
    while (Timer_GetCurrentTime() - blinkStartTime < 50) {
        __WFI();
    }
    KeyBacklightBrightness = 0;
    Ledmap_SetBlackValues();
}

static bool keyIsSfjl(uint8_t keyId, uint8_t slotId) {
    if (slotId == SlotId_RightKeyboardHalf) {
        return keyId == 16 || keyId == 18;
    }
    if (slotId == SlotId_LeftKeyboardHalf) {
        return keyId == 17 || keyId == 15;
    }
    return false;
}

static bool anySfjlKeyActive() {
    for (uint8_t slotId = 0; slotId <= SlotId_RightKeyboardHalf; slotId++) {
        for (uint8_t keyId = 0; keyId < MAX_KEY_COUNT_PER_MODULE; keyId++) {
            if (KeyStates[slotId][keyId].hardwareSwitchState && keyIsSfjl(keyId, slotId)) {
                return true;
            }
        }
    }
    return false;
}

static void checkSleepMode() {
    ATTR_UNUSED bool someKeyActive = false;
    bool matches = true;
    for (uint8_t slotId = 0; slotId <= SlotId_LeftKeyboardHalf; slotId++) {
        for (uint8_t keyId = 0; keyId < MAX_KEY_COUNT_PER_MODULE; keyId++) {
            someKeyActive |= KeyStates[slotId][keyId].hardwareSwitchState;
            if (KeyStates[slotId][keyId].hardwareSwitchState != keyIsSfjl(keyId, slotId)) {
                matches = false;
            }
        }
    }
    if (matches) {
        PowerMode_ActivateMode(PowerMode_Awake, false, true, "uhk60 sfjl keys pressed");
        LedManager_FullUpdate();
        // Wait for the user to release the keys so that they don't get activated immediately again.
        uint32_t sleepStartTime = Timer_GetCurrentTime();
        while (Timer_GetCurrentTime() - sleepStartTime < 3000 && anySfjlKeyActive()) {
            CopyRightKeystateMatrix();
            __WFI();
        }
        return;
    }
    if (someKeyActive) {
        blinkSfjl();
    }
}

int main(void)
{
    Debug_InitStackCanary();
    Trace_Init();
    if (StateWormhole_IsOpen()) {
        if (StateWormhole.persistStatusBuffer) {
            MacroStatusBuffer_InitFromWormhole();
        }
        else if (StateWormhole.wasReboot || Trace_ResetShouldBeIgnored()) {
            // Looks like a normal reboot or power on startup
            MacroStatusBuffer_InitNormal();
        }
        else {
            // Looks like a crash.
            StateWormhole.persistStatusBuffer = true;
            MacroStatusBuffer_Validate();
            Trace_Print(LogTarget_ErrorBuffer, "Looks like your uhk60 crashed.");
            MacroStatusBuffer_InitFromWormhole();
        }
        StateWormhole_Clean();
    } else {
        MacroStatusBuffer_InitNormal();
        ConfigManager_ResetWormConfiguration();
        StateWormhole_Clean();
        StateWormhole_Open();
        Trace_ResetUhk60Reasons();
    }

    InitClock();
    InitPeripherals();

    EEPROM_LaunchTransfer(StorageOperation_Read, ConfigBufferId_HardwareConfig, hardwareConfigurationReadFinished);

    if (IsBusPalOn) {
        init_hardware();
        handleUsbBusPalCommand();
    } else {
        InitSlaveScheduler();

        KeyMatrix_Init(&RightKeyMatrix);
        initUsb();

        initConfig();

        sendFirstReport();

        Trace_Printc("initialized");
        LOG_INF("Booted up.");

        while (1) {
            if (TestHooks_Active) {
                TestHooks_Tick();
            }
            if (!TestHooks_Active || TestHooks_AwaitingRelease) {
                CopyRightKeystateMatrix();
            }

            if (CurrentPowerMode >= PowerMode_Lock) {
                checkSleepMode();
            }

            if (EventScheduler_Vector & EventVector_UserLogicUpdateMask) {
                Trace('(');
                RunUserLogic();
                Trace(')');
            }
            if (EventVector_IsSet(EventVector_EventScheduler)) {
                EventScheduler_Process();
            }

            UserLogic_LastEventloopTime = Timer_GetCurrentTime();

            __WFI();
        }
    }
}

// https://stackoverflow.com/questions/73742774/gcc-arm-none-eabi-11-3-is-not-implemented-and-will-always-fail
#if 1 // using nano vs nosys
void _exit(int n)
{
    (void)n;
    while (1);
}
#endif
```

## src/action.c
```c
#include "main.h"
#include "action.h"
#include "led_display.h"
#include "layer.h"
#include "usb_interface_mouse.h"
#include "current_keymap.h"

static uint8_t activeLayer = LAYER_ID_BASE;
static uint8_t mouseWheelDivisorCounter = 0;
static uint8_t mouseSpeedAccelDivisorCounter = 0;
static uint8_t mouseSpeed = 3;
static bool wasPreviousMouseActionWheelAction = false;

void ProcessMouseAction(key_action_t action)
{
    bool isWheelAction = action.mouse.scrollActions && !action.mouse.moveActions && !action.mouse.buttonActions;

    if (isWheelAction && wasPreviousMouseActionWheelAction) {
        mouseWheelDivisorCounter++;
    }

    if (action.mouse.scrollActions) {
        if (mouseWheelDivisorCounter == MOUSE_WHEEL_DIVISOR) {
            mouseWheelDivisorCounter = 0;
            if (action.mouse.scrollActions & MOUSE_SCROLL_UP) {
                UsbMouseReport.wheelX = 1;
            }
            if (action.mouse.scrollActions & MOUSE_SCROLL_DOWN) {
                UsbMouseReport.wheelX = -1;
            }
        }
    }

    if (action.mouse.moveActions & MOUSE_ACCELERATE || action.mouse.moveActions & MOUSE_DECELERATE) {
        mouseSpeedAccelDivisorCounter++;

        if (mouseSpeedAccelDivisorCounter == MOUSE_SPEED_ACCEL_DIVISOR) {
            mouseSpeedAccelDivisorCounter = 0;

            if (action.mouse.moveActions & MOUSE_ACCELERATE) {
                if (mouseSpeed < MOUSE_MAX_SPEED) {
                    mouseSpeed++;
                }
            }
            if (action.mouse.moveActions & MOUSE_DECELERATE) {
                if (mouseSpeed > 1) {
                    mouseSpeed--;
                }
            }
        }
    } else if (action.mouse.moveActions) {
        if (action.mouse.moveActions & MOUSE_MOVE_LEFT) {
            UsbMouseReport.x = -mouseSpeed;
        }
        if (action.mouse.moveActions & MOUSE_MOVE_RIGHT) {
            UsbMouseReport.x = mouseSpeed;
        }
        if (action.mouse.moveActions & MOUSE_MOVE_UP) {
            UsbMouseReport.y = -mouseSpeed;
        }
        if (action.mouse.moveActions & MOUSE_MOVE_DOWN) {
            UsbMouseReport.y = mouseSpeed;
        }
    }

    UsbMouseReport.buttons |= action.mouse.buttonActions;

    wasPreviousMouseActionWheelAction = isWheelAction;
}

void UpdateActiveUsbReports() {

    bzero(&UsbMouseReport, sizeof(usb_mouse_report_t));

    uint8_t scancodeIdx = 0;

    activeLayer = LAYER_ID_BASE;
    for (uint8_t slotId=0; slotId<SLOT_COUNT; slotId++) {
        for (uint8_t keyId=0; keyId<MAX_KEY_COUNT_PER_MODULE; keyId++) {
            if (CurrentKeyStates[slotId][keyId]) {
                key_action_t action = CurrentKeymap[LAYER_ID_BASE][slotId][keyId];
                if (action.type == KEY_ACTION_SWITCH_LAYER) {
                    activeLayer = action.switchLayer.layer;
                }
            }
        }
    }

    for (uint8_t slotId=0; slotId<SLOT_COUNT; slotId++) {
        for (uint8_t keyId=0; keyId<MAX_KEY_COUNT_PER_MODULE; keyId++) {

            if (!CurrentKeyStates[slotId][keyId]) {
                continue;
            }

            key_action_t action = CurrentKeymap[activeLayer][slotId][keyId];
            switch (action.type) {
                case KEY_ACTION_KEYSTROKE:
                    ActiveUsbKeyboardReport->scancodes[scancodeIdx++] = action.keystroke.key;
                    ActiveUsbKeyboardReport->modifiers |= action.keystroke.mods;
                    break;
                case KEY_ACTION_MOUSE:
                    ProcessMouseAction(action);
                    break;
            }
        }
    }
}
```

## src/action.h
```c
#ifndef __ACTION_H__
#define __ACTION_H__

#include <stdint.h>
#include "lufa/HIDClassCommon.h"
#include "usb_composite_device.h"
#include "main.h"

#include "module.h"

typedef enum {
    KeyActionType_None,
    KeyActionType_Keystroke,
    KeyActionType_Mouse,
    KeyActionType_SwitchLayer,
    KeyActionType_SwitchKeymap,
    KeyActionType_PlayMacro,
    KeyActionType_Test,
} key_action_type_t;

typedef enum {
    KeystrokeType_Basic,
    KeystrokeType_Media,
    KeystrokeType_System,
} keystroke_type_t;

typedef enum {
    MouseButton_Left   = 1 << 0,
    MouseButton_Right  = 1 << 1,
    MouseButton_Middle = 1 << 2,
    MouseButton_4      = 1 << 3,
    MouseButton_5      = 1 << 4,
    MouseButton_t      = 1 << 5,
} mouse_button_t;

typedef enum {
    MouseMove_Up    = 1 << 0,
    MouseMove_Down  = 1 << 1,
    MouseMove_Left  = 1 << 2,
    MouseMove_Right = 1 << 3,

    MouseMove_Accelerate = 1 << 4,
    MouseMove_Decelerate = 1 << 5,
} mouse_move_action_t;

typedef enum {
    MouseScroll_Up    = 1 << 0,
    MouseScroll_Down  = 1 << 1,
    MouseScroll_Left  = 1 << 2,
    MouseScroll_Right = 1 << 3,
} mouse_scroll_t;

typedef enum {
    TestAction_DisableUsb,
    TestAction_DisableI2c,
    TestAction_DisableKeyMatrixScan,
    TestAction_DisableLedSdb,
    TestAction_DisableLedFetPwm,
    TestAction_DisableLedDriverPwm,
} test_action_t;

#define MOUSE_WHEEL_SPEED   1
#define MOUSE_WHEEL_DIVISOR 4

#define MOUSE_MAX_SPEED           10
#define MOUSE_SPEED_ACCEL_DIVISOR 50

typedef struct {
    uint8_t type;
    union {
        struct {
            keystroke_type_t keystrokeType;
            uint8_t longPressAction;
            uint8_t modifiers;
            uint16_t scancode;
        } __attribute__ ((packed)) keystroke;
        struct {
            mouse_button_t buttonActions;
            mouse_scroll_t scrollActions;
            mouse_move_action_t moveActions;
        } __attribute__ ((packed)) mouse;
        struct {
            bool isToggle;
            uint8_t layer;
        } __attribute__ ((packed)) switchLayer;
        struct {
            uint8_t keymapId;
        } __attribute__ ((packed)) switchKeymap;
        struct {
            uint16_t macroId;
        } __attribute__ ((packed)) playMacro;
        struct {
            test_action_t testAction;
        } __attribute__ ((packed)) test;
    };
} __attribute__ ((packed)) key_action_t;

extern void UpdateActiveUsbReports();

#endif
```

## src/bridge_protocol_scheduler.c
```c
#include "fsl_i2c.h"
#include "bridge_protocol_scheduler.h"
#include "slot.h"
#include "main.h"
#include "slave_drivers/slave_driver_led_driver.h"
#include "slave_drivers/slave_driver_uhk_module.h"
#include "i2c.h"
#include "i2c_addresses.h"
#include "test_states.h"

uint8_t currentBridgeSlaveId = 0;

uhk_slave_t bridgeSlaves[] = {
    { .slaveHandler = BridgeSlaveUhkModuleHandler, .moduleId = 0 },
    { .slaveHandler = BridgeSlaveLedDriverHandler, .moduleId = 0 },
    { .slaveHandler = BridgeSlaveLedDriverHandler, .moduleId = 1 },
};

static void bridgeProtocolCallback(I2C_Type *base, i2c_master_handle_t *handle, status_t status, void *userData)
{
    if (TestStates.disableI2c) {
        return;
    }
    uhk_slave_t *bridgeSlave = bridgeSlaves + currentBridgeSlaveId;

    bool isFinished = bridgeSlave->slaveHandler(bridgeSlave->moduleId);
    if (isFinished) {
        currentBridgeSlaveId++;

        if (currentBridgeSlaveId >= (sizeof(bridgeSlaves) / sizeof(uhk_slave_t))) {
            currentBridgeSlaveId = 0;
        }
    }
}

void InitBridgeProtocolScheduler()
{
    InitUhkModules();
    SetLeds(0xff);
    I2C_MasterTransferCreateHandle(I2C_MAIN_BUS_BASEADDR, &I2cMasterHandle, bridgeProtocolCallback, NULL);

    // Kickstart the scheduler by triggering the first callback.
    bridgeSlaves[0].slaveHandler(bridgeSlaves[0].moduleId);
}
```

## src/bridge_protocol_scheduler.h
```c
#ifndef __BRIDGE_PROTOCOL_SCHEDULER_H__
#define __BRIDGE_PROTOCOL_SCHEDULER_H__

// Includes:

    #include "fsl_common.h"

// Typedefs:

    typedef enum {
        BridgeSlaveType_LedDriver,
        BridgeSlaveType_UhkModule,
        BridgeSlaveType_Touchpad
    } uhk_slave_type_t;

    typedef bool (slave_handler_t)(uint8_t);

    typedef struct {
        uint8_t moduleId;  // This is a unique, per-module ID.
        slave_handler_t *slaveHandler;
        bool isConnected;
    } uhk_slave_t;

// Functions:

    void InitBridgeProtocolScheduler();
    void SetLeds(uint8_t ledBrightness);

#endif
```

## src/bridge_slave_led_driver.c
```c
#include "bridge_slave_led_driver.h"
#include "led_driver.h"

#define BUFFER_SIZE (LED_DRIVER_LED_COUNT + 1)

uint8_t ledsBuffer[BUFFER_SIZE] = {FRAME_REGISTER_PWM_FIRST};
uint8_t ledDriverStates[2] = {0};
uint8_t buffer[LED_DRIVER_BUFFER_LENGTH];

uint8_t initLedControlRegistersMessage = {FRAME_REGISTER_LED_CONTROL_FIRST, };

uint8_t ledControlBufferLeft[] = {
    FRAME_REGISTER_LED_CONTROL_FIRST,
    0b01111111, // key row 1
    0b00111111, // display row 1
    0b01011111, // keys row 2
    0b00111111, // display row 2
    0b01011111, // keys row 3
    0b00111111, // display row 3
    0b01111101, // keys row 4
    0b00011111, // display row 4
    0b00101111, // keys row 5
    0b00011111, // display row 5
    0b00000000, // keys row 6
    0b00011111, // display row 6
    0b00000000, // keys row 7
    0b00011111, // display row 7
    0b00000000, // keys row 8
    0b00011111, // display row 8
    0b00000000, // keys row 9
    0b00011111, // display row 9
};

uint8_t ledControlBufferRight[] = {
    FRAME_REGISTER_LED_CONTROL_FIRST,
    0b01111111, // key row 1
    0b00000000, // no display
    0b01111111, // keys row 2
    0b00000000, // no display
    0b01111111, // keys row 3
    0b00000000, // no display
    0b01111111, // keys row 4
    0b00000000, // no display
    0b01111010, // keys row 5
    0b00000000, // no display
    0b00000000, // keys row 6
    0b00000000, // no display
    0b00000000, // keys row 7
    0b00000000, // no display
    0b00000000, // keys row 8
    0b00000000, // no display
    0b00000000, // keys row 9
    0b00000000, // no display
};

uint8_t setFunctionFrameBuffer[] = {LED_DRIVER_REGISTER_FRAME, LED_DRIVER_FRAME_FUNCTION};
uint8_t setShutdownModeNormalBuffer[] = {LED_DRIVER_REGISTER_SHUTDOWN, SHUTDOWN_MODE_NORMAL};
uint8_t setFrame1Buffer[] = {LED_DRIVER_REGISTER_FRAME, LED_DRIVER_FRAME_1};

bool BridgeSlaveLedDriverHandler(uint8_t ledDriverId) {
    uint8_t *ledDriverState = ledDriverStates + ledDriverId;
    uint8_t ledDriverAddress = ledDriverId ? I2C_ADDRESS_LED_DRIVER_LEFT : I2C_ADDRESS_LED_DRIVER_RIGHT;
    uint8_t *ledControlBuffer = ledDriverId ? ledControlBufferLeft : ledControlBufferRight;

    switch (*ledDriverState) {
        case LedDriverState_SetFunctionFrame:
            I2cAsyncWrite(ledDriverAddress, setFunctionFrameBuffer, sizeof(setFunctionFrameBuffer));
            *ledDriverState = LedDriverState_SetShutdownModeNormal;
            break;
        case LedDriverState_SetShutdownModeNormal:
            I2cAsyncWrite(ledDriverAddress, setShutdownModeNormalBuffer, sizeof(setShutdownModeNormalBuffer));
            *ledDriverState = LedDriverState_SetFrame1;
            break;
        case LedDriverState_SetFrame1:
            I2cAsyncWrite(ledDriverAddress, setFrame1Buffer, sizeof(setFrame1Buffer));
            *ledDriverState = LedDriverState_InitLedControlRegisters;
            break;
        case LedDriverState_InitLedControlRegisters:
            I2cAsyncWrite(ledDriverAddress, ledControlBuffer, sizeof(ledControlBufferLeft));
            *ledDriverState = LedDriverState_Initialized;
        break;
          case LedDriverState_Initialized:
            I2cAsyncWrite(I2C_ADDRESS_LED_DRIVER_LEFT, ledsBuffer, BUFFER_SIZE);
            break;
        }
    return true;
}

void SetLeds(uint8_t ledBrightness)
{
    memset(ledsBuffer+1, ledBrightness, LED_DRIVER_LED_COUNT);
}
```

## src/bridge_slave_led_driver_handler.c
```c
#include "bridge_slave_led_driver_handler.h"
#include "led_driver.h"

#define BUFFER_SIZE (LED_DRIVER_LED_COUNT + 1)

uint8_t ledsBuffer[BUFFER_SIZE] = {FRAME_REGISTER_PWM_FIRST};
uint8_t ledDriverStates[2] = {0};
uint8_t buffer[LED_DRIVER_BUFFER_LENGTH];

uint8_t initLedControlRegistersMessage = {FRAME_REGISTER_LED_CONTROL_FIRST, };

uint8_t ledControlBufferLeft[] = {
    FRAME_REGISTER_LED_CONTROL_FIRST,
    0b01111111, // key row 1
    0b00111111, // display row 1
    0b01011111, // keys row 2
    0b00111111, // display row 2
    0b01011111, // keys row 3
    0b00111111, // display row 3
    0b01111101, // keys row 4
    0b00011111, // display row 4
    0b00101111, // keys row 5
    0b00011111, // display row 5
    0b00000000, // keys row 6
    0b00011111, // display row 6
    0b00000000, // keys row 7
    0b00011111, // display row 7
    0b00000000, // keys row 8
    0b00011111, // display row 8
    0b00000000, // keys row 9
    0b00011111, // display row 9
};

uint8_t ledControlBufferRight[] = {
    FRAME_REGISTER_LED_CONTROL_FIRST,
    0b01111111, // key row 1
    0b00000000, // no display
    0b01111111, // keys row 2
    0b00000000, // no display
    0b01111111, // keys row 3
    0b00000000, // no display
    0b01111111, // keys row 4
    0b00000000, // no display
    0b01111010, // keys row 5
    0b00000000, // no display
    0b00000000, // keys row 6
    0b00000000, // no display
    0b00000000, // keys row 7
    0b00000000, // no display
    0b00000000, // keys row 8
    0b00000000, // no display
    0b00000000, // keys row 9
    0b00000000, // no display
};

uint8_t setFunctionFrameBuffer[] = {LED_DRIVER_REGISTER_FRAME, LED_DRIVER_FRAME_FUNCTION};
uint8_t setShutdownModeNormalBuffer[] = {LED_DRIVER_REGISTER_SHUTDOWN, SHUTDOWN_MODE_NORMAL};
uint8_t setFrame1Buffer[] = {LED_DRIVER_REGISTER_FRAME, LED_DRIVER_FRAME_1};

bool BridgeSlaveLedDriverHandler(uint8_t ledDriverId) {
    uint8_t *ledDriverState = ledDriverStates + ledDriverId;
    uint8_t ledDriverAddress = ledDriverId ? I2C_ADDRESS_LED_DRIVER_LEFT : I2C_ADDRESS_LED_DRIVER_RIGHT;
    uint8_t *ledControlBuffer = ledDriverId ? ledControlBufferLeft : ledControlBufferRight;

    switch (*ledDriverState) {
        case LedDriverState_SetFunctionFrame:
            I2cAsyncWrite(ledDriverAddress, setFunctionFrameBuffer, sizeof(setFunctionFrameBuffer));
            *ledDriverState = LedDriverState_SetShutdownModeNormal;
            break;
        case LedDriverState_SetShutdownModeNormal:
            I2cAsyncWrite(ledDriverAddress, setShutdownModeNormalBuffer, sizeof(setShutdownModeNormalBuffer));
            *ledDriverState = LedDriverState_SetFrame1;
            break;
        case LedDriverState_SetFrame1:
            I2cAsyncWrite(ledDriverAddress, setFrame1Buffer, sizeof(setFrame1Buffer));
            *ledDriverState = LedDriverState_InitLedControlRegisters;
            break;
        case LedDriverState_InitLedControlRegisters:
            I2cAsyncWrite(ledDriverAddress, ledControlBuffer, sizeof(ledControlBufferLeft));
            *ledDriverState = LedDriverState_Initialized;
        break;
          case LedDriverState_Initialized:
            I2cAsyncWrite(I2C_ADDRESS_LED_DRIVER_LEFT, ledsBuffer, BUFFER_SIZE);
            break;
        }
    return true;
}

void SetLeds(uint8_t ledBrightness)
{
    memset(ledsBuffer+1, ledBrightness, LED_DRIVER_LED_COUNT);
}
```

## src/bridge_slave_led_driver_handler.h
```c
#ifndef __BRIDGE_SLAVE_LED_DRIVER_HANDLER_H__
#define __BRIDGE_SLAVE_LED_DRIVER_HANDLER_H__

// Includes:

    #include "fsl_common.h"

// Typedefs:

    typedef enum {
        LedDriverState_SetFunctionFrame,
        LedDriverState_SetShutdownModeNormal,
        LedDriverState_SetFrame1,
        LedDriverState_InitLedControlRegisters,
        LedDriverState_Initialized,
    } LedDriverState;

// Functions:

    extern bool BridgeSlaveLedDriverHandler(uint8_t ledDriverId);
    extern void SetLeds(uint8_t ledBrightness);

#endif
```

## src/bt_defs.h
```c
#ifndef __BT_DEFS_H__
#define __BT_DEFS_H__

// Includes:
#ifdef __ZEPHYR__
#include "trace.h"
#include <zephyr/kernel.h>
#define BT_TRACE_AND_ASSERT(tag) Trace_Printc(tag); __ASSERT(!k_is_in_isr(), "BLE API called from ISR context!")
#endif

// Macros:

// Typedefs:

// Functions:

// Variables

#endif // __BT_PAIR_H__
```

## src/calendar.c
```c
#include "calendar.h"
#include "segment_display.h"
#include "timer.h"
#include "macros.h"

uint32_t times[CalendarEvent_Count] = {};
calendar_event_t nextEvent;
uint32_t nextEventAt;
bool Calendar_IsActive = false;

static void scheduleNext()
{
    bool gotAny = false;
    for (uint8_t i = 0; i < CalendarEvent_Count; i++) {
        if (times[i] != 0 && (!gotAny || times[i] < nextEventAt)) {
            nextEvent = i;
            nextEventAt = times[i];
        }
    }
    if (!gotAny) {
        Calendar_IsActive = false;
    }
}

static void processEvt(calendar_event_t evt)
{
    switch (evt) {
        case CalendarEvent_SegmentDisplayUpdate:
            SegmentDisplay_NeedsUpdate = true;
            break;
        case CalendarEvent_MacroWakeOnTime:
            Macros_WakedBecauseOfTime = true;
            MacroPlaying = true;
            break;
        default:
            return;
    }
}


void Calendar_Reschedule(uint32_t at, calendar_event_t evt)
{
    times[evt] = at;
    if (nextEvent == evt) {
        scheduleNext();
    } else if (at < nextEventAt) {
        nextEventAt = at;
        nextEvent = evt;
    }
    Calendar_IsActive = true;
}

void Calendar_Schedule(uint32_t at, calendar_event_t evt)
{
    if (times[evt] == 0 || at < times[evt]) {
        times[evt] = at;
    }
    if (at < nextEventAt) {
        nextEventAt = at;
        nextEvent = evt;
    }
    Calendar_IsActive = true;
}


void Calendar_Process()
{
    if (nextEvent <= CurrentTime) {
        calendar_event_t evt = nextEvent;
        times[nextEvent] = 0;
        scheduleNext();
        processEvt(evt);
    }
}
```

## src/calendar.h
```c
#ifndef __CALENDAR_H__
#define __CALENDAR_H__

// Includes:

    #include <stdint.h>
    #include <stdbool.h>
    #include "timer.h"

// Macros:

// Typedefs:

    typedef enum {
        CalendarEvent_SegmentDisplayUpdate,
        CalendarEvent_MacroWakeOnTime,
        CalendarEvent_Count
    } calendar_event_t;

// Variables:

    extern bool Calendar_IsActive;

// Functions:

    void Calendar_Schedule(uint32_t at, calendar_event_t evt);
    void Calendar_Reschedule(uint32_t at, calendar_event_t evt);
    void Calendar_Process();

#endif
```

## src/caret_config.c
```c
#include "caret_config.h"
#include "arduino_hid/ConsumerAPI.h"
#include "arduino_hid/SystemAPI.h"
#include "macros/core.h"
#include "macros/status_buffer.h"
#include "config_manager.h"
#include "module.h"

caret_configuration_t* GetNavigationModeConfiguration(navigation_mode_t mode) {
    if (NavigationMode_RemappableFirst <= mode && mode <= NavigationMode_RemappableLast) {
        return &Cfg.NavigationModes[mode - NavigationMode_RemappableFirst];
    } else {
            Macros_ReportErrorNum("Mode referenced in invalid context. Only remappable modes are supported here:", mode, NULL);
            return NULL;
    }
}


void SetModuleCaretConfiguration(navigation_mode_t mode, caret_axis_t axis, bool positive, key_action_t action)
{
    caret_configuration_t* config = GetNavigationModeConfiguration(mode);

    key_action_t* actionSlot = positive ? &config->axisActions[axis].positiveAction : &config->axisActions[axis].negativeAction;

    *actionSlot = action;
}
```

## src/caret_config.h
```c
#ifndef __CARET_CONFIG_H__
#define __CARET_CONFIG_H__

// Includes:

    #include "key_action.h"
    #include "module.h"

// Typedefs:

    typedef enum {
        CaretAxis_Horizontal = 0,
        CaretAxis_Vertical = 1,
        CaretAxis_Count = 2,
        CaretAxis_Inactive = CaretAxis_Count,
        CaretAxis_None = CaretAxis_Count,
    } caret_axis_t;

    typedef struct {
        key_action_t negativeAction;
        key_action_t positiveAction;
    } caret_dir_action_t;

    typedef struct {
        caret_dir_action_t axisActions[CaretAxis_Count];
    } caret_configuration_t;


// Functions:

    caret_configuration_t* GetNavigationModeConfiguration(navigation_mode_t mode);
    void SetModuleCaretConfiguration(navigation_mode_t mode, caret_axis_t axis, bool positive, key_action_t action);

#endif
```
