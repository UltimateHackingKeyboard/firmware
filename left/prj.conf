## CMakeLists.txt
```
cmake_minimum_required(VERSION 3.22.0)

add_subdirectory(sysbuild)

set(CMAKE_EXPORT_COMPILE_COMMANDS ON)
set(CMAKE_C_STANDARD 11)
set(CMAKE_C_STANDARD_REQUIRED ON)

set(board frdmkl03z) # TODO: how to remove the board selection?
set(device MKL03Z4)

include(${SdkRootDirPath}/cmake/extension/mcux.cmake)
project(uhk-60-left
    LANGUAGES "ASM" "C" "CXX"
)
include(${SdkRootDirPath}/CMakeLists.txt)

set(IS_MCUX_SDK ON)

include(${CMAKE_CURRENT_SOURCE_DIR}/../shared/CMakeLists.txt)
include(${CMAKE_CURRENT_SOURCE_DIR}/../shared/module/CMakeLists.txt)
```

## prj.conf
```kconfig
# disable board (and device) specific source files, as the project has its own sources
# examples/_common/project_segments/common/Kconfig.prjseg
CONFIG_MCUX_HAS_PRJSEG_module.board.pinmux_sel=n
CONFIG_MCUX_PRJSEG_module.board.console_lite=n
CONFIG_MCUX_PRJSEG_module.board.boardfile=n
CONFIG_MCUX_PRJSEG_module.board.clock=n
CONFIG_MCUX_PRJSEG_module.board.suite=n
CONFIG_MCUX_PRJSEG_module.board.use_board_clock=n

CONFIG_MCUX_HAS_PRJSEG_project.use_hw_app=n

CONFIG_MCUX_COMPONENT_utilities.misc_utilities=n

# CMSIS layer files
CONFIG_MCUX_COMPONENT_device.startup=n
CONFIG_MCUX_COMPONENT_device.CMSIS=y
CONFIG_MCUX_COMPONENT_device.system=y

# peripheral drivers
CONFIG_MCUX_COMPONENT_driver.i2c=y
CONFIG_MCUX_COMPONENT_driver.lptmr=y
CONFIG_MCUX_COMPONENT_driver.tpm=y
CONFIG_MCUX_COMPONENT_driver.lpuart=y
CONFIG_MCUX_COMPONENT_driver.smc=n
```

## src/main.c
```c
#include "module/init_clock.h"
#include "init_peripherals.h"
#include "bootloader.h"
#include <stdio.h>
#include "key_scanner.h"
#include "module.h"

DEFINE_BOOTLOADER_CONFIG_AREA(I2C_ADDRESS_MODULE_BOOTLOADER)

int main(void)
{
    InitClock();
    InitPeripherals();
    Module_Init();
    InitKeyScanner();

    while (1) {
        __WFI();
    }
}
```

## src/bootloader.c
```c
#include "kboot.h"
#include "i2c_addresses.h"
#include "bootloader.h"

__attribute__((used, section(".BootloaderConfig"))) const bootloader_config_t BootloaderConfig = {
    .tag = 0x6766636B,                                            // Magic Number
    .enabledPeripherals = ENABLE_PERIPHERAL_I2C,
    .i2cSlaveAddress = I2C_ADDRESS_LEFT_KEYBOARD_HALF_BOOTLOADER,
    .peripheralDetectionTimeoutMs = 300,
    .clockFlags = 0xFF,                                           // Disable High speed mode
    .clockDivider = 0xFF,                                         // Use clock divider (0)
};
```

## src/bootloader.h
```c
#ifndef __BOOTLOADER_H__
#define __BOOTLOADER_H__

// Includes:

    #include <stdint.h>
    #include <stddef.h>

// Typedefs:

    typedef struct {
        uint32_t tag;                          // Magic number to verify bootloader configuration is valid. Must be set to 'kcfg'.
        uint32_t reserved[3];
        uint8_t enabledPeripherals;            // Bitfield of peripherals to enable.
                                               // bit 0 - LPUART, bit 1 - I2C, bit 2 - SPI, bit 3 - CAN, bit 4 - USB
        uint8_t i2cSlaveAddress;               // If not 0xFF, used as the 7-bit I2C slave address.
                                               // If 0xFF, defaults to 0x10 for I2C slave address.
        uint16_t peripheralDetectionTimeoutMs; // Timeout in milliseconds for active peripheral detection.
                                               // If 0xFFFF, defaults to 5 seconds.
        uint16_t reserved2[2];
        uint32_t reserved3;
        uint8_t clockFlags;   // The flags in the clockFlags configuration field are enabled if the corresponding bit is cleared (0).
                              // bit 0 - HighSpeed Enable high speed mode (i.e., 48 MHz).
        uint8_t clockDivider; // Inverted value of the divider to use for core and bus clocks when in high speed mode.
    } bootloader_config_t;


// Functions:

    extern void JumpToBootloader(void);

#endif
```

## src/bootloader_config.c
```c
#include "bootloader.h"
#include "i2c_addresses.h"

DEFINE_BOOTLOADER_CONFIG_AREA(I2C_ADDRESS_LEFT_KEYBOARD_HALF_BOOTLOADER)
```

## src/bridge_protocol_handler.c
```c
#include "bridge_protocol_handler.h"
#include "test_led.h"
#include "main.h"
#include "i2c_addresses.h"
#include "i2c.h"
#include "led_pwm.h"
#include "bridge_protocol.h"
#include "main.h"
#include "init_peripherals.h"

void SetError(uint8_t error);
void SetGenericError(void);
void SetResponseByte(uint8_t response);

void SetError(uint8_t error) {
    BridgeTxBuffer[0] = error;
}

void SetGenericError(void)
{
    SetError(PROTOCOL_RESPONSE_GENERIC_ERROR);
}

// Set a single byte as the response.
void SetResponseByte(uint8_t response)
{
    BridgeTxBuffer[1] = response;
}

void BridgeProtocolHandler(void)
{
    uint8_t commandId = BridgeRxBuffer[0];
    switch (commandId) {
        case BridgeCommand_GetKeyStates:
            BridgeTxSize = KEYBOARD_MATRIX_COLS_NUM*KEYBOARD_MATRIX_ROWS_NUM;
            memcpy(BridgeTxBuffer, keyMatrix.keyStates, BridgeTxSize);
            break;
        case BridgeCommand_SetTestLed:
            BridgeTxSize = 0;
            bool isLedOn = BridgeRxBuffer[1];
            TEST_LED_SET(isLedOn);
            break;
        case BridgeCommand_SetLedPwmBrightness:
            BridgeTxSize = 0;
            uint8_t brightnessPercent = BridgeRxBuffer[1];
            LedPwm_SetBrightness(brightnessPercent);
            break;
        case BridgeCommand_SetDisableKeyMatrixScanState:
            BridgeTxSize = 0;
            DisableKeyMatrixScanState = BridgeRxBuffer[1];
            break;
        case BridgeCommand_SetDisableLedSdb:
            BridgeTxSize = 0;
            GPIO_WritePinOutput(LED_DRIVER_SDB_GPIO, LED_DRIVER_SDB_PIN, BridgeRxBuffer[1] ? 0 : 1);
            break;
    }
}
```

## src/bridge_protocol_handler.h
```c
#ifndef __BRIDGE_PROTOCOL_HANDLER__
#define __BRIDGE_PROTOCOL_HANDLER__

// Includes:

    #include "fsl_port.h"

// Macros:

    #define BRIDGE_RX_BUFFER_SIZE 100
    #define BRIDGE_TX_BUFFER_SIZE 100

    #define PROTOCOL_RESPONSE_SUCCESS       0
    #define PROTOCOL_RESPONSE_GENERIC_ERROR 1

// Variables:

    uint8_t BridgeRxBuffer[BRIDGE_RX_BUFFER_SIZE];
    uint8_t BridgeTxBuffer[BRIDGE_TX_BUFFER_SIZE];
    uint8_t BridgeTxSize;

// Functions:

    extern void BridgeProtocolHandler(void);

#endif
```

## src/clock_config.c
```c
/*
 * Copyright (c) 2015, Freescale Semiconductor, Inc.
 * All rights reserved.
 *
 * Redistribution and use in source and binary forms, with or without modification,
 * are permitted provided that the following conditions are met:
 *
 * o Redistributions of source code must retain the above copyright notice, this list
 *   of conditions and the following disclaimer.
 *
 * o Redistributions in binary form must reproduce the above copyright notice, this
 *   list of conditions and the following disclaimer in the documentation and/or
 *   other materials provided with the distribution.
 *
 * o Neither the name of Freescale Semiconductor, Inc. nor the names of its
 *   contributors may be used to endorse or promote products derived from this
 *   software without specific prior written permission.
 *
 * THIS SOFTWARE IS PROVIDED BY THE COPYRIGHT HOLDERS AND CONTRIBUTORS "AS IS" AND
 * ANY EXPRESS OR IMPLIED WARRANTIES, INCLUDING, BUT NOT LIMITED TO, THE IMPLIED
 * WARRANTIES OF MERCHANTABILITY AND FITNESS FOR A PARTICULAR PURPOSE ARE
 * DISCLAIMED. IN NO EVENT SHALL THE COPYRIGHT HOLDER OR CONTRIBUTORS BE LIABLE FOR
 * ANY DIRECT, INDIRECT, INCIDENTAL, SPECIAL, EXEMPLARY, OR CONSEQUENTIAL DAMAGES
 * (INCLUDING, BUT NOT LIMITED TO, PROCUREMENT OF SUBSTITUTE GOODS OR SERVICES;
 * LOSS OF USE, DATA, OR PROFITS; OR BUSINESS INTERRUPTION) HOWEVER CAUSED AND ON
 * ANY THEORY OF LIABILITY, WHETHER IN CONTRACT, STRICT LIABILITY, OR TORT
 * (INCLUDING NEGLIGENCE OR OTHERWISE) ARISING IN ANY WAY OUT OF THE USE OF THIS
 * SOFTWARE, EVEN IF ADVISED OF THE POSSIBILITY OF SUCH DAMAGE.
 */

#include "fsl_common.h"
#include "fsl_smc.h"
#include "clock_config.h"

/*******************************************************************************
 * Definitions
 ******************************************************************************/

/*******************************************************************************
 * Variables
 ******************************************************************************/
/* System clock frequency. */
extern uint32_t SystemCoreClock;

/*******************************************************************************
 * Code
 ******************************************************************************/
/*
 * How to setup clock using clock driver functions:
 *
 * 1. CLOCK_SetSimSafeDivs, to make sure core clock, bus clock, flexbus clock
 *    and flash clock are in allowed range during clock mode switch.
 *
 * 2. Call CLOCK_SetMcgliteConfig to set MCG_Lite configuration.
 *
 * 3. Call CLOCK_SetSimConfig to set the clock configuration in SIM.
 */

void BOARD_BootClockVLPR(void)
{
    /*
     * Core clock: 2MHz
     * Bus clock: 1MHz
     */
    const mcglite_config_t mcgliteConfig = {
        .outSrc = kMCGLITE_ClkSrcLirc,
        .irclkEnableMode = kMCGLITE_IrclkEnable,
        .ircs = kMCGLITE_Lirc2M,
        .fcrdiv = kMCGLITE_LircDivBy1,
        .lircDiv2 = kMCGLITE_LircDivBy1,
        .hircEnableInNotHircMode = false,
    };

    const sim_clock_config_t simConfig =
    {
#if (defined(FSL_FEATURE_SIM_OPT_HAS_OSC32K_SELECTION) && FSL_FEATURE_SIM_OPT_HAS_OSC32K_SELECTION)
        .er32kSrc = 0U, /* SIM_SOPT1[OSC32KSEL]. */
#endif
        .clkdiv1 = 0x00010000U, /* SIM_CLKDIV1. */
    };

    CLOCK_SetSimSafeDivs();

    CLOCK_SetMcgliteConfig(&mcgliteConfig);

    CLOCK_SetSimConfig(&simConfig);

    SystemCoreClock = 2000000U;

    SMC_SetPowerModeProtection(SMC, kSMC_AllowPowerModeAll);
    SMC_SetPowerModeVlpr(SMC);
    while (SMC_GetPowerModeState(SMC) != kSMC_PowerStateVlpr)
    {
    }
}

void BOARD_BootClockRUN(void)
{
    /*
     * Core clock: 48MHz
     * Bus clock: 24MHz
     */
    const mcglite_config_t mcgliteConfig = {
        .outSrc = kMCGLITE_ClkSrcHirc,
        .irclkEnableMode = 0U,
        .ircs = kMCGLITE_Lirc8M,
        .fcrdiv = kMCGLITE_LircDivBy1,
        .lircDiv2 = kMCGLITE_LircDivBy1,
        .hircEnableInNotHircMode = true,
    };

    const sim_clock_config_t simConfig =
    {
#if (defined(FSL_FEATURE_SIM_OPT_HAS_OSC32K_SELECTION) && FSL_FEATURE_SIM_OPT_HAS_OSC32K_SELECTION)
        .er32kSrc = 0U, /* SIM_SOPT1[OSC32KSEL]. */
#endif
        .clkdiv1 = 0x00010000U, /* SIM_CLKDIV1. */
    };

    CLOCK_SetSimSafeDivs();

    CLOCK_SetMcgliteConfig(&mcgliteConfig);

    CLOCK_SetSimConfig(&simConfig);

    SystemCoreClock = 48000000U;
}

void BOARD_InitOsc0(void)
{
    const osc_config_t oscConfig = {.freq = BOARD_XTAL0_CLK_HZ,
                                    .capLoad = 0U,
                                    .workMode = kOSC_ModeOscLowPower,
                                    .oscerConfig = {
                                        .enableMode = kOSC_ErClkEnable,
#if (defined(FSL_FEATURE_OSC_HAS_EXT_REF_CLOCK_DIVIDER) && FSL_FEATURE_OSC_HAS_EXT_REF_CLOCK_DIVIDER)
                                        .erclkDiv = 0U,
#endif
                                    }};

    CLOCK_InitOsc0(&oscConfig);

    /* Passing the XTAL0 frequency to clock driver. */
    CLOCK_SetXtal0Freq(BOARD_XTAL0_CLK_HZ);
}
```

## src/clock_config.h
```c
/*
 * Copyright (c) 2015, Freescale Semiconductor, Inc.
 * All rights reserved.
 *
 * Redistribution and use in source and binary forms, with or without modification,
 * are permitted provided that the following conditions are met:
 *
 * o Redistributions of source code must retain the above copyright notice, this list
 *   of conditions and the following disclaimer.
 *
 * o Redistributions in binary form must reproduce the above copyright notice, this
 *   list of conditions and the following disclaimer in the documentation and/or
 *   other materials provided with the distribution.
 *
 * o Neither the name of Freescale Semiconductor, Inc. nor the names of its
 *   contributors may be used to endorse or promote products derived from this
 *   software without specific prior written permission.
 *
 * THIS SOFTWARE IS PROVIDED BY THE COPYRIGHT HOLDERS AND CONTRIBUTORS "AS IS" AND
 * ANY EXPRESS OR IMPLIED WARRANTIES, INCLUDING, BUT NOT LIMITED TO, THE IMPLIED
 * WARRANTIES OF MERCHANTABILITY AND FITNESS FOR A PARTICULAR PURPOSE ARE
 * DISCLAIMED. IN NO EVENT SHALL THE COPYRIGHT HOLDER OR CONTRIBUTORS BE LIABLE FOR
 * ANY DIRECT, INDIRECT, INCIDENTAL, SPECIAL, EXEMPLARY, OR CONSEQUENTIAL DAMAGES
 * (INCLUDING, BUT NOT LIMITED TO, PROCUREMENT OF SUBSTITUTE GOODS OR SERVICES;
 * LOSS OF USE, DATA, OR PROFITS; OR BUSINESS INTERRUPTION) HOWEVER CAUSED AND ON
 * ANY THEORY OF LIABILITY, WHETHER IN CONTRACT, STRICT LIABILITY, OR TORT
 * (INCLUDING NEGLIGENCE OR OTHERWISE) ARISING IN ANY WAY OUT OF THE USE OF THIS
 * SOFTWARE, EVEN IF ADVISED OF THE POSSIBILITY OF SUCH DAMAGE.
 */
#ifndef _CLOCK_CONFIG_H_
#define _CLOCK_CONFIG_H_

/*******************************************************************************
 * DEFINITION
 ******************************************************************************/
#define BOARD_XTAL0_CLK_HZ 32768U
#define BOARD_XTAL32K_CLK_HZ 0U

/*******************************************************************************
 * API
 ******************************************************************************/
#if defined(__cplusplus)
extern "C" {
#endif /* __cplusplus*/

void BOARD_BootClockVLPR(void);
void BOARD_BootClockRUN(void);
void BOARD_InitOsc0(void);

#if defined(__cplusplus)
}
#endif /* __cplusplus*/

#endif /* _CLOCK_CONFIG_H_ */
```

## src/config.h
```c
#ifndef __CONFIG_H__
#define __CONFIG_H__

// Macros:

//    #define DEBUG_OVER_SPI

#endif
```

## src/debug_over_spi.c
```c
#include "debug_over_spi.h"
#include "fsl_gpio.h"

#define EXAMPLE_SPI_MASTER (SPI0)
#define EXAMPLE_SPI_MASTER_SOURCE_CLOCK (kCLOCK_BusClk)

#define BUFFER_SIZE (64)
static uint8_t srcBuff[BUFFER_SIZE];

static spi_transfer_t xfer = {0};
static spi_master_config_t userConfig;
spi_master_handle_t handle;

static volatile bool masterFinished = true;

static void masterCallback(SPI_Type *base, spi_master_handle_t *masterHandle, status_t status, void *userData)
{
    masterFinished = true;
}

void DebugOverSpi_Init(void)
{
    CLOCK_EnableClock(DEBUG_OVER_SPI_MOSI_CLOCK);
    CLOCK_EnableClock(DEBUG_OVER_SPI_SCK_CLOCK);

    PORT_SetPinMux(DEBUG_OVER_SPI_MOSI_PORT, DEBUG_OVER_SPI_MOSI_PIN, kPORT_MuxAlt3);
    PORT_SetPinMux(DEBUG_OVER_SPI_SCK_PORT, DEBUG_OVER_SPI_SCK_PIN, kPORT_MuxAlt3);

    GPIO_PinInit(DEBUG_OVER_SPI_MOSI_GPIO, DEBUG_OVER_SPI_MOSI_PIN, &(gpio_pin_config_t){kGPIO_DigitalOutput, 0});
    GPIO_PinInit(DEBUG_OVER_SPI_SCK_GPIO, DEBUG_OVER_SPI_SCK_PIN, &(gpio_pin_config_t){kGPIO_DigitalOutput, 0});

    GPIO_SetPinsOutput(DEBUG_OVER_SPI_MOSI_GPIO, 1U << DEBUG_OVER_SPI_MOSI_PIN);
    GPIO_SetPinsOutput(DEBUG_OVER_SPI_SCK_GPIO, 1U << DEBUG_OVER_SPI_SCK_PIN);

    SPI_MasterGetDefaultConfig(&userConfig);
    uint32_t srcFreq = CLOCK_GetFreq(EXAMPLE_SPI_MASTER_SOURCE_CLOCK);
    SPI_MasterInit(EXAMPLE_SPI_MASTER, &userConfig, srcFreq);
    SPI_MasterTransferCreateHandle(EXAMPLE_SPI_MASTER, &handle, masterCallback, NULL);
}

void DebugOverSpi_Send(uint8_t *tx, uint8_t len)
{
    if (masterFinished) {
        masterFinished = false;
        memcpy(srcBuff, tx, MIN(BUFFER_SIZE, len));
        xfer.txData = srcBuff;
        xfer.dataSize = len;
        SPI_MasterTransferNonBlocking(EXAMPLE_SPI_MASTER, &handle, &xfer);
    }
}
```

## src/debug_over_spi.h
```c
#ifdef DEBUG_OVER_SPI

#ifndef __DEBUG_OVER_SPI_H__
#define __DEBUG_OVER_SPI_H__

// Includes:

    #include "fsl_common.h"
    #include "fsl_port.h"
    #include "fsl_spi.h"

// Macros:

    #define DEBUG_OVER_SPI_MOSI_PORT  PORTA
    #define DEBUG_OVER_SPI_MOSI_GPIO  GPIOA
    #define DEBUG_OVER_SPI_MOSI_CLOCK kCLOCK_PortA
    #define DEBUG_OVER_SPI_MOSI_PIN   7

    #define DEBUG_OVER_SPI_SCK_PORT  PORTB
    #define DEBUG_OVER_SPI_SCK_GPIO  GPIOB
    #define DEBUG_OVER_SPI_SCK_CLOCK kCLOCK_PortB
    #define DEBUG_OVER_SPI_SCK_PIN   0

// Functions:

    void DebugOverSpi_Init(void);
    void DebugOverSpi_Send(uint8_t *tx, uint8_t len);

#endif

#else
    #define DebugOverSpi_Init()
    #define DebugOverSpi_Send(tx, len)
#endif
```

## src/i2c.h
```c
#ifndef __I2C_H__
#define __I2C_H__

// Macros:

    #define I2C_BUS_BASEADDR  I2C0
    #define I2C_BUS_CLK_SRC   I2C0_CLK_SRC
    #define I2C_BUS_BAUD_RATE 100000 // 100 kHz works even with a 20 meter long bridge cable.
    #define I2C_BUS_MUX       kPORT_MuxAlt2

    #define I2C_BUS_SDA_PORT  PORTB
    #define I2C_BUS_SDA_CLOCK kCLOCK_PortB
    #define I2C_BUS_SDA_PIN   4

    #define I2C_BUS_SCL_PORT  PORTB
    #define I2C_BUS_SCL_CLOCK kCLOCK_PortB
    #define I2C_BUS_SCL_PIN   3

#endif
```

## src/i2c_watchdog.c
```c
#include "fsl_i2c.h"
#include "i2c.h"
#include "i2c_watchdog.h"
#include "test_led.h"
#include "init_peripherals.h"
#include "config.h"

// NOTE: Because of a bug in the ROM bootloader of the KL03Z, the watchdog timer is disabled and cannot be re-enabled.
// See https://community.nxp.com/thread/457893
// Therefore the hardware watchdog timer cannot be used without an extra way to enter bootloader or application mode.
static uint32_t prevWatchdogCounter = 0;
static uint32_t I2cWatchdog_RecoveryCounter; // Counter for how many times we had to recover and restart

void RunWatchdog(void)
{
    static volatile uint32_t I2cWatchdog_WatchCounter = 0; // Counter for timer
    static int counter = 0;

    counter++;
    if (counter == 100) { // We get called from KEY_SCANNER_HANDLER() which runs at 1ms, thus scaling down by 100 here to get 100 ms period
        counter=0;
        TestLed_Toggle();
        I2cWatchdog_WatchCounter++;

        if (I2cWatchdog_WatchCounter > 10) { // Do not check within the first 1000 ms, as I2C might not be running yet
            if (I2C_Watchdog == prevWatchdogCounter) { // Restart I2C if there hasn't been any interrupt during 100 ms. I2C_Watchdog gets incremented for every I2C transaction
                I2cWatchdog_RecoveryCounter++;
                I2C_SlaveDeinit(I2C_BUS_BASEADDR);
                initI2c();
            }
        }
        prevWatchdogCounter = I2C_Watchdog;
    }
}
```
