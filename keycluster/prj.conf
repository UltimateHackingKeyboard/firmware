## CMakeLists.txt
```
cmake_minimum_required(VERSION 3.22.0)

add_subdirectory(sysbuild)

set(CMAKE_EXPORT_COMPILE_COMMANDS ON)
set(CMAKE_C_STANDARD 11)
set(CMAKE_C_STANDARD_REQUIRED ON)

set(board frdmkl03z) # TODO: how to remove the board selection?
set(device MKL03Z4)

include(${SdkRootDirPath}/cmake/extension/mcux.cmake)
project(uhk-keycluster
    LANGUAGES "ASM" "C" "CXX"
)
include(${SdkRootDirPath}/CMakeLists.txt)

set(IS_MCUX_SDK ON)

include(${CMAKE_CURRENT_SOURCE_DIR}/../shared/CMakeLists.txt)
include(${CMAKE_CURRENT_SOURCE_DIR}/../shared/module/CMakeLists.txt)
```

## prj.conf
```kconfig
# disable board (and device) specific source files, as the project has its own sources
# examples/_common/project_segments/common/Kconfig.prjseg
CONFIG_MCUX_HAS_PRJSEG_module.board.pinmux_sel=n
CONFIG_MCUX_PRJSEG_module.board.console_lite=n
CONFIG_MCUX_PRJSEG_module.board.boardfile=n
CONFIG_MCUX_PRJSEG_module.board.clock=n
CONFIG_MCUX_PRJSEG_module.board.suite=n
CONFIG_MCUX_PRJSEG_module.board.use_board_clock=n

CONFIG_MCUX_HAS_PRJSEG_project.use_hw_app=n

CONFIG_MCUX_COMPONENT_utilities.misc_utilities=n

# CMSIS layer files
CONFIG_MCUX_COMPONENT_device.startup=n
CONFIG_MCUX_COMPONENT_device.CMSIS=y
CONFIG_MCUX_COMPONENT_device.system=y

# peripheral drivers
CONFIG_MCUX_COMPONENT_driver.i2c=y
CONFIG_MCUX_COMPONENT_driver.lptmr=y
CONFIG_MCUX_COMPONENT_driver.tpm=y
CONFIG_MCUX_COMPONENT_driver.lpuart=n
CONFIG_MCUX_COMPONENT_driver.smc=n
```

## src/main.c
```c
#include "module/init_clock.h"
#include "init_peripherals.h"
#include "bootloader.h"
#include <stdio.h>
#include "key_scanner.h"
#include "module.h"

DEFINE_BOOTLOADER_CONFIG_AREA(I2C_ADDRESS_MODULE_BOOTLOADER)

int main(void)
{
    InitClock();
    InitPeripherals();
    Module_Init();
    InitKeyScanner();

    while (1) {
        Module_Loop();
        __WFI();
    }
}
```

## src/blackberry_trackball.c
```c
#include "fsl_gpio.h"
#include "fsl_port.h"
#include "blackberry_trackball.h"
#include "module.h"

void BlackberryTrackball_Init(void)
{
    CLOCK_EnableClock(BLACKBERRY_TRACKBALL_LEFT_CLOCK);
    PORT_SetPinMux(BLACKBERRY_TRACKBALL_LEFT_PORT, BLACKBERRY_TRACKBALL_LEFT_PIN, kPORT_MuxAsGpio);

    CLOCK_EnableClock(BLACKBERRY_TRACKBALL_RIGHT_CLOCK);
    PORT_SetPinMux(BLACKBERRY_TRACKBALL_RIGHT_PORT, BLACKBERRY_TRACKBALL_RIGHT_PIN, kPORT_MuxAsGpio);

    CLOCK_EnableClock(BLACKBERRY_TRACKBALL_UP_CLOCK);
    PORT_SetPinMux(BLACKBERRY_TRACKBALL_UP_PORT, BLACKBERRY_TRACKBALL_UP_PIN, kPORT_MuxAsGpio);

    CLOCK_EnableClock(BLACKBERRY_TRACKBALL_DOWN_CLOCK);
    PORT_SetPinMux(BLACKBERRY_TRACKBALL_DOWN_PORT, BLACKBERRY_TRACKBALL_DOWN_PIN, kPORT_MuxAsGpio);
}

bool oldLeft, oldRight, oldUp, oldDown;

void BlackberryTrackball_Update(void)
{
    uint8_t newLeft = GPIO_ReadPinInput(BLACKBERRY_TRACKBALL_LEFT_GPIO, BLACKBERRY_TRACKBALL_LEFT_PIN);
    if (oldLeft != newLeft) {
        PointerDelta.x--;
        oldLeft = newLeft;
    }

    uint8_t newRight = GPIO_ReadPinInput(BLACKBERRY_TRACKBALL_RIGHT_GPIO, BLACKBERRY_TRACKBALL_RIGHT_PIN);
    if (oldRight != newRight) {
        PointerDelta.x++;
        oldRight = newRight;
    }

    uint8_t newUp = GPIO_ReadPinInput(BLACKBERRY_TRACKBALL_UP_GPIO, BLACKBERRY_TRACKBALL_UP_PIN);
    if (oldUp != newUp) {
        PointerDelta.y--;
        oldUp = newUp;
    }

    uint8_t newDown = GPIO_ReadPinInput(BLACKBERRY_TRACKBALL_DOWN_GPIO, BLACKBERRY_TRACKBALL_DOWN_PIN);
    if (oldDown != newDown) {
        PointerDelta.y++;
        oldDown = newDown;
    }
}
```

## src/blackberry_trackball.h
```c
#ifndef __BLACKBERRY_TRACKBALL_H__
#define __BLACKBERRY_TRACKBALL_H__

// Includes:

    #include "slave_protocol.h"
    #include "fsl_port.h"

// Macros:

    #define BLACKBERRY_TRACKBALL_LEFT_PORT PORTB
    #define BLACKBERRY_TRACKBALL_LEFT_GPIO GPIOB
    #define BLACKBERRY_TRACKBALL_LEFT_IRQ PORTB_IRQn
    #define BLACKBERRY_TRACKBALL_LEFT_CLOCK kCLOCK_PortB
    #define BLACKBERRY_TRACKBALL_LEFT_PIN 13

    #define BLACKBERRY_TRACKBALL_RIGHT_PORT PORTB
    #define BLACKBERRY_TRACKBALL_RIGHT_GPIO GPIOB
    #define BLACKBERRY_TRACKBALL_RIGHT_IRQ PORTB_IRQn
    #define BLACKBERRY_TRACKBALL_RIGHT_CLOCK kCLOCK_PortB
    #define BLACKBERRY_TRACKBALL_RIGHT_PIN 6

    #define BLACKBERRY_TRACKBALL_UP_PORT PORTA
    #define BLACKBERRY_TRACKBALL_UP_GPIO GPIOA
    #define BLACKBERRY_TRACKBALL_UP_IRQ PORTA_IRQn
    #define BLACKBERRY_TRACKBALL_UP_CLOCK kCLOCK_PortA
    #define BLACKBERRY_TRACKBALL_UP_PIN 3

    #define BLACKBERRY_TRACKBALL_DOWN_PORT PORTA
    #define BLACKBERRY_TRACKBALL_DOWN_GPIO GPIOA
    #define BLACKBERRY_TRACKBALL_DOWN_IRQ PORTA_IRQn
    #define BLACKBERRY_TRACKBALL_DOWN_CLOCK kCLOCK_PortA
    #define BLACKBERRY_TRACKBALL_DOWN_PIN 4

// Functions:

    void BlackberryTrackball_Init(void);
    void BlackberryTrackball_Update(void);

#endif
```

## src/init_peripherals.c
```c
#include "fsl_common.h"
#include "fsl_port.h"
#include "test_led.h"
#include "init_peripherals.h"
#include "i2c_addresses.h"
#include "fsl_i2c.h"
#include "fsl_clock.h"
#include "i2c.h"
#include "led_pwm.h"
#include "slave_protocol_handler.h"
#include "i2c_watchdog.h"
#include "module.h"

i2c_slave_config_t slaveConfig;
i2c_slave_handle_t slaveHandle;

uint8_t userData;
uint8_t rxMessagePos;
uint8_t dosBuffer[2];

static void i2cSlaveCallback(I2C_Type *base, i2c_slave_transfer_t *xfer, void *userDataArg)
{
    dosBuffer[0] = xfer->event;
    dosBuffer[1] = userData;

    switch (xfer->event) {
        case kI2C_SlaveTransmitEvent:
            SlaveTxHandler();
            xfer->data = (uint8_t*)&TxMessage;
            xfer->dataSize = TxMessage.length + I2C_MESSAGE_HEADER_LENGTH;
            break;
        case kI2C_SlaveAddressMatchEvent:
            rxMessagePos = 0;
            break;
        case kI2C_SlaveReceiveEvent:
            ((uint8_t*)&RxMessage)[rxMessagePos++] = userData;
            if (RxMessage.length == rxMessagePos-I2C_MESSAGE_HEADER_LENGTH) {
                SlaveRxHandler();
            }
            break;
        default:
            break;
    }
}

void initInterruptPriorities(void)
{
    NVIC_SetPriority(I2C0_IRQn, 1);
    NVIC_SetPriority(TPM1_IRQn, 1);
    NVIC_SetPriority(SPI0_IRQn, 1);
}

void initI2c(void)
{
    port_pin_config_t pinConfig = {
        .pullSelect = kPORT_PullUp,
    };

    CLOCK_EnableClock(I2C_BUS_SDA_CLOCK);
    CLOCK_EnableClock(I2C_BUS_SCL_CLOCK);

    pinConfig.mux = I2C_BUS_MUX;
    PORT_SetPinConfig(I2C_BUS_SDA_PORT, I2C_BUS_SDA_PIN, &pinConfig);
    PORT_SetPinConfig(I2C_BUS_SCL_PORT, I2C_BUS_SCL_PIN, &pinConfig);

    I2C_SlaveGetDefaultConfig(&slaveConfig);
    slaveConfig.slaveAddress = I2C_ADDRESS_MODULE_FIRMWARE;
    I2C_SlaveInit(I2C_BUS_BASEADDR, &slaveConfig);
    I2C_SlaveTransferCreateHandle(I2C_BUS_BASEADDR, &slaveHandle, i2cSlaveCallback, &userData);
    I2C_SlaveTransferNonBlocking(I2C_BUS_BASEADDR, &slaveHandle, kI2C_SlaveAddressMatchEvent);
}

void InitLedDriver(void)
{
    CLOCK_EnableClock(LED_DRIVER_SDB_CLOCK);
    PORT_SetPinMux(LED_DRIVER_SDB_PORT, LED_DRIVER_SDB_PIN, kPORT_MuxAsGpio);
    GPIO_PinInit(LED_DRIVER_SDB_GPIO, LED_DRIVER_SDB_PIN, &(gpio_pin_config_t){kGPIO_DigitalOutput, 0});
    GPIO_WritePinOutput(LED_DRIVER_SDB_GPIO, LED_DRIVER_SDB_PIN, 1);
}

void InitPeripherals(void)
{
    initInterruptPriorities();
    InitLedDriver();
    TestLed_Init();
    LedPwm_Init();
    initI2c();
}
```

## src/key_scanner.c
```c
#include "fsl_lptmr.h"
#include "key_scanner.h"
#include "i2c_watchdog.h"

void KEY_SCANNER_HANDLER(void)
{
    #if KEY_ARRAY_TYPE == KEY_ARRAY_TYPE_VECTOR
        KeyVector_Scan(&keyVector);
    #elif KEY_ARRAY_TYPE == KEY_ARRAY_TYPE_MATRIX
        KeyMatrix_ScanRow(&keyMatrix);
    #endif
    RunWatchdog();
    LPTMR_ClearStatusFlags(KEY_SCANNER_LPTMR_BASEADDR, kLPTMR_TimerCompareFlag);
}

void InitKeyScanner(void)
{
    lptmr_config_t lptmrConfig;
    LPTMR_GetDefaultConfig(&lptmrConfig);
    LPTMR_Init(KEY_SCANNER_LPTMR_BASEADDR, &lptmrConfig);

    #if KEY_ARRAY_TYPE == KEY_ARRAY_TYPE_MATRIX
        uint8_t scanCountPerUsec = KEYBOARD_MATRIX_ROWS_NUM;
    #else
        uint8_t scanCountPerUsec = 1;
    #endif
    LPTMR_SetTimerPeriod(KEY_SCANNER_LPTMR_BASEADDR, USEC_TO_COUNT(1000 / scanCountPerUsec, LPTMR_SOURCE_CLOCK));
    LPTMR_EnableInterrupts(KEY_SCANNER_LPTMR_BASEADDR, kLPTMR_TimerInterruptEnable);
    EnableIRQ(KEY_SCANNER_LPTMR_IRQ_ID);
    LPTMR_StartTimer(KEY_SCANNER_LPTMR_BASEADDR);
}
```

## src/key_scanner.h
```c
#ifndef __KEY_SCANNER_H__
#define __KEY_SCANNER_H__

// Includes:

    #include "main.h"

// Macros:

    #define LPTMR_SOURCE_CLOCK CLOCK_GetFreq(kCLOCK_LpoClk)

    #define KEY_SCANNER_LPTMR_BASEADDR LPTMR0
    #define KEY_SCANNER_LPTMR_IRQ_ID   LPTMR0_IRQn
    #define KEY_SCANNER_HANDLER        LPTMR0_IRQHandler

    #define KEY_SCANNER_INTERVAL_USEC (1000 / KEYBOARD_VECTOR_ITEMS_NUM)

// Functions:

    void InitKeyScanner(void);

#endif
```

## src/led_pwm.h
```c
#ifndef __LED_PWM_H__
#define __LED_PWM_H__

// Includes:

    #include "fsl_tpm.h"

// Macros:

    #define LED_PWM_PORT  PORTB
    #define LED_PWM_CLOCK kCLOCK_PortB
    #define LED_PWM_PIN   5

    #define LED_PWM_TPM_BASEADDR TPM1
    #define LED_PWM_TPM_CHANNEL kTPM_Chnl_1

    #define TPM_SOURCE_CLOCK CLOCK_GetFreq(kCLOCK_BusClk)
    #define TPM_PWM_FREQUENCY 24000U

    #define INITIAL_DUTY_CYCLE_PERCENT 100U

// Functions:

    void LedPwm_Init(void);
    void LedPwm_SetBrightness(uint8_t brightnessPercent);

#endif
```

## src/main.h
```c
#ifndef __MAIN_H__
#define __MAIN_H__

// Includes:

    #include "key_matrix.h"

// Macros:

    #define KEYBOARD_MATRIX_COLS_NUM 2
    #define KEYBOARD_MATRIX_ROWS_NUM 2

// Variables:

    extern key_matrix_t keyMatrix;

#endif
```

## src/module.c
```c
#include "fsl_gpio.h"
#include "fsl_port.h"
#include "module.h"

#define BLACKBERRY_TRACKBALL_LEFT_PORT PORTA
#define BLACKBERRY_TRACKBALL_LEFT_GPIO GPIOA
#define BLACKBERRY_TRACKBALL_LEFT_IRQ PORTA_IRQn
#define BLACKBERRY_TRACKBALL_LEFT_CLOCK kCLOCK_PortA
#define BLACKBERRY_TRACKBALL_LEFT_PIN 9

#define BLACKBERRY_TRACKBALL_RIGHT_PORT PORTB
#define BLACKBERRY_TRACKBALL_RIGHT_GPIO GPIOB
#define BLACKBERRY_TRACKBALL_RIGHT_IRQ PORTB_IRQn
#define BLACKBERRY_TRACKBALL_RIGHT_CLOCK kCLOCK_PortB
#define BLACKBERRY_TRACKBALL_RIGHT_PIN 6

#define BLACKBERRY_TRACKBALL_UP_PORT PORTB
#define BLACKBERRY_TRACKBALL_UP_GPIO GPIOB
#define BLACKBERRY_TRACKBALL_UP_IRQ PORTB_IRQn
#define BLACKBERRY_TRACKBALL_UP_CLOCK kCLOCK_PortB
#define BLACKBERRY_TRACKBALL_UP_PIN 13

#define BLACKBERRY_TRACKBALL_DOWN_PORT PORTA
#define BLACKBERRY_TRACKBALL_DOWN_GPIO GPIOA
#define BLACKBERRY_TRACKBALL_DOWN_IRQ PORTA_IRQn
#define BLACKBERRY_TRACKBALL_DOWN_CLOCK kCLOCK_PortA
#define BLACKBERRY_TRACKBALL_DOWN_PIN 12

pointer_delta_t PointerDelta;

key_vector_t KeyVector = {
    .itemNum = KEYBOARD_VECTOR_ITEMS_NUM,
    .items = (key_vector_pin_t[]) {
        {PORTB, GPIOB, kCLOCK_PortB, 10}, // top key
        {PORTA, GPIOA, kCLOCK_PortA,  6}, // left key
        {PORTB, GPIOB, kCLOCK_PortB,  2}, // right key
        {PORTB, GPIOB, kCLOCK_PortB,  1}, // left microswitch
        {PORTB, GPIOB, kCLOCK_PortB,  7}, // trackball microswitch
        {PORTA, GPIOA, kCLOCK_PortA,  8}, // right microswitch
    },
    .keyStates = {0}
};

void BlackberryTrackball_Init(void)
{
    CLOCK_EnableClock(BLACKBERRY_TRACKBALL_LEFT_CLOCK);
    PORT_SetPinConfig(BLACKBERRY_TRACKBALL_LEFT_PORT, BLACKBERRY_TRACKBALL_LEFT_PIN,
        &(port_pin_config_t){.pullSelect=kPORT_PullUp, .mux=kPORT_MuxAsGpio});

    CLOCK_EnableClock(BLACKBERRY_TRACKBALL_RIGHT_CLOCK);
    PORT_SetPinConfig(BLACKBERRY_TRACKBALL_RIGHT_PORT, BLACKBERRY_TRACKBALL_RIGHT_PIN,
        &(port_pin_config_t){.pullSelect=kPORT_PullUp, .mux=kPORT_MuxAsGpio});

    CLOCK_EnableClock(BLACKBERRY_TRACKBALL_UP_CLOCK);
    PORT_SetPinConfig(BLACKBERRY_TRACKBALL_UP_PORT, BLACKBERRY_TRACKBALL_UP_PIN,
        &(port_pin_config_t){.pullSelect=kPORT_PullUp, .mux=kPORT_MuxAsGpio});

    CLOCK_EnableClock(BLACKBERRY_TRACKBALL_DOWN_CLOCK);
    PORT_SetPinConfig(BLACKBERRY_TRACKBALL_DOWN_PORT, BLACKBERRY_TRACKBALL_DOWN_PIN,
        &(port_pin_config_t){.pullSelect=kPORT_PullUp, .mux=kPORT_MuxAsGpio});
}

void InitLedDriverSdb(void)
{
    CLOCK_EnableClock(SDB_CLOCK);
    PORT_SetPinMux(SDB_PORT, SDB_PIN, kPORT_MuxAsGpio);
    GPIO_PinInit(SDB_GPIO, SDB_PIN, &(gpio_pin_config_t){kGPIO_DigitalOutput, 0});
    GPIO_PinWrite(SDB_GPIO, SDB_PIN, 1);
}

void BlackberryTrackball_Update(void)
{
    static bool oldLeft, oldRight, oldUp, oldDown, firstRun=true;

    uint8_t newLeft = GPIO_PinRead(BLACKBERRY_TRACKBALL_LEFT_GPIO, BLACKBERRY_TRACKBALL_LEFT_PIN);
    if (oldLeft != newLeft) {
        PointerDelta.x--;
        oldLeft = newLeft;
    }

    uint8_t newRight = GPIO_PinRead(BLACKBERRY_TRACKBALL_RIGHT_GPIO, BLACKBERRY_TRACKBALL_RIGHT_PIN);
    if (oldRight != newRight) {
        PointerDelta.x++;
        oldRight = newRight;
    }

    uint8_t newUp = GPIO_PinRead(BLACKBERRY_TRACKBALL_UP_GPIO, BLACKBERRY_TRACKBALL_UP_PIN);
    if (oldUp != newUp) {
        PointerDelta.y--;
        oldUp = newUp;
    }

    uint8_t newDown = GPIO_PinRead(BLACKBERRY_TRACKBALL_DOWN_GPIO, BLACKBERRY_TRACKBALL_DOWN_PIN);
    if (oldDown != newDown) {
        PointerDelta.y++;
        oldDown = newDown;
    }

    if (firstRun) {
        PointerDelta.x = 0;
        PointerDelta.y = 0;
        firstRun = false;
    }
}

void Module_Init(void)
{
    KeyVector_Init(&KeyVector);
    BlackberryTrackball_Init();
    InitLedDriverSdb();
}

void Module_Loop(void)
{
    BlackberryTrackball_Update();
}

void Module_ModuleSpecificCommand(module_specific_command_t command)
{
}

void Module_OnScan(void)
{
}
```

## src/module.h
```c
#ifndef __MODULE_H__
#define __MODULE_H__

// Includes:

    #include "fsl_tpm.h"
    #include "module/module_api.h"
    #include "key_vector.h"
    #include "slave_protocol.h"

// Macros:

    #define I2C_ADDRESS_MODULE_FIRMWARE I2C_ADDRESS_LEFT_MODULE_FIRMWARE
    #define I2C_ADDRESS_MODULE_BOOTLOADER I2C_ADDRESS_LEFT_MODULE_BOOTLOADER

    #define MODULE_PROTOCOL_VERSION 1
    #define MODULE_ID ModuleId_KeyClusterLeft
    #define MODULE_KEY_COUNT KEYBOARD_VECTOR_ITEMS_NUM
    #define MODULE_POINTER_COUNT 1

    #define TEST_LED_GPIO  GPIOB
    #define TEST_LED_PORT  PORTB
    #define TEST_LED_CLOCK kCLOCK_PortB
    #define TEST_LED_PIN   11

    #define SDB_GPIO  GPIOA
    #define SDB_PORT  PORTA
    #define SDB_CLOCK kCLOCK_PortA
    #define SDB_PIN   5

    #define KEY_ARRAY_TYPE KEY_ARRAY_TYPE_VECTOR
    #define KEYBOARD_VECTOR_ITEMS_NUM 6

// Variables:

    extern key_vector_t KeyVector;
    extern pointer_delta_t PointerDelta;

// Functions:

    void Module_Init(void);
    void Module_Loop(void);
    void Module_OnScan(void);
    void Module_ModuleSpecificCommand(module_specific_command_t command);

#endif
```

## src/slave_protocol_handler.c
```c
#include "slave_protocol_handler.h"
#include "module/test_led.h"
#include "i2c_addresses.h"
#include "module/i2c.h"
#include "module/led_pwm.h"
#include "slave_protocol.h"
#include "init_peripherals.h"
#include "bool_array_converter.h"
#include "bootloader.h"
#include "module.h"
#include "versions.h"

i2c_message_t RxMessage;
i2c_message_t TxMessage;

static version_t moduleProtocolVersion = {
    MODULE_PROTOCOL_MAJOR_VERSION,
    MODULE_PROTOCOL_MINOR_VERSION,
    MODULE_PROTOCOL_PATCH_VERSION,
};

static version_t firmwareVersion = {
    FIRMWARE_MAJOR_VERSION,
    FIRMWARE_MINOR_VERSION,
    FIRMWARE_PATCH_VERSION,
};

void SlaveRxHandler(void)
{
    if (!CRC16_IsMessageValid(&RxMessage)) {
        TxMessage.length = 0;
        return;
    }

    uint8_t commandId = RxMessage.data[0];
    switch (commandId) {
        case SlaveCommand_JumpToBootloader:
            NVIC_SystemReset();
            break;
        case SlaveCommand_SetTestLed:
            TxMessage.length = 0;
            bool isLedOn = RxMessage.data[1];
            TestLed_Set(isLedOn);
            break;
        case SlaveCommand_SetLedPwmBrightness:
            TxMessage.length = 0;
            uint8_t brightnessPercent = RxMessage.data[1];
            LedPwm_SetBrightness(brightnessPercent);
            break;
    }
}

void SlaveTxHandler(void)
{
    uint8_t commandId = RxMessage.data[0];
    switch (commandId) {
        case SlaveCommand_RequestProperty: {
            uint8_t propertyId = RxMessage.data[1];
            switch (propertyId) {
                case SlaveProperty_Sync: {
                    memcpy(TxMessage.data, SlaveSyncString, SLAVE_SYNC_STRING_LENGTH);
                    TxMessage.length = SLAVE_SYNC_STRING_LENGTH;
                    break;
                }
                case SlaveProperty_ModuleProtocolVersion: {
                    memcpy(TxMessage.data, &moduleProtocolVersion, sizeof(version_t));
                    TxMessage.length = sizeof(version_t);
                    break;
                }
                case SlaveProperty_FirmwareVersion: {
                    memcpy(TxMessage.data, &firmwareVersion, sizeof(version_t));
                    TxMessage.length = sizeof(version_t);
                    break;
                }
                case SlaveProperty_ModuleId: {
                    TxMessage.data[0] = MODULE_ID;
                    TxMessage.length = 1;
                    break;
                }
                case SlaveProperty_KeyCount: {
                    TxMessage.data[0] = MODULE_KEY_COUNT;
                    TxMessage.length = 1;
                    break;
                }
                case SlaveProperty_PointerCount: {
                    TxMessage.data[0] = MODULE_POINTER_COUNT;
                    TxMessage.length = 1;
                    break;
                }
            }
            break;
        }
        case SlaveCommand_RequestKeyStates: {
            #if KEY_ARRAY_TYPE == KEY_ARRAY_TYPE_VECTOR
                BoolBytesToBits(keyVector.keyStates, TxMessage.data, MODULE_KEY_COUNT);
            #elif KEY_ARRAY_TYPE == KEY_ARRAY_TYPE_MATRIX
                BoolBytesToBits(keyMatrix.keyStates, TxMessage.data, MODULE_KEY_COUNT);
            #endif
            uint8_t messageLength = BOOL_BYTES_TO_BITS_COUNT(MODULE_KEY_COUNT);
            if (MODULE_POINTER_COUNT) {
                pointer_delta_t *pointerDelta = (pointer_delta_t*)(TxMessage.data + messageLength);
                pointerDelta->x = PointerDelta.x;
                pointerDelta->y = PointerDelta.y;
                PointerDelta.x = 0;
                PointerDelta.y = 0;
                messageLength += sizeof(pointer_delta_t);
            }
            TxMessage.length = messageLength;
            break;
        }
    }

    CRC16_UpdateMessageChecksum(&TxMessage);
}
```

## src/test_led.h
```c
#ifndef __TEST_LED_H__
#define __TEST_LED_H__

// Includes:

    #include "fsl_gpio.h"

// Macros:

    #define LOGIC_LED_ON  0U
    #define LOGIC_LED_OFF 1U

    #define TEST_LED_GPIO  GPIOB
    #define TEST_LED_PORT  PORTB
    #define TEST_LED_CLOCK kCLOCK_PortB
    #define TEST_LED_PIN   13

    static inline void TestLed_On(void)
    {
        GPIO_SetPinsOutput(TEST_LED_GPIO, 1U << TEST_LED_PIN);
    }

    static inline void TestLed_Off(void)
    {
        GPIO_ClearPinsOutput(TEST_LED_GPIO, 1U << TEST_LED_PIN);
    }

    static inline void TestLed_Set(bool state)
    {
        GPIO_WritePinOutput(TEST_LED_GPIO, TEST_LED_PIN, state);
    }

    static inline void TestLed_Toggle(void)
    {
        GPIO_TogglePinsOutput(TEST_LED_GPIO, 1U << TEST_LED_PIN);
    }

// Functions:

    void TestLed_Init(void);

#endif
```
