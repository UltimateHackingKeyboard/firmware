## CMakeLists.txt
```
cmake_minimum_required(VERSION 3.22.0)

add_subdirectory(sysbuild)

set(CMAKE_EXPORT_COMPILE_COMMANDS ON)
set(CMAKE_C_STANDARD 11)
set(CMAKE_C_STANDARD_REQUIRED ON)

set(board frdmkl03z) # TODO: how to remove the board selection?
set(device MKL03Z4)

include(${SdkRootDirPath}/cmake/extension/mcux.cmake)
project(uhk-trackball
    LANGUAGES "ASM" "C" "CXX"
)
include(${SdkRootDirPath}/CMakeLists.txt)

set(IS_MCUX_SDK ON)

include(${CMAKE_CURRENT_SOURCE_DIR}/../shared/CMakeLists.txt)
include(${CMAKE_CURRENT_SOURCE_DIR}/../shared/module/CMakeLists.txt)
```

## prj.conf
```kconfig
# disable board (and device) specific source files, as the project has its own sources
# examples/_common/project_segments/common/Kconfig.prjseg
CONFIG_MCUX_HAS_PRJSEG_module.board.pinmux_sel=n
CONFIG_MCUX_PRJSEG_module.board.console_lite=n
CONFIG_MCUX_PRJSEG_module.board.boardfile=n
CONFIG_MCUX_PRJSEG_module.board.clock=n
CONFIG_MCUX_PRJSEG_module.board.suite=n
CONFIG_MCUX_PRJSEG_module.board.use_board_clock=n

CONFIG_MCUX_HAS_PRJSEG_project.use_hw_app=n

CONFIG_MCUX_COMPONENT_utilities.misc_utilities=n

# CMSIS layer files
CONFIG_MCUX_COMPONENT_device.startup=n
CONFIG_MCUX_COMPONENT_device.CMSIS=y
CONFIG_MCUX_COMPONENT_device.system=y

# peripheral drivers
CONFIG_MCUX_COMPONENT_driver.i2c=y
CONFIG_MCUX_COMPONENT_driver.lptmr=y
CONFIG_MCUX_COMPONENT_driver.spi=y
CONFIG_MCUX_COMPONENT_driver.tpm=y
CONFIG_MCUX_COMPONENT_driver.lpuart=y
CONFIG_MCUX_COMPONENT_driver.smc=n
```

## src/main.c
```c
#include "module/init_clock.h"
#include "init_peripherals.h"
#include "bootloader.h"
#include <stdio.h>
#include "key_scanner.h"
#include "module.h"
#include "trackball.h"

DEFINE_BOOTLOADER_CONFIG_AREA(I2C_ADDRESS_MODULE_BOOTLOADER)

int main(void)
{
    InitClock();
    InitPeripherals();
    Module_Init();
    InitKeyScanner();

    while (1) {
        __WFI();
    }
}
```

## src/blackberry_trackball.h
```c
#ifndef __BLACKBERRY_TRACKBALL_H__
#define __BLACKBERRY_TRACKBALL_H__

// Includes:

    #include "slave_protocol.h"
    #include "fsl_port.h"

// Macros:

    #define BLACKBERRY_TRACKBALL_LEFT_PORT PORTB
    #define BLACKBERRY_TRACKBALL_LEFT_GPIO GPIOB
    #define BLACKBERRY_TRACKBALL_LEFT_IRQ PORTB_IRQn
    #define BLACKBERRY_TRACKBALL_LEFT_CLOCK kCLOCK_PortB
    #define BLACKBERRY_TRACKBALL_LEFT_PIN 13

    #define BLACKBERRY_TRACKBALL_RIGHT_PORT PORTB
    #define BLACKBERRY_TRACKBALL_RIGHT_GPIO GPIOB
    #define BLACKBERRY_TRACKBALL_RIGHT_IRQ PORTB_IRQn
    #define BLACKBERRY_TRACKBALL_RIGHT_CLOCK kCLOCK_PortB
    #define BLACKBERRY_TRACKBALL_RIGHT_PIN 6

    #define BLACKBERRY_TRACKBALL_UP_PORT PORTA
    #define BLACKBERRY_TRACKBALL_UP_GPIO GPIOA
    #define BLACKBERRY_TRACKBALL_UP_IRQ PORTA_IRQn
    #define BLACKBERRY_TRACKBALL_UP_CLOCK kCLOCK_PortA
    #define BLACKBERRY_TRACKBALL_UP_PIN 3

    #define BLACKBERRY_TRACKBALL_DOWN_PORT PORTA
    #define BLACKBERRY_TRACKBALL_DOWN_GPIO GPIOA
    #define BLACKBERRY_TRACKBALL_DOWN_IRQ PORTA_IRQn
    #define BLACKBERRY_TRACKBALL_DOWN_CLOCK kCLOCK_PortA
    #define BLACKBERRY_TRACKBALL_DOWN_PIN 4

// Variables:

    extern pointer_delta_t BlackBerryTrackball_PointerDelta;

// Functions:

    void BlackberryTrackball_Init(void);
    void BlackberryTrackball_Update(void);

#endif
```

## src/i2c_watchdog.c
```c
#include "fsl_i2c.h"
#include "i2c.h"
#include "i2c_watchdog.h"
#include "test_led.h"
#include "init_peripherals.h"

// NOTE: Because of a bug in the ROM bootloader of the KL03Z, the watchdog timer is disabled and cannot be re-enabled.
// See https://community.nxp.com/thread/457893
// Therefore the hardware watchdog timer cannot be used without an extra way to enter bootloader or application mode.
static uint32_t prevWatchdogCounter = 0;
static uint32_t I2cWatchdog_RecoveryCounter; // Counter for how many times we had to recover and restart

void RunWatchdog(void)
{
    static volatile uint32_t I2cWatchdog_WatchCounter = 0; // Counter for timer
    static int counter = 0;

    counter++;
    if (counter == 100) { // We get called from KEY_SCANNER_HANDLER() which runs at 1ms, thus scaling down by 100 here to get 100 ms period
        counter=0;
//        TestLed_Toggle();
        I2cWatchdog_WatchCounter++;

        if (I2cWatchdog_WatchCounter > 10) { // Do not check within the first 1000 ms, as I2C might not be running yet
            if (I2C_Watchdog == prevWatchdogCounter) { // Restart I2C if there hasn't been any interrupt during 100 ms. I2C_Watchdog gets incremented for every I2C transaction
                I2cWatchdog_RecoveryCounter++;
                I2C_SlaveDeinit(I2C_BUS_BASEADDR);
                initI2c();
            }
        }
        prevWatchdogCounter = I2C_Watchdog;
    }
}
```

## src/init_peripherals.c
```c
#include "fsl_common.h"
#include "fsl_port.h"
#include "test_led.h"
#include "init_peripherals.h"
#include "i2c_addresses.h"
#include "fsl_i2c.h"
#include "fsl_clock.h"
#include "module/i2c.h"
#include "module/led_pwm.h"
#include "slave_protocol_handler.h"
#include "module/i2c_watchdog.h"
#include "module.h"

i2c_slave_config_t slaveConfig;
i2c_slave_handle_t slaveHandle;

uint8_t userData;
uint8_t rxMessagePos;
uint8_t dosBuffer[2];

static void i2cSlaveCallback(I2C_Type *base, i2c_slave_transfer_t *xfer, void *userDataArg)
{
    dosBuffer[0] = xfer->event;
    dosBuffer[1] = userData;

    switch (xfer->event) {
        case kI2C_SlaveTransmitEvent:
            SlaveTxHandler();
            xfer->data = (uint8_t*)&TxMessage;
            xfer->dataSize = TxMessage.length + I2C_MESSAGE_HEADER_LENGTH;
            break;
        case kI2C_SlaveAddressMatchEvent:
            rxMessagePos = 0;
            break;
        case kI2C_SlaveReceiveEvent:
            ((uint8_t*)&RxMessage)[rxMessagePos++] = userData;
            if (RxMessage.length == rxMessagePos-I2C_MESSAGE_HEADER_LENGTH) {
                SlaveRxHandler();
            }
            break;
        default:
            break;
    }
}

void initInterruptPriorities(void)
{
    NVIC_SetPriority(I2C0_IRQn, 1);
    NVIC_SetPriority(TPM1_IRQn, 1);
    NVIC_SetPriority(SPI0_IRQn, 1);
}

void initI2c(void)
{
    port_pin_config_t pinConfig = {
        .pullSelect = kPORT_PullUp,
    };

    CLOCK_EnableClock(I2C_BUS_SDA_CLOCK);
    CLOCK_EnableClock(I2C_BUS_SCL_CLOCK);

    pinConfig.mux = I2C_BUS_MUX;
    PORT_SetPinConfig(I2C_BUS_SDA_PORT, I2C_BUS_SDA_PIN, &pinConfig);
    PORT_SetPinConfig(I2C_BUS_SCL_PORT, I2C_BUS_SCL_PIN, &pinConfig);

    I2C_SlaveGetDefaultConfig(&slaveConfig);
    slaveConfig.slaveAddress = I2C_ADDRESS_MODULE_FIRMWARE;
    I2C_SlaveInit(I2C_BUS_BASEADDR, &slaveConfig);
    I2C_SlaveTransferCreateHandle(I2C_BUS_BASEADDR, &slaveHandle, i2cSlaveCallback, &userData);
    I2C_SlaveTransferNonBlocking(I2C_BUS_BASEADDR, &slaveHandle, kI2C_SlaveAddressMatchEvent);
}

void InitLedDriver(void)
{
    CLOCK_EnableClock(LED_DRIVER_SDB_CLOCK);
    PORT_SetPinMux(LED_DRIVER_SDB_PORT, LED_DRIVER_SDB_PIN, kPORT_MuxAsGpio);
    GPIO_PinInit(LED_DRIVER_SDB_GPIO, LED_DRIVER_SDB_PIN, &(gpio_pin_config_t){kGPIO_DigitalOutput, 0});
    GPIO_WritePinOutput(LED_DRIVER_SDB_GPIO, LED_DRIVER_SDB_PIN, 1);
}

void InitPeripherals(void)
{
    initInterruptPriorities();
    InitLedDriver();
    TestLed_Init();
    LedPwm_Init();
    initI2c();
}
```

## src/key_scanner.c
```c
#include "fsl_lptmr.h"
#include "key_scanner.h"
#include "module/i2c_watchdog.h"

void KEY_SCANNER_HANDLER(void)
{
    #if KEY_ARRAY_TYPE == KEY_ARRAY_TYPE_VECTOR
        KeyVector_Scan(&keyVector);
    #elif KEY_ARRAY_TYPE == KEY_ARRAY_TYPE_MATRIX
        KeyMatrix_ScanRow(&keyMatrix);
    #endif
    RunWatchdog();
    LPTMR_ClearStatusFlags(KEY_SCANNER_LPTMR_BASEADDR, kLPTMR_TimerCompareFlag);
}

void InitKeyScanner(void)
{
    lptmr_config_t lptmrConfig;
    LPTMR_GetDefaultConfig(&lptmrConfig);
    LPTMR_Init(KEY_SCANNER_LPTMR_BASEADDR, &lptmrConfig);

    #if KEY_ARRAY_TYPE == KEY_ARRAY_TYPE_MATRIX
        uint8_t scanCountPerUsec = KEYBOARD_MATRIX_ROWS_NUM;
    #else
        uint8_t scanCountPerUsec = 1;
    #endif
    LPTMR_SetTimerPeriod(KEY_SCANNER_LPTMR_BASEADDR, USEC_TO_COUNT(1000 / scanCountPerUsec, LPTMR_SOURCE_CLOCK));
    LPTMR_EnableInterrupts(KEY_SCANNER_LPTMR_BASEADDR, kLPTMR_TimerInterruptEnable);
    EnableIRQ(KEY_SCANNER_LPTMR_IRQ_ID);
    LPTMR_StartTimer(KEY_SCANNER_LPTMR_BASEADDR);
}
```

## src/key_scanner.h
```c
#ifndef __KEY_SCANNER_H__
#define __KEY_SCANNER_H__

// Includes:

    #include "module.h"

// Macros:

    #define LPTMR_SOURCE_CLOCK CLOCK_GetFreq(kCLOCK_LpoClk)

    #define KEY_SCANNER_LPTMR_BASEADDR LPTMR0
    #define KEY_SCANNER_LPTMR_IRQ_ID   LPTMR0_IRQn
    #define KEY_SCANNER_HANDLER        LPTMR0_IRQHandler

    #define KEY_SCANNER_INTERVAL_USEC (1000 / KEYBOARD_VECTOR_ITEMS_NUM)

// Functions:

    void InitKeyScanner(void);

#endif
```

## src/main.h
```c
#ifndef __MAIN_H__
#define __MAIN_H__

// Includes:

    #include "key_vector.h"

// Macros:

    #define KEYBOARD_VECTOR_ITEMS_NUM 2

// Variables:

    extern key_vector_t keyVector;

#endif
```

## src/module.c
```c
#include "fsl_gpio.h"
#include "fsl_port.h"
#include "fsl_spi.h"
#include "module.h"
#include "module/uart.h"
#include "module/init_peripherals.h"

#define TRACKBALL_SHTDWN_PORT PORTA
#define TRACKBALL_SHTDWN_GPIO GPIOA
#define TRACKBALL_SHTDWN_IRQ PORTA_IRQn
#define TRACKBALL_SHTDWN_CLOCK kCLOCK_PortA
#define TRACKBALL_SHTDWN_PIN 4

#define TRACKBALL_NCS_PORT PORTB
#define TRACKBALL_NCS_GPIO GPIOB
#define TRACKBALL_NCS_IRQ PORTB_IRQn
#define TRACKBALL_NCS_CLOCK kCLOCK_PortB
#define TRACKBALL_NCS_PIN 1

#define TRACKBALL_MOSI_PORT PORTA
#define TRACKBALL_MOSI_GPIO GPIOA
#define TRACKBALL_MOSI_IRQ PORTA_IRQn
#define TRACKBALL_MOSI_CLOCK kCLOCK_PortA
#define TRACKBALL_MOSI_PIN 7

#define TRACKBALL_MISO_PORT PORTA
#define TRACKBALL_MISO_GPIO GPIOA
#define TRACKBALL_MISO_IRQ PORTA_IRQn
#define TRACKBALL_MISO_CLOCK kCLOCK_PortA
#define TRACKBALL_MISO_PIN 6

#define TRACKBALL_SCK_PORT PORTB
#define TRACKBALL_SCK_GPIO GPIOB
#define TRACKBALL_SCK_IRQ PORTB_IRQn
#define TRACKBALL_SCK_CLOCK kCLOCK_PortB
#define TRACKBALL_SCK_PIN 0

#define TRACKBALL_SPI_MASTER SPI0
#define TRACKBALL_SPI_MASTER_SOURCE_CLOCK kCLOCK_BusClk

pointer_delta_t PointerDelta;

key_vector_t KeyVector = {
    .itemNum = KEYBOARD_VECTOR_ITEMS_NUM,
    .items = (key_vector_pin_t[]) {
        {PORTA, GPIOA, kCLOCK_PortA, 3}, // left button
        {PORTA, GPIOA, kCLOCK_PortA, 12}, // right button
    },
    .keyStates = {0}
};

#define BUFFER_SIZE 2
#define MOTION_BIT (1<<7)

typedef enum {
    ModulePhase_SetResolution,
    ModulePhase_SetRestRate3,
    ModulePhase_Initialized,
    ModulePhase_ProcessMotion,
    ModulePhase_ProcessDeltaY,
    ModulePhase_ProcessDeltaX,
} module_phase_t;

module_phase_t modulePhase = ModulePhase_SetResolution;

uint8_t txBufferPowerUpReset[] = {0xba, 0x5a};
uint8_t txSetResolution[] = {0x91, 0b10000000};
uint8_t txSetRestRate3[] = {0x18, 0x09};
uint8_t txBufferGetMotion[] = {0x02, 0x00};
uint8_t txBufferGetDeltaY[] = {0x03, 0x00};
uint8_t txBufferGetDeltaX[] = {0x04, 0x00};

uint8_t rxBuffer[BUFFER_SIZE];
spi_master_handle_t handle;
spi_transfer_t xfer = {0};

void tx(uint8_t *txBuff)
{
    GPIO_PinWrite(TRACKBALL_NCS_GPIO, TRACKBALL_NCS_PIN, 1);
    GPIO_PinWrite(TRACKBALL_NCS_GPIO, TRACKBALL_NCS_PIN, 0);
    xfer.txData = txBuff;
    SPI_MasterTransferNonBlocking(TRACKBALL_SPI_MASTER, &handle, &xfer);
}

void trackballUpdate(SPI_Type *base, spi_master_handle_t *masterHandle, status_t status, void *userData)
{
    switch (modulePhase) {
        case ModulePhase_SetResolution:
            tx(txSetResolution);
            modulePhase = ModulePhase_SetRestRate3;
            break;
        case ModulePhase_SetRestRate3:
            tx(txSetRestRate3);
            modulePhase = ModulePhase_Initialized;
            break;
        case ModulePhase_Initialized:
            tx(txBufferGetMotion);
            modulePhase = ModulePhase_ProcessMotion;
            break;
        case ModulePhase_ProcessMotion: ;
            uint8_t motion = rxBuffer[1];
            bool isMoved = motion & MOTION_BIT;
            if (isMoved) {
                tx(txBufferGetDeltaY);
                modulePhase = ModulePhase_ProcessDeltaY;
            } else {
                tx(txBufferGetMotion);
            }
            break;
        case ModulePhase_ProcessDeltaY: ;
            int8_t deltaY = (int8_t)rxBuffer[1];
            PointerDelta.x += deltaY; // This is correct given the sensor orientation.
            tx(txBufferGetDeltaX);
            modulePhase = ModulePhase_ProcessDeltaX;
            break;
        case ModulePhase_ProcessDeltaX: ;
            int8_t deltaX = (int8_t)rxBuffer[1];
            PointerDelta.y += deltaX; // This is correct given the sensor orientation.
            tx(txBufferGetMotion);
            modulePhase = ModulePhase_ProcessMotion;
            if (MODULE_OVER_UART) {
                ModuleUart_RequestKeyStatesUpdate();
            }
            break;
    }
}

void Trackball_Init(void)
{
    CLOCK_EnableClock(TRACKBALL_SHTDWN_CLOCK);
    PORT_SetPinMux(TRACKBALL_SHTDWN_PORT, TRACKBALL_SHTDWN_PIN, kPORT_MuxAsGpio);
    GPIO_PinWrite(TRACKBALL_SHTDWN_GPIO, TRACKBALL_SHTDWN_PIN, 0);

    CLOCK_EnableClock(TRACKBALL_NCS_CLOCK);
    PORT_SetPinMux(TRACKBALL_NCS_PORT, TRACKBALL_NCS_PIN, kPORT_MuxAsGpio);

    CLOCK_EnableClock(TRACKBALL_MOSI_CLOCK);
    PORT_SetPinMux(TRACKBALL_MOSI_PORT, TRACKBALL_MOSI_PIN, kPORT_MuxAlt3);

    CLOCK_EnableClock(TRACKBALL_MISO_CLOCK);
    PORT_SetPinMux(TRACKBALL_MISO_PORT, TRACKBALL_MISO_PIN, kPORT_MuxAlt3);

    CLOCK_EnableClock(TRACKBALL_SCK_CLOCK);
    PORT_SetPinMux(TRACKBALL_SCK_PORT, TRACKBALL_SCK_PIN, kPORT_MuxAlt3);

    uint32_t srcFreq = 0;
    spi_master_config_t userConfig;
    SPI_MasterGetDefaultConfig(&userConfig);
    userConfig.polarity = kSPI_ClockPolarityActiveLow;
    userConfig.phase = kSPI_ClockPhaseSecondEdge;
    userConfig.baudRate_Bps = 100000U;
    srcFreq = CLOCK_GetFreq(TRACKBALL_SPI_MASTER_SOURCE_CLOCK);
    SPI_MasterInit(TRACKBALL_SPI_MASTER, &userConfig, srcFreq);
    SPI_MasterTransferCreateHandle(TRACKBALL_SPI_MASTER, &handle, trackballUpdate, NULL);
    xfer.rxData = rxBuffer;
    xfer.dataSize = BUFFER_SIZE;
    tx(txBufferPowerUpReset);
}

void Module_Init(void)
{
    KeyVector_Init(&KeyVector);
    Trackball_Init();
}

void Module_Loop(void)
{
}

void Module_ModuleSpecificCommand(module_specific_command_t command)
{
}

void Module_OnScan(void)
{
}
```

## src/module.h
```c
#ifndef __MODULE_H__
#define __MODULE_H__

// Includes:

    #include "module/module_api.h"
    #include "key_vector.h"
    #include "module/slave_protocol_handler.h"

// Macros:

    #define I2C_ADDRESS_MODULE_FIRMWARE I2C_ADDRESS_RIGHT_MODULE_FIRMWARE
    #define I2C_ADDRESS_MODULE_BOOTLOADER I2C_ADDRESS_RIGHT_MODULE_BOOTLOADER

    #define MODULE_PROTOCOL_VERSION 1
    #define MODULE_ID ModuleId_TrackballRight
    #define MODULE_KEY_COUNT KEYBOARD_VECTOR_ITEMS_NUM
    #define MODULE_POINTER_COUNT 1

    #define TEST_LED_GPIO  GPIOB
    #define TEST_LED_PORT  PORTB
    #define TEST_LED_CLOCK kCLOCK_PortB
    #define TEST_LED_PIN   2

    #define KEY_ARRAY_TYPE KEY_ARRAY_TYPE_VECTOR
    #define KEYBOARD_VECTOR_ITEMS_NUM 2

// Variables:

    extern key_vector_t KeyVector;
    extern pointer_delta_t PointerDelta;

// Functions:

    void Module_Init(void);
    void Module_Loop(void);
    void Module_OnScan(void);
    void Module_ModuleSpecificCommand(module_specific_command_t command);

#endif
```

## src/slave_protocol_handler.c
```c
#include "slave_protocol_handler.h"
#include "test_led.h"
#include "i2c_addresses.h"
#include "i2c.h"
#include "led_pwm.h"
#include "slave_protocol.h"
#include "init_peripherals.h"
#include "bool_array_converter.h"
#include "bootloader.h"
#include "module.h"
#include "versions.h"

i2c_message_t RxMessage;
i2c_message_t TxMessage;

static version_t moduleProtocolVersion = {
    MODULE_PROTOCOL_MAJOR_VERSION,
    MODULE_PROTOCOL_MINOR_VERSION,
    MODULE_PROTOCOL_PATCH_VERSION,
};

static version_t firmwareVersion = {
    FIRMWARE_MAJOR_VERSION,
    FIRMWARE_MINOR_VERSION,
    FIRMWARE_PATCH_VERSION,
};

void SlaveRxHandler(void)
{
    if (!CRC16_IsMessageValid(&RxMessage)) {
        TxMessage.length = 0;
        return;
    }

    uint8_t commandId = RxMessage.data[0];
    switch (commandId) {
        case SlaveCommand_JumpToBootloader:
            NVIC_SystemReset();
            break;
        case SlaveCommand_SetTestLed:
            TxMessage.length = 0;
            bool isLedOn = RxMessage.data[1];
            TestLed_Set(isLedOn);
            break;
        case SlaveCommand_SetLedPwmBrightness:
            TxMessage.length = 0;
            uint8_t brightnessPercent = RxMessage.data[1];
            LedPwm_SetBrightness(brightnessPercent);
            break;
    }
}

void SlaveTxHandler(void)
{
    uint8_t commandId = RxMessage.data[0];
    switch (commandId) {
        case SlaveCommand_RequestProperty: {
            uint8_t propertyId = RxMessage.data[1];
            switch (propertyId) {
                case SlaveProperty_Sync: {
                    memcpy(TxMessage.data, SlaveSyncString, SLAVE_SYNC_STRING_LENGTH);
                    TxMessage.length = SLAVE_SYNC_STRING_LENGTH;
                    break;
                }
                case SlaveProperty_ModuleProtocolVersion: {
                    memcpy(TxMessage.data, &moduleProtocolVersion, sizeof(version_t));
                    TxMessage.length = sizeof(version_t);
                    break;
                }
                case SlaveProperty_FirmwareVersion: {
                    memcpy(TxMessage.data, &firmwareVersion, sizeof(version_t));
                    TxMessage.length = sizeof(version_t);
                    break;
                }
                case SlaveProperty_ModuleId: {
                    TxMessage.data[0] = MODULE_ID;
                    TxMessage.length = 1;
                    break;
                }
                case SlaveProperty_KeyCount: {
                    TxMessage.data[0] = MODULE_KEY_COUNT;
                    TxMessage.length = 1;
                    break;
                }
                case SlaveProperty_PointerCount: {
                    TxMessage.data[0] = MODULE_POINTER_COUNT;
                    TxMessage.length = 1;
                    break;
                }
            }
            break;
        }
        case SlaveCommand_RequestKeyStates: {
            #if KEY_ARRAY_TYPE == KEY_ARRAY_TYPE_VECTOR
                BoolBytesToBits(keyVector.keyStates, TxMessage.data, MODULE_KEY_COUNT);
            #elif KEY_ARRAY_TYPE == KEY_ARRAY_TYPE_MATRIX
                BoolBytesToBits(keyMatrix.keyStates, TxMessage.data, MODULE_KEY_COUNT);
            #endif
            uint8_t messageLength = BOOL_BYTES_TO_BITS_COUNT(MODULE_KEY_COUNT);
            if (MODULE_POINTER_COUNT) {
                pointer_delta_t *pointerDelta = (pointer_delta_t*)(TxMessage.data + messageLength);
                pointerDelta->x = PointerDelta.x;
                pointerDelta->y = PointerDelta.y;
                PointerDelta.x = 0;
                PointerDelta.y = 0;
                messageLength += sizeof(pointer_delta_t);
            }
            TxMessage.length = messageLength;
            break;
        }
    }

    CRC16_UpdateMessageChecksum(&TxMessage);
}
```

## src/test_led.h
```c
#ifndef __TEST_LED_H__
#define __TEST_LED_H__

// Includes:

    #include "fsl_gpio.h"
    #include "module.h"

// Macros:

    #define LOGIC_LED_ON  0U
    #define LOGIC_LED_OFF 1U

    static inline void TestLed_On(void)
    {
        GPIO_SetPinsOutput(TEST_LED_GPIO, 1U << TEST_LED_PIN);
    }

    static inline void TestLed_Off(void)
    {
        GPIO_ClearPinsOutput(TEST_LED_GPIO, 1U << TEST_LED_PIN);
    }

    static inline void TestLed_Set(bool state)
    {
        GPIO_WritePinOutput(TEST_LED_GPIO, TEST_LED_PIN, state);
    }

    static inline void TestLed_Toggle(void)
    {
        GPIO_TogglePinsOutput(TEST_LED_GPIO, 1U << TEST_LED_PIN);
    }

// Functions:

    void TestLed_Init(void);

#endif
```

## src/trackball.c
```c
#include "fsl_gpio.h"
#include "fsl_port.h"
#include "fsl_spi.h"
#include "trackball.h"
#include "module.h"

#define BUFFER_SIZE 2
#define MOTION_BIT (1<<7)

typedef enum {
    ModulePhase_PoweredUp,
    ModulePhase_ProcessMotion,
    ModulePhase_ProcessDeltaY,
    ModulePhase_ProcessDeltaX,
} module_phase_t;

module_phase_t modulePhase = ModulePhase_PoweredUp;

uint8_t txBufferPowerUpReset[] = {0xba, 0x5a};
uint8_t txBufferGetMotion[] = {0x02, 0x00};
uint8_t txBufferGetDeltaY[] = {0x03, 0x00};
uint8_t txBufferGetDeltaX[] = {0x04, 0x00};

uint8_t rxBuffer[BUFFER_SIZE];
spi_master_handle_t handle;
spi_transfer_t xfer = {0};

void tx(uint8_t *txBuff)
{
    GPIO_WritePinOutput(TRACKBALL_NCS_GPIO, TRACKBALL_NCS_PIN, 1);
    GPIO_WritePinOutput(TRACKBALL_NCS_GPIO, TRACKBALL_NCS_PIN, 0);
    xfer.txData = txBuff;
    SPI_MasterTransferNonBlocking(TRACKBALL_SPI_MASTER, &handle, &xfer);
}

void trackballUpdate(SPI_Type *base, spi_master_handle_t *masterHandle, status_t status, void *userData)
{
    switch (modulePhase) {
        case ModulePhase_PoweredUp:
            tx(txBufferGetMotion);
            modulePhase = ModulePhase_ProcessMotion;
            break;
        case ModulePhase_ProcessMotion: ;
            uint8_t motion = rxBuffer[1];
            bool isMoved = motion & MOTION_BIT;
            if (isMoved) {
                tx(txBufferGetDeltaY);
                modulePhase = ModulePhase_ProcessDeltaY;
            } else {
                tx(txBufferGetMotion);
            }
            break;
        case ModulePhase_ProcessDeltaY: ;
            int8_t deltaY = (int8_t)rxBuffer[1];
            PointerDelta.x += deltaY; // This is correct given the sensor orientation.
            tx(txBufferGetDeltaX);
            modulePhase = ModulePhase_ProcessDeltaX;
            break;
        case ModulePhase_ProcessDeltaX: ;
            int8_t deltaX = (int8_t)rxBuffer[1];
            PointerDelta.y += deltaX; // This is correct given the sensor orientation.
            tx(txBufferGetMotion);
            modulePhase = ModulePhase_ProcessMotion;
            break;
    }
}

void Trackball_Init(void)
{
    CLOCK_EnableClock(TRACKBALL_SHTDWN_CLOCK);
    PORT_SetPinMux(TRACKBALL_SHTDWN_PORT, TRACKBALL_SHTDWN_PIN, kPORT_MuxAsGpio);
    GPIO_WritePinOutput(TRACKBALL_SHTDWN_GPIO, TRACKBALL_SHTDWN_PIN, 0);

    CLOCK_EnableClock(TRACKBALL_NCS_CLOCK);
    PORT_SetPinMux(TRACKBALL_NCS_PORT, TRACKBALL_NCS_PIN, kPORT_MuxAsGpio);

    CLOCK_EnableClock(TRACKBALL_MOSI_CLOCK);
    PORT_SetPinMux(TRACKBALL_MOSI_PORT, TRACKBALL_MOSI_PIN, kPORT_MuxAlt3);

    CLOCK_EnableClock(TRACKBALL_MISO_CLOCK);
    PORT_SetPinMux(TRACKBALL_MISO_PORT, TRACKBALL_MISO_PIN, kPORT_MuxAlt3);

    CLOCK_EnableClock(TRACKBALL_SCK_CLOCK);
    PORT_SetPinMux(TRACKBALL_SCK_PORT, TRACKBALL_SCK_PIN, kPORT_MuxAlt3);

    uint32_t srcFreq = 0;
    spi_master_config_t userConfig;
    SPI_MasterGetDefaultConfig(&userConfig);
    userConfig.polarity = kSPI_ClockPolarityActiveLow;
    userConfig.phase = kSPI_ClockPhaseSecondEdge;
    userConfig.baudRate_Bps = 100000U;
    srcFreq = CLOCK_GetFreq(TRACKBALL_SPI_MASTER_SOURCE_CLOCK);
    SPI_MasterInit(TRACKBALL_SPI_MASTER, &userConfig, srcFreq);
    SPI_MasterTransferCreateHandle(TRACKBALL_SPI_MASTER, &handle, trackballUpdate, NULL);
    xfer.rxData = rxBuffer;
    xfer.dataSize = BUFFER_SIZE;
    tx(txBufferPowerUpReset);
}
```

## src/trackball.h
```c
#ifndef __TRACKBALL_H__
#define __TRACKBALL_H__

// Includes:

    #include "slave_protocol.h"
    #include "fsl_port.h"

// Macros:

    #define TRACKBALL_SHTDWN_PORT PORTA
    #define TRACKBALL_SHTDWN_GPIO GPIOA
    #define TRACKBALL_SHTDWN_IRQ PORTA_IRQn
    #define TRACKBALL_SHTDWN_CLOCK kCLOCK_PortA
    #define TRACKBALL_SHTDWN_PIN 4

    #define TRACKBALL_NCS_PORT PORTB
    #define TRACKBALL_NCS_GPIO GPIOB
    #define TRACKBALL_NCS_IRQ PORTB_IRQn
    #define TRACKBALL_NCS_CLOCK kCLOCK_PortB
    #define TRACKBALL_NCS_PIN 1

    #define TRACKBALL_MOSI_PORT PORTA
    #define TRACKBALL_MOSI_GPIO GPIOA
    #define TRACKBALL_MOSI_IRQ PORTA_IRQn
    #define TRACKBALL_MOSI_CLOCK kCLOCK_PortA
    #define TRACKBALL_MOSI_PIN 7

    #define TRACKBALL_MISO_PORT PORTA
    #define TRACKBALL_MISO_GPIO GPIOA
    #define TRACKBALL_MISO_IRQ PORTA_IRQn
    #define TRACKBALL_MISO_CLOCK kCLOCK_PortA
    #define TRACKBALL_MISO_PIN 6

    #define TRACKBALL_SCK_PORT PORTB
    #define TRACKBALL_SCK_GPIO GPIOB
    #define TRACKBALL_SCK_IRQ PORTB_IRQn
    #define TRACKBALL_SCK_CLOCK kCLOCK_PortB
    #define TRACKBALL_SCK_PIN 0

    #define TRACKBALL_SPI_MASTER SPI0
    #define TRACKBALL_SPI_MASTER_SOURCE_CLOCK kCLOCK_BusClk

// Functions:

    void Trackball_Init(void);

#endif
```
